AUTOSAR XML (schema 4-2-2)
package /ArcCore/Implementations/tc2xx
  bsw implementation Mcu: programming-language=C, sw-version=2.0.0, used-code-generator=generators::mcal::tc2xx::Mcu::main, vendor-id=60, ar-release-version=4.1.2, vendor-specific-module-def=Mcu
