AUTOSAR XML (schema 4-2-2)
package /ArcCore/EcucDefs/mpc5567/Implementations
  6 x bsw implementation, all with ar-release-version=4.1.2:
    Spi: programming-language=C, sw-version=2.0.0, used-code-generator=generators::mcal::mpc5567::Spi::main, vendor-specific-module-def=Spi
    Pwm: programming-language=C, sw-version=2.1.0, used-code-generator=generators::mcal::mpc5567::Pwm::main, vendor-specific-module-def=Pwm
    Mcu: programming-language=C, sw-version=2.0.0, used-code-generator=generators::mcal::mpc5567::Mcu::main, vendor-id=60, vendor-specific-module-def=Mcu
    Dio: sw-version=5.0.0, used-code-generator=generators::mcal::mpc5567::Dio::main, vendor-id=60, vendor-api-infix=NOT_USED, vendor-specific-module-def=Dio
    Can: sw-version=5.0.0, used-code-generator=generators::mcal::mpc5567::Can::main, vendor-id=60, vendor-specific-module-def=Can
    Adc: programming-language=C, sw-version=2.0.0, used-code-generator=generators::mcal::mpc5567::Adc::main, vendor-specific-module-def=Adc
