AUTOSAR XML (schema 4-2-2)
package /ArcCore/Implementations/mpc5645s
  11 x bsw implementation, all with vendor-id=60, ar-release-version=4.1.2:
    Adc: programming-language=C, sw-version=2.0.0, used-code-generator=generators::mcal::mpc560x::Adc::main, vendor-specific-module-def=Adc
    Can: sw-version=5.0.0, used-code-generator=generators::mcal::mpc560x::Can::main, vendor-specific-module-def=Can
    Icu: sw-version=2.0.0, used-code-generator=generators::mcal::mpc560x::Icu::main, vendor-specific-module-def=Icu
    Gpt: programming-language=C, sw-version=3.0.0, used-code-generator=generators::mcal::mpc560x::Gpt::main, vendor-specific-module-def=Gpt
    Mcu: programming-language=C, sw-version=2.0.0, used-code-generator=generators::mcal::mpc560x::Mcu::main, vendor-specific-module-def=Mcu
    Pwm: programming-language=C, sw-version=2.1.0, used-code-generator=generators::mcal::mpc560x::Pwm::main, vendor-specific-module-def=Pwm
    Spi: programming-language=C, sw-version=2.0.0, used-code-generator=generators::mcal::mpc560x::Spi::main, vendor-specific-module-def=Spi
    Lin: programming-language=C, sw-version=2.1.1, used-code-generator=generators::mcal::mpc560x::Lin::main, vendor-specific-module-def=Lin
    Dio: sw-version=5.0.0, used-code-generator=generators::mcal::mpc560x::Dio::main, vendor-specific-module-def=Dio
    Ocu: programming-language=C, sw-version=1.0.0, used-code-generator=generators::mcal::mpc560x::Ocu::main, vendor-specific-module-def=Ocu
    CDD_LinSlv: programming-language=C, sw-version=0.1.0, used-code-generator=cdd::LinSlv::generator::CDD_LinSlv::main, vendor-specific-module-def=CDD_LinSlv
