AUTOSAR XML (schema 4-2-2)
package /ArcCore/Implementations/mpc5777m
  7 x bsw implementation, all with vendor-id=60, ar-release-version=4.1.2:
    Adc: programming-language=C, sw-version=2.0.0, used-code-generator=generators::mcal::mpc560x::Adc::main, vendor-specific-module-def=Adc
    Can: programming-language=C, sw-version=5.0.0, used-code-generator=generators::mcal::mpc560x::mCan::main, vendor-specific-module-def=Can
    Dio: sw-version=5.0.0, used-code-generator=generators::mcal::mpc560x::Dio::main, vendor-specific-module-def=Dio
    Gpt: programming-language=C, sw-version=3.0.0, used-code-generator=generators::mcal::mpc560x::Gpt::main, vendor-specific-module-def=Gpt
    Mcu: programming-language=C, sw-version=2.0.0, used-code-generator=generators::mcal::mpc560x::Mcu_mpc5744p::main, vendor-specific-module-def=Mcu
    Lin: programming-language=C, sw-version=2.1.1, used-code-generator=generators::mcal::mpc560x::Lin::main, vendor-specific-module-def=Lin
    Spi: programming-language=C, sw-version=2.0.0, used-code-generator=generators::mcal::mpc560x::Spi::main, vendor-specific-module-def=Spi
