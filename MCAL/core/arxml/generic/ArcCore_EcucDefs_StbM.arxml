AUTOSAR XML (schema 4-2-2)
package /ArcCore/EcucDefs/Generic
  module definition StbM [0..1]: refined-module-def=StbM, variants pre-compile  # Configuration of the Synchronized Time-base Manager (StbM) module.
    container StbMGeneral  # This container holds the general parameters of the Synchronized Time-base Manager
      boolean StbMDevErrorDetect  # Switches the Default Error Tracer (Det) detection and notification ON or OFF. | * true: enabled (ON). * false: disabled (OFF).
      boolean StbMGetCurrentTimeExtendedAvailable [0..1]  # This allows to define whether an additional variant of the API GetCurrentTime with a 64 bit argument is provided.
      float StbMMainFunctionPeriod: 1E-6..Inf  # Schedule period of the main function StbM_MainFunction. Unit: [s].
      boolean StbMVersionInfo  # Activate/Deactivate the version information API (StbM_GetVersionInfo). True: version information API activated False: version information API deactivated.
    container StbMSynchronizedTimeBase [1..*]  # Synchronized time.base collects the information about a specific time-base provider within the system.
      boolean StbMIsSystemWideGlobalTimeMaster  # This parameter shall be set to true for a global time master that acts as a system-wide source of time information with respect to global time. | It is possible that several global time masters exist that have set this parameter set to true because the global time masters exist once per global time domain and one ECU may start several global time domains on different busses it is connected to.
      enumeration StbMStoreTimebaseNonVolatile [0..1]: {NO_STORAGE, STORAGE_AT_SHUTDOWN}  # This allows for specifying that the timebase shall be stored in the NvRam
      float StbMSyncLossThreshold [0..1]: 0..Inf  # This represents the minimum delta between the time value in two sync messages for which the sync loss flag is set. Unit: seconds.
      float StbMSyncLossTimeout [0..1]: 0..Inf  # This attribute describes the timeout for the situation that the time synchronization gets lost in the scope of the time domain. Unit: seconds
      integer StbMSynchronizedTimeBaseIdentifier: 0..65535, symbolic-name-value=true  # Identification of a synchronized time-base via a unique identifier.
      reference StbMEthGlobalTimeDomainRef [0..1]: destination=EthTSynGlobalTimeDomain  # Optional sub container in case a local time shall be accessed on an Ethernet bus.
      reference StbMLocalTimeRef [0..1]: destination=OsCounter  # This represents an optional sub-container in case a local time shall be accessed. | In this case, the designated OS counter has to be configured properly, meaning: * the counter is directly driven by a HW timer. * the counter's OsCounterTicksPerBase is one tick in x nanoseconds (ns).
      reference StbMOffsetTimeBase [0..1]: destination=StbMSynchronizedTimeBase  # This is the reference to the Synchronized Time-Base this Offset Time-Base is based on. This reference makes the containing StbMSynchronizedTimeBase an Offset Time-Base.
      symbolic name reference ArcStbMNvMBlockRef [0..1]: set at pre-compile, origin=ARCCORE_ECUC, destination=NvMBlockDescriptor  # Reference to NvM block used for storing Time Stamp Data.
    container StbMTriggeredCustomer [0..*]  # The triggered customer is directly triggered by the Synchronized Time-base Manager by getting synchronized with the current (global) definition of time and passage of time.
      integer StbMTriggeredCustomerPeriod: 0..4294967295  # The triggering period of the triggered customer, called by the StbM_MainFunction. | The period is documented in microseconds.
      reference StbMOSScheduleTableRef: destination=OsScheduleTable  # Mandatory reference to synchronized OS ScheduleTable, which will be explicitly synchronized by the StbM.
      symbolic name reference StbMSynchronizedTimeBaseRef: destination=StbMSynchronizedTimeBase  # Mandatory reference to the required synchronized time-base.
package /ArcCore/EcucDefs/Generic/Implementations
  bsw implementation StbM: programming-language=C, sw-version=1.0.0, used-code-generator=generators::generic::StbM::main, vendor-id=60, ar-release-version=4.2.2, vendor-specific-module-def=StbM
