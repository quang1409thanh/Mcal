AUTOSAR XML (schema 4-2-2)
package /ArcCore/EcucDefs/Generic
  module definition Cal [0..1]: variants pre-compile  # Configuration of the Cal (CryptoAbstractionLibrary) module.
    container CalAsymDecrypt [0..1]  # Container for incorporation of AsymDecrypt primitives.
      integer CalAsymDecryptMaxCtxBufByteSize: 1..4294967295, set at pre-compile  # The maximum, in bytes, of all context buffers used in all CPL primitives which implement an asymmetrical decryption.
      integer CalAsymDecryptMaxKeySize: 1..4294967295, set at pre-compile  # The maximum, in bytes, of all key lengths used in all CPL primitives which implement an asymmetrical decryption.
      container CalAsymDecryptConfig [0..32]  # Container for configuration of service AsymDecrypt. The container name serves as a symbolic name for the identifier of a service configuration.
        string CalAsymDecryptInitConfiguration: set at pre-compile  # Name of a C symbol which contains the configuration of the underlying cryptographic primitive.
        string CalAsymDecryptPrimitiveName: set at pre-compile  # Name of the cryptographic primitive to use.
    container CalAsymEncrypt [0..1]  # Container for incorporation of AsymEncrypt primitives.
      integer CalAsymEncryptMaxCtxBufByteSize: 1..4294967295, set at pre-compile  # The maximum, in bytes, of all context buffers used in all CPL primitives which implement an asymmetrical encryption.
      integer CalAsymEncryptMaxKeySize: 1..4294967295, set at pre-compile  # The maximum, in bytes, of all key lengths used in all CPL primitives which implement an asymmetrical encryption.
      container CalAsymEncryptConfig [0..32]  # Container for configuration of service AsymEncrypt. The container name serves as a symbolic name for the identifier of a service configuration.
        string CalAsymEncryptInitConfiguration: set at pre-compile  # Name of a C symbol which contains the configuration of the underlying cryptographic primitive.
        string CalAsymEncryptPrimitiveName: set at pre-compile  # Name of the cryptographic primitive to use.
    container CalAsymPrivateKeyExtract [0..1]  # Container for incorporation of AsymPrivateKeyExtract primitives.
      integer CalAsymPrivateKeyExtractMaxCtxBufByteSize: 1..4294967295, set at pre-compile  # The maximum, in bytes, of all context buffers used in all CPL primitives which implement an asymmetrical private key extraction.
      integer CalAsymPrivateKeyExtractMaxKeySize: 1..4294967295, set at pre-compile  # The maximum, in bytes, of all key lengths used in all CPL primitives which implement an asymmetrical private key extraction.
      container CalAsymPrivateKeyExtractConfig [0..32]  # Container for configuration of service AsymPrivateKeyExtract. | The container name serves as a symbolic name for the identifier of a service configuration.
        string CalAsymPrivateKeyExtractInitConfiguration: set at pre-compile  # Name of a C symbol which contains the configuration of the underlying cryptographic primitive.
        string CalAsymPrivateKeyExtractPrimitiveName: set at pre-compile  # Name of the cryptographic primitive to use.
    container CalAsymPrivateKeyWrapAsym [0..1]  # Container for incorporation of AsymPrivateKeyWrapAsym primitives.
      integer CalAsymPrivateKeyWrapAsymMaxPrivKeySize: 1..4294967295, set at pre-compile  # The maximum length, in bytes, of all private information types used in all CPL primitives which implement an asymmetrical key wrapping.
      integer CalAsymPrivateKeyWrapAsymMaxPubKeySize: 1..4294967295, set at pre-compile  # The maximum length, in bytes, of all public key types used in all CPL primitives which implement an asymmetrical key wrapping.
      container CalAsymPrivateKeyWrapAsymConfig [0..32]  # Container for configuration of service AsymPrivateKeyWrapAsym. | The container name serves as a symbolic name for the identifier of a service configuration.
        string CalAsymPrivateKeyWrapAsymInitConfiguration: set at pre-compile  # Name of a C symbol which contains the configuration of the underlying cryptographic primitive.
        string CalAsymPrivateKeyWrapAsymPrimitiveName: set at pre-compile  # Name of the cryptographic primitive to use.
    container CalAsymPrivateKeyWrapSym [0..1]  # Container for incorporation of AsymPrivateKeyWrapSym primitives.
      integer CalAsymPrivateKeyWrapSymMaxPrivKeySize: 1..4294967295, set at pre-compile  # The maximum length, in bytes, of all private information types used in all CPL primitives which implement an asymmetrical key wrapping.
      integer CalAsymPrivateKeyWrapSymMaxSymKeySize: 1..4294967295, set at pre-compile  # The maximum, in bytes, of all key lengths used in all CPL primitives which implement an asymmetrical key wrapping.
      container CalAsymPrivateKeyWrapSymConfig [0..32]  # Container for configuration of service AsymPrivateKeyWrapSym. | The container name serves as a symbolic name for the identifier of a service configuration.
        string CalAsymPrivateKeyWrapSymInitConfiguration: set at pre-compile  # Name of a C symbol which contains the configuration of the underlying cryptographic primitive.
        string CalAsymPrivateKeyWrapSymPrimitiveName: set at pre-compile  # Name of the cryptographic primitive to use.
    container CalAsymPublicKeyExtract [0..1]  # Container for incorporation of AsymPublicKeyExtract primitives.
      integer CalAsymPublicKeyExtractMaxCtxBufByteSize: 1..4294967295, set at pre-compile  # The maximum, in bytes, of all context buffers used in all CPL primitives which implement an asymmetrical public key extraction.
      integer CalAsymPublicKeyExtractMaxKeySize: 1..4294967295, set at pre-compile  # The maximum, in bytes, of all key lengths used in all CPL primitives which implement an asymmetrical public key extraction.
      container CalAsymPublicKeyExtractConfig [0..32]  # Container for configuration of service AsymPublicKeyExtract. | The container name serves as a symbolic name for the identifier of a service configuration.
        string CalAsymPublicKeyExtractInitConfiguration: set at pre-compile  # Name of a C symbol which contains the configuration of the underlying cryptographic primitive.
        string CalAsymPublicKeyExtractPrimitiveName: set at pre-compile  # Name of the cryptographic primitive to use.
    container CalChecksum [0..1]  # Container for incorporation of Checksum primitives.
      integer CalChecksumMaxCtxBufByteSize: 1..4294967295, set at pre-compile  # The maximum, in bytes, of all context buffers used in all CPL primitives which implement a checksum computation.
      container CalChecksumConfig [0..32]  # Container for configuration of service Checksum. The container name serves as a symbolic name for the identifier of a service configuration.
        string CalChecksumInitConfiguration: set at pre-compile  # Name of a C symbol which contains the configuration of the underlying cryptographic primitive.
        string CalChecksumPrimitiveName: set at pre-compile  # Name of the cryptographic primitive to use.
    container CalGeneral  # Container for common configuration options.
      string CalMaxAlignScalarType: set at pre-compile  # The scalar type which has the maximum alignment restrictions on the given platform. | This type can be e.g. uint8, uint16 or uint32.
    container CalHash [0..1]  # Container for incorporation of Hash primitives.
      integer CalHashMaxCtxBufByteSize: 1..4294967295, set at pre-compile  # The maximum, in bytes, of all context buffers used in all CPL primitives which implement a hash computation.
      container CalHashConfig [0..32]  # Configurations for the Hash service. The container name serves as a symbolic name for the identifier of a service configuration.
        string CalHashInitConfiguration: set at pre-compile  # Name of a C symbol which contains the configuration of the underlying cryptographic primitive.
        string CalHashPrimitiveName: set at pre-compile  # Name of the cryptographic primitive to use.
    container CalKeyDerive [0..1]  # Container for incorporation of KeyDerive primitives.
      integer CalKeyDeriveMaxCtxBufByteSize: 1..4294967295, set at pre-compile  # The maximum, in bytes, of all context buffers used in all CPL primitives which implement a key derivation.
      integer CalKeyDeriveMaxKeySize: 1..4294967295, set at pre-compile  # The maximum, in bytes, of all key lengths used in all CRL primitives which implement a key derivation.
      container CalKeyDeriveConfig [0..32]  # Container for configuration of service KeyDerive. The container name serves as a symbolic name for the identifier of a service configuration.
        string CalKeyDeriveInitConfiguration: set at pre-compile  # Name of a C symbol which contains the configuration of the underlying cryptographic primitive.
        string CalKeyDerivePrimitiveName: set at pre-compile  # Name of the cryptographic primitive to use.
    container CalKeyExchangeCalcPubVal [0..1]  # Container for incorporation of KeyExchangeCalcPubVal primitives.
      integer CalKeyExchangeCalcPubValMaxBaseTypeSize: 1..4294967295, set at pre-compile  # The maximum length, in bytes, of all base types used in all CPL primitives which implement a public value calculation.
      integer CalKeyExchangeCalcPubValMaxCtxBufByteSize: 1..4294967295, set at pre-compile  # The maximum, in bytes, of all context buffers used in all CPL primitives which implement a public value calculation.
      integer CalKeyExchangeCalcPubValMaxPrivateTypeSize: 1..4294967295, set at pre-compile  # The maximum length, in bytes, of all private information types used in all CPL primitives which implement a public value calculation.
      container CalKeyExchangeCalcPubValConfig [0..32]  # Container for configuration of service KeyExchangeCalcPubVal. The container name serves as a symbolic name for the identifier of a service configuration.
        string CalKeyExchangeCalcPubValInitConfiguration: set at pre-compile  # Name of a C symbol which contains the configuration of the underlying cryptographic primitive.
        string CalKeyExchangeCalcPubValPrimitiveName: set at pre-compile  # Name of the cryptographic primitive to use.
    container CalKeyExchangeCalcSecret [0..1]  # Container for incorporation of KeyExchangeCalcSecret primitives.
      integer CalKeyExchangeCalcSecretMaxBaseTypeSize: 1..4294967295, set at pre-compile  # The maximum length, in bytes, of all base types used in all CPL primitives which implement a shared secret calculation.
      integer CalKeyExchangeCalcSecretMaxCtxBufByteSize: 1..4294967295, set at pre-compile  # The maximum, in bytes, of all context buffers used in all CPL primitives which implement a shared secret calculation.
      integer CalKeyExchangeCalcSecretMaxPrivateTypeSize: 1..4294967295, set at pre-compile  # The maximum length, in bytes, of all private information types used in all CPL primitives which implement a shared secret calculation.
      container CalKeyExchangeCalcSecretConfig [0..32]  # Container for configuration of service KeyExchangeCalcSecret. The container name serves as a symbolic name for the identifier of a service configuration.
        string CalKeyExchangeCalcSecretInitConfiguration: set at pre-compile  # Name of a C symbol which contains the configuration of the underlying cryptographic primitive.
        string CalKeyExchangeCalcSecretPrimitiveName: set at pre-compile  # Name of the cryptographic primitive to use.
    container CalMacGenerate [0..1]  # Container for incorporation of MacGenerate primitives.
      integer CalMacGenerateMaxCtxBufByteSize: 1..4294967295, set at pre-compile  # The maximum, in bytes, of all context buffers used in all CPL primitives which implement a MAC generation.
      integer CalMacGenerateMaxKeySize: 1..4294967295, set at pre-compile  # The maximum, in bytes, of all key lengths used in all CPL primitives which implement a MAC generation.
      container CalMacGenerateConfig [0..32]  # Configurations for the MacGenerate service. The container name serves as a symbolic name for the identifier of a service configuration.
        string CalMacGenerateInitConfiguration: set at pre-compile  # Name of a C symbol which contains the configuration of the underlying cryptographic primitive.
        string CalMacGeneratePrimitiveName: set at pre-compile  # Name of the cryptographic primitive to use.
    container CalMacVerify [0..1]  # Container for incorporation of MacVerify primitives.
      integer CalMacVerifyMaxCtxBufByteSize: 1..4294967295, set at pre-compile  # The maximum, in bytes, of all context buffers used in all CPL primitives which implement a MAC verification.
      integer CalMacVerifyMaxKeySize: 1..4294967295, set at pre-compile  # The maximum, in bytes, of all key lengths used in all CPL primitives which implement a MAC verification.
      container CalMacVerifyConfig [0..32]  # Container for configuration of service MacVerify. The container name serves as a symbolic name for the identifier of a service configuration.
        string CalMacVerifyInitConfiguration: set at pre-compile  # Name of a C symbol which contains the configuration of the underlying cryptographic primitive.
        string CalMacVerifyPrimitiveName: set at pre-compile  # Name of the cryptographic primitive to use.
    container CalRandomGenerate [0..1]  # Container for incorporation of RandomGenerate primitives.
      container CalRandomGenerateConfig [0..32]  # Container for configuration of service RandomGenerate. The container name serves as a symbolic name for the identifier of a service configuration.
        string CalRandomGenerateInitConfiguration: set at pre-compile  # Name of a C symbol which contains the configuration of the underlying cryptographic primitive.
        string CalRandomGeneratePrimitiveName: set at pre-compile  # Name of the cryptographic primitive to use.
    container CalRandomSeed [0..1]  # Container for incorporation of RandomSeed primitives.
      integer CalRandomMaxCtxBufByteSize: 1..4294967295, set at pre-compile  # The maximum, in bytes, of all context buffers used in all CPL primitives which implement seeding or generating a random number.
      container CalRandomSeedConfig [0..32]  # Container for configuration of service RandomSeed. The container name serves as a symbolic name for the identifier of a service configuration.
        string CalRandomSeedInitConfiguration: set at pre-compile  # Name of a C symbol which contains the configuration of the underlying cryptographic primitive.
        string CalRandomSeedPrimitiveName: set at pre-compile  # Name of the cryptographic primitive to use.
    container CalSignatureGenerate [0..1]  # Container for incorporation of SignatureGenerate primitives
      integer CalSignatureGenerateMaxCtxBufByteSize: 1..4294967295, set at pre-compile  # The maximum, in bytes, of all context buffers used in all CPL primitives which implement a signature generation.
      integer CalSignatureGenerateMaxKeySize: 1..4294967295, set at pre-compile  # The maximum, in bytes, of all key lengths used in all CPL primitives which implement a signature generation.
      container CalSignatureGenerateConfig [0..32]  # Container for configuration of service SignatureGenerate. The container name serves as a symbolic name for the identifier of a service configuration.
        string CalSignatureGenerateInitConfiguration: set at pre-compile  # Name of a C symbol which contains the configuration of the underlying cryptographic primitive.
        string CalSignatureGeneratePrimitiveName: set at pre-compile  # Name of the cryptographic primitive to use.
    container CalSignatureVerify [0..1]  # Container for incorporation of SignatureVerify primitives.
      integer CalSignatureVerifyMaxCtxBufByteSize: 1..4294967295, set at pre-compile  # The maximum, in bytes, of all context buffers used in all CPL primitives which implement a signature verification.
      integer CalSignatureVerifyMaxKeySize: 1..4294967295, set at pre-compile  # The maximum, in bytes, of all key lengths used in all CPL primitives which implement a signature verification.
      container CalSignatureVerifyConfig [0..32]  # Container for configuration of service SignatureVerify. The container name serves as a symbolic name for the identifier of a service configuration.
        string CalSignatureVerifyInitConfiguration: set at pre-compile  # Name of a C symbol which contains the configuration of the underlying cryptographic primitive.
        string CalSignatureVerifyPrimitiveName: set at pre-compile  # Name of the cryptographic primitive to use.
    container CalSymBlockDecrypt [0..1]  # Container for incorporation of SymBlockDecrypt primitives.
      integer CalSymBlockDecryptMaxCtxBufByteSize: 1..4294967295, set at pre-compile  # The maximum, in bytes, of all context buffers used in all CPL primitives which implement a symmetrical block decryption.
      integer CalSymBlockDecryptMaxKeySize: 1..4294967295, set at pre-compile  # The maximum, in bytes, of all key lengths used in all CPL primitives which implement a symmetrical block decryption.
      container CalSymBlockDecryptConfig [0..32]  # Container for configuration of service SymBlockDecrypt. The container name serves as a symbolic name for the identifier of a service configuration.
        string CalSymBlockDecryptInitConfiguration: set at pre-compile  # Name of a C symbol which contains the configuration of the underlying cryptographic primitive.
        string CalSymBlockDecryptPrimitiveName: set at pre-compile  # Name of the cryptographic primitive to use.
    container CalSymBlockEncrypt [0..1]  # Container for incorporation of SymBlockEncrypt primitives.
      integer CalSymBlockEncryptMaxCtxBufByteSize: 1..4294967295, set at pre-compile  # The maximum, in bytes, of all context buffers used in all CPL primitives which implement a symmetrical block encryption.
      integer CalSymBlockEncryptMaxKeySize: 1..4294967295, set at pre-compile  # The maximum, in bytes, of all key lengths used in all CPL primitives which implement a symmetrical block encryption.
      container CalSymBlockEncryptConfig [0..32]  # Container for configuration of service SymBlockEncrypt. The container name serves as a symbolic name for the identifier of a service configuration.
        string CalSymBlockEncryptInitConfiguration: set at pre-compile  # Name of a C symbol which contains the configuration of the underlying cryptographic primitive.
        string CalSymBlockEncryptPrimitiveName: set at pre-compile  # Name of the cryptographic primitive to use.
    container CalSymDecrypt [0..1]  # Container for incorporation of SymDecrypt primitives
      integer CalSymDecryptMaxCtxBufByteSize: 1..4294967295, set at pre-compile  # The maximum, in bytes, of all context buffers used in all CPL primitives which implement a symmetrical decryption.
      integer CalSymDecryptMaxKeySize: 1..4294967295, set at pre-compile  # The maximum, in bytes, of all key lengths used in all CPL primitives which implement a symmetrical decryption.
      container CalSymDecryptConfig [0..32]  # Container for configuration of service SymDecrypt. | The container name serves as a symbolic name for the identifier of a service configuration.
        string CalSymDecryptInitConfiguration: set at pre-compile  # Name of a C symbol which contains the configuration of the underlying cryptographic primitive.
        string CalSymDecryptPrimitiveName: set at pre-compile  # Name of the cryptographic primitive to use.
    container CalSymEncrypt [0..1]  # Container for incorporation of SymEncrypt primitives.
      integer CalSymEncryptMaxCtxBufByteSize: 1..4294967295, set at pre-compile  # The maximum, in bytes, of all context buffers used in all CPL primitives which implement a symmetrical encryption.
      integer CalSymEncryptMaxKeySize: 1..4294967295, set at pre-compile  # The maximum, in bytes, of all key lengths used in all CPL primitives which implement a symmetrical encryption.
      container CalSymEncryptConfig [0..32]  # Container for configuration of service SymEncrypt. The container name serves as a symbolic name for the identifier of a service configuration.
        string CalSymBlockEncryptInitConfiguration: set at pre-compile  # Name of a C symbol which contains the configuration of the underlying cryptographic primitive.
        string CalSymEncryptPrimitiveName: set at pre-compile  # Name of the cryptographic primitive to use.
    container CalSymKeyExtract [0..1]  # Container for incorporation of SymKeyExtract primitives.
      integer CalSymKeyExtractMaxCtxBufByteSize: 1..4294967295, set at pre-compile  # The maximum, in bytes, of all context buffers used in all CPL primitives which implement a symmetrical key extraction.
      integer CalSymKeyExtractMaxKeySize: 1..4294967295, set at pre-compile  # The maximum, in bytes, of all key lengths used in all CPL primitives which implement a symmetrical key extraction.
      container CalSymKeyExtractConfig [0..32]  # Container for configuration of service SymKeyExtract. The container name serves as a symbolic name for the identifier of a service configuration.
        string CalSymKeyExtractInitConfiguration: set at pre-compile  # Name of a C symbol which contains the configuration of the underlying cryptographic primitive.
        string CalSymKeyExtractPrimitiveName: set at pre-compile  # Name of the cryptographic primitive to use.
    container CalSymKeyWrapAsym [0..1]  # Container for incorporation of SymKeyWrapAsym primitives.
      integer CalSymKeyWrapAsymMaxPubKeySize: 1..4294967295, set at pre-compile  # The maximum length, in bytes, of all public key types used in all CPL primitives which implement a symmetrical key wrapping.
      integer CalSymKeyWrapAsymMaxSymKeySize: 1..4294967295, set at pre-compile  # The maximum, in bytes, of all key lengths used in all CPL primitives which implement a symmetrical key wrapping.
      container CalSymKeyWrapAsymConfig [0..32]  # Container for configuration of service SymKeyWrapAsym. | The container name serves as a symbolic name for the identifier of a service configuration.
        string CalSymKeyWrapAsymInitConfiguration: set at pre-compile  # Name of a C symbol which contains the configuration of the underlying cryptographic primitive.
        string CalSymKeyWrapAsymPrimitiveName: set at pre-compile  # Name of the cryptographic primitive to use.
    container CalSymKeyWrapSym [0..1]  # Container for incorporation of SymKeyWrapSym primitives.
      integer CalSymKeyWrapSymMaxSymKeySize: 1..4294967295, set at pre-compile  # The maximum, in bytes, of all key lengths used in all CPL primitives which implement a symmetrical key wrapping.
      container CalSymKeyWrapSymConfig [0..32]  # Container for configuration of service SymKeyWrapSym. | The container name serves as a symbolic name for the identifier of a service configuration.
        string CalSymKeyWrapSymInitConfiguration: set at pre-compile  # Name of a C symbol which contains the configuration of the underlying cryptographic primitive.
        string CalSymKeyWrapSymPrimitiveName: set at pre-compile  # Name of the cryptographic primitive to use.
package /ArcCore/EcucDefs/Generic/Implementations
  bsw implementation Cal: programming-language=C, sw-version=1.0.0, used-code-generator=generators::generic::Cal::main, vendor-id=60, ar-release-version=4.0.3, vendor-specific-module-def=Cal
