AUTOSAR XML (schema 4-2-2)
package /ArcCore/EcucDefs/Generic
  module definition MemIf [0..1]: refined-module-def=MemIf, variants pre-compile  # Configuration of the MemIf (Memory Abstraction Interface) module.
    container MemIfGeneral  # Configuration of the memory abstraction interface (Memif) module.
      boolean MemIfDevErrorDetect: set at pre-compile, default-value=1  # Pre-processor switch to enable and disable development error detection. | true: Development error detection enabled. false: Development error detection disabled.
      integer MemIfNumberOfDevices: 1..255, set at pre-compile  # Concrete number of underlying memory abstraction modules. | Calculation Formula: Count number of configured EA and FEE modules.
      boolean MemIfVersionInfoApi: set at pre-compile, default-value=0  # Pre-processor switch to enable / disable the API to read out the modules version information. | true: Version info API enabled. false: Version info API disabled.
package /ArcCore/EcucDefs/Generic/Implementations
  bsw implementation MemIf: programming-language=C, sw-version=1.0.0, used-code-generator=generators::generic::MemIf::main, vendor-id=60, ar-release-version=4.0.3, vendor-specific-module-def=MemIf
