AUTOSAR XML (schema 4-2-2)
package /ArcCore/EcucDefs/Generic
  module definition Fee [0..1]: refined-module-def=Fee, variants pre-compile  # Configuration of the Fee (Flash EEPROM Emulation) module.
    container FeeBlockConfiguration [1..*]  # Configuration of block specific parameters for the Flash EEPROM Emulation module.
      integer FeeBlockNumber: 1..65534, set at pre-compile, symbolic-name-value=true  # Block identifier (handle). | 0x0000 and 0xFFFF shall not be used for block numbers (see FEE006). Range: min = 2^NVM_DATASET_SELECTION_BITS max = 0xFFFF -2^NVM_DATASET_SELECTION_BITS Note: Depending on the number of bits set aside for dataset selection several other block numbers shall also be left out to ease implementation.
      integer FeeBlockSize: 1..65535, set at pre-compile  # Size of a logical block in bytes.
      boolean FeeImmediateData: set at pre-compile  # Marker for high priority data. | true: Block contains immediate data. false: Block does not contain immediate data.
      integer FeeNumberOfWriteCycles: 0..4294967295, set at pre-compile  # Number of write cycles required for this block.
      symbolic name reference FeeDeviceIndex: set at pre-compile, destination=FlsGeneral  # Device index (handle). | Range: 0 .. 254 (0xFF reserved for broadcast call to GetStatus function).
    container FeeGeneral  # Container for general parameters. These parameters are not specific to a block.
      boolean FeeDevErrorDetect: set at pre-compile, default-value=1  # Pre-processor switch to enable and disable development error detection. | true: Development error detection enabled. false: Development error detection disabled.
      integer FeeIndex: 0..254, set at pre-compile  # Specifies the InstanceId of this module instance. If only one instance is present it shall have the Id 0.
      function name FeeNvmJobEndNotification [0..1]: set at pre-compile  # Mapped to the job end notification routine provided by the upper layer module (NvM_JobEndNotification).
      function name FeeNvmJobErrorNotification [0..1]: set at pre-compile  # Mapped to the job error notification routine provided by the upper layer module (NvM_JobErrorNotification).
      boolean FeePollingMode: set at pre-compile, default-value=1  # Pre-processor switch to enable and disable the polling mode for this module. | true: Polling mode enabled, callback functions (provided to FLS module) disabled. false: Polling mode disabled, callback functions (provided to FLS module) enabled.
      boolean FeeSetModeSupported: set at pre-compile  # Compiler switch to enable/disable the 'SetMode' functionality of the FEE module. | TRUE: SetMode functionality supported / code present, FALSE: SetMode functionality not supported / code not present. Note: This configuration setting has to be consistent with that of all underlying flash device drivers (configuration parameter FlsSetModeApi).
      boolean FeeVersionInfoApi: set at pre-compile, default-value=0  # Pre-processor switch to enable / disable the API to read out the modules version information. | true: Version info API enabled. false: Version info API disabled.
      integer FeeVirtualPageSize: 0..65535, set at pre-compile  # The size in bytes to which logical blocks shall be aligned.
      boolean ArcUseJobNotifications: set at pre-compile, origin=ArcCore, default-value=1  # Enables/Disables Job end notification callback and Job error notification callback
      integer ArcFeeBank1Size: 1.., set at pre-compile, origin=ArcCore  # Size of bank1 in bytes, offset + size must be aligned to a sector end
      integer ArcFeeBank2Size: 1.., set at pre-compile, origin=ArcCore  # Size of bank2 in bytes, offset + size must be aligned to a sector end
      integer ArcFeeBank1Offset: 0..4294967295, set at pre-compile, origin=ArcCore  # Offset from start flash address to Bank1. Must be aligned to a flash sector start. This value is used in the linkscript file for allocation of the bank.
      integer ArcFeeBank2Offset: 0..4294967295, set at pre-compile, origin=ArcCore  # Offset from start flash address to Bank2. Must be aligned to a flash sector start. This value is used in the linkscript file for allocation of the bank.
    container FeePublishedInformation  # Additional published parameters not covered by CommonPublishedInformation container. | Note that these parameters do not have any configuration class setting, since they are published information.
      integer FeeBlockOverhead: 0..65535, set at published-information  # Management overhead per logical block in bytes. | Note: If the management overhead depends on the block size or block location a formula has to be provided that allows the configurator to calculate the management overhead correctly.
      float FeeMaximumBlockingTime: 0..Inf, set at published-information  # The maximum time the FEE module's API routines shall be blocked (delayed) by internal operations. | Note: Internal operations in that case means operations that are not explicitly invoked from the upper layer module but need to be handled for proper operation of this module or the underlying memory driver.
      integer FeePageOverhead: 0..65535, set at published-information  # Management overhead per page in bytes. | Note: If the management overhead depends on the block size or block location a formula has to be provided that allows the configurator to calculate the management overhead correctly.
package /ArcCore/EcucDefs/Generic/Implementations
  bsw implementation Fee: programming-language=C, sw-version=1.0.0, used-code-generator=generators::generic::Fee::main, vendor-id=60, ar-release-version=4.0.3, vendor-specific-module-def=Fee
