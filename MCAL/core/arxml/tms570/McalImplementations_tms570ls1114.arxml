AUTOSAR XML (schema 4-2-2)
package /ArcCore/Implementations/tms570ls1114
  9 x bsw implementation, all with ar-release-version=4.1.2:
    Mcu: programming-language=C, sw-version=2.0.0, used-code-generator=generators::mcal::tms570::Mcu::main, vendor-specific-module-def=Mcu
    Dio: programming-language=C, sw-version=5.0.0, used-code-generator=generators::mcal::tms570::Dio::main, vendor-specific-module-def=Dio
    Pwm: programming-language=C, sw-version=2.1.0, used-code-generator=generators::mcal::tms570::Pwm::main, vendor-specific-module-def=Pwm
    Adc: programming-language=C, sw-version=2.0.0, used-code-generator=generators::mcal::tms570::Adc::main, vendor-specific-module-def=Adc
    Can: programming-language=C, sw-version=5.0.0, used-code-generator=generators::mcal::tms570::Can::main, vendor-specific-module-def=Can
    Port: sw-version=5.0.1, used-code-generator=generators::mcal::tms570::Port::main, vendor-id=60, vendor-specific-module-def=Port
    Gpt: programming-language=C, sw-version=3.0.0, used-code-generator=generators::mcal::tms570::Gpt::main, vendor-specific-module-def=Gpt
    Wdg: programming-language=C, sw-version=2.0.0, used-code-generator=generators::mcal::tms570::Wdg::main, vendor-specific-module-def=Wdg
    Spi: programming-language=C, sw-version=2.0.0, used-code-generator=generators::mcal::tms570::Spi::main, vendor-specific-module-def=Spi
