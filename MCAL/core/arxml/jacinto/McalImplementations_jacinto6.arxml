AUTOSAR XML (schema 4-2-2)
package /ArcCore/Implementations/jacinto6
  9 x bsw implementation:
    Port: sw-version=5.0.1, used-code-generator=generators::mcal::jacinto::Port::main, vendor-id=60, ar-release-version=4.1.2, vendor-specific-module-def=Port
    Dio: programming-language=C, sw-version=5.0.0, used-code-generator=generators::mcal::jacinto::Dio::main, ar-release-version=4.1.2, vendor-specific-module-def=Dio
    Mcu: programming-language=C, sw-version=2.0.0, used-code-generator=generators::mcal::jacinto::Mcu::main, ar-release-version=4.1.2, vendor-specific-module-def=Mcu
    Gpt: programming-language=C, sw-version=3.0.0, used-code-generator=generators::mcal::jacinto::Gpt::main, vendor-id=60, ar-release-version=4.1.2, vendor-specific-module-def=Gpt
    Eth: sw-version=1.0.0, used-code-generator=generators::generic::Eth::main, vendor-id=60, ar-release-version=4.2.2, vendor-specific-module-def=Eth
    Pwm: programming-language=C, sw-version=2.1.0, used-code-generator=generators::mcal::jacinto::Pwm::main, ar-release-version=4.1.2, vendor-specific-module-def=Pwm
    Spi: programming-language=C, sw-version=2.0.0, used-code-generator=generators::mcal::jacinto::Spi::main, ar-release-version=4.1.2, vendor-specific-module-def=Spi
    Lin: programming-language=C, sw-version=2.1.0, used-code-generator=generators::mcal::jacinto::Lin::main, ar-release-version=4.1.2, vendor-specific-module-def=Lin
    Can: programming-language=C, sw-version=5.0.0, used-code-generator=generators::mcal::jacinto::Can::main, ar-release-version=4.1.2, vendor-specific-module-def=Can
