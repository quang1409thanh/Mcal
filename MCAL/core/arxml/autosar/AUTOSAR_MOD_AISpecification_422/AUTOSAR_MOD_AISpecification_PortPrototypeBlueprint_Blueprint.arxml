[part 2 of 3: package /AUTOSAR/AISpecification/PortPrototypeBlueprints_Blueprint]
AUTOSAR XML (schema 4-2-2)
package /AUTOSAR/AISpecification/PortPrototypeBlueprints_Blueprint  (continued)
  2154 x port prototype blueprint:  (continued)
    EscTqCluPtMaxSlow: interface=EngTqDecAtCluReqByEscSlow1  # Maximum Powertrain Clutch Torque Requested by Electronic Stability Control (ESC) Slow Path | Reducing engine torque requested by Electronic stability control below the driver input torque including virtual driver request. Slow refers to the longer term or torque reserve request, usually the input to throttle control.
    EscTqCluPtMin: interface=EngTqIncAtCluReqByEsc1  # Minimum Powertrain Clutch Torque Requested by Electronic Stability Control (ESC) | Increasing engine torque requested by Electronic Stability Control over the driver input torque including virtual driver. If the engine has a slow (usually by throttle control) and fast path (typically by ignition timing) this signal is used for increasing on both torque paths.
    EscTqWhlPtMaxFast: interface=PtTqTotAtWhls1  # Maximum Powertrain Wheel Torque Requested by Electronic Stability Control (ESC) Fast Path | Wheel torque (to all the driven wheels) after coordination among several stability systems (traction control, stability control, and yaw rate control) to be generated by the powertrain. This is the maximum torque to be delivered by the powertrain, e.g. a torque decrease request [absolute] for ASC (Acceleration Slip Control) (to prevent wheel spin). If the maximum request is less than the minimum request the priority must be clearly defined. If no request is active, the value of this interface will be the upper limit of the chosen data type. | Must be initialised to the upper limit of the chosen data type.
    EscTqWhlPtMaxSlow: interface=PtTqTotAtWhls1  # Maximum Powertrain Wheel Torque Requested by Electronic Stability Control (ESC) Slow Path | Anticipated wheel torque (to all the driven wheels) after coordination among several stability systems (traction control, stability control, and yaw rate control) to be generated by the powertrain. This is the maximum torque to be delivered by the powertrain, e.g. a torque decrease request [absolute] for ASC (Acceleration Slip Control) (to prevent wheel spin). If the maximum request is less than the minimum request the priority must be clearly defined. If no request is active, the value of this interface will be the upper limit of the chosen data type. | Must be initialised to the upper limit of the chosen data type.
    EscTqWhlPtMinFast: interface=PtTqTotAtWhls1  # Minimum Powertrain Wheel Torque Requested by Electronic Stability Control (ESC) Fast Path | Wheel torque (to all the driven wheels) after coordination among several stability systems (traction control, stability control, and yaw rate control) to be generated by the powertrain. This is the minimum torque to be delivered by the powertrain, e.g. a torque increase request [absolute] for MSR (engine drag torque control (also known as "Motorschleppmomentregelung")) (to prevent wheel lock up). If the maximum request is less than the minimum request the priority must be clearly defined. If no request is active, the value of this interface will be the lower limit of the chosen data type. | Must be initialised to the lower limit of the chosen data type.
    EscTqWhlPtMinSlow: interface=PtTqTotAtWhls1  # Minimum Powertrain Wheel Torque Requested by Electronic Stability Control (ESC) Slow Path | Anticipated wheel torque (to all the driven wheels) after coordination among several stability systems (traction control, stability control, and yaw rate control) to be generated by the powertrain. This is the minimum torque to be delivered by the powertrain, e.g. a torque increase request [absolute] for MSR (engine drag torque control (also known as "Motorschleppmomentregelung")). If the maximum request is less than the minimum request the priority is the maximum request (which in the case is the lower value!) If no request is active, the value of this interface will be the lower limit of the chosen data type. | Must be initialised to the lower limit of the chosen data type.
    EscVMax: interface=VehSpd1  # Maximum Vehicle Speed Due to Electronic Stability Control (ESC) | Maximum vehicle speed requested by chassis for safety vehicle speed limitation. Arbitrated with a minimum function in powertrain domain, together with similar requests from other domains. Limit vehicle speed in case of brake system deterioration
    EscVWhlInd: interface=WhlSpdCircuml1  # Electronic Stability Control (ESC): Vector of Individual Speed of Wheels | Vector of 4 scalars in the order front left, front right, rear left, rear right. These scalars are the product of the individual angular velocities with the nominal (or static) rolling radius. The nominal (or static) rolling radius is representative of each vehicle, and is a value such that the standard circumferential wheel speed is very close to the vehicle longitudinal speed of the vehicle. If signal is not provided (optional) the radius must be available as a parameter
    ExtrLiBriActvn: interface=ExtrLiBriCmd1  # Activation Of Exterior Light Source | Request the brightness of a light actuator. The percentage value (independent of light actuator type and environment e.g. voltage of electrical system) depends on the functionality that the light source shall be switched on for (e.g. low beam used for daytime running light, or replacement of a defect lamp). | 100 percent means full power of the light actuator.
    ExtrLiBriActvnOfBeamHiLe: interface=ExtrLiBriCmd1  # Activation of Exterior Light Source | Request the brightness of a light actuator. The percentage value (independent of light actuator type and environment e.g. voltage of electrical system) depends on the functionality that the light source shall be switched on for (e.g. low beam used for daytime running light, or replacement of a defect lamp). | 100 percent means full power of the light actuator.
    ExtrLiBriActvnOfBeamHiRi: interface=ExtrLiBriCmd1  # Activation of Exterior Light Source | Request the brightness of a light actuator. The percentage value (independent of light actuator type and environment e.g. voltage of electrical system) depends on the functionality that the light source shall be switched on for (e.g. low beam used for daytime running light, or replacement of a defect lamp). | 100 percent means full power of the light actuator.
    ExtrLiBriActvnOfBeamLoLe: interface=ExtrLiBriCmd1  # Activation of Exterior Light Source | Request the brightness of a light actuator. The percentage value (independent of light actuator type and environment e.g. voltage of electrical system) depends on the functionality that the light source shall be switched on for (e.g. low beam used for daytime running light, or replacement of a defect lamp). | 100 percent means full power of the light actuator.
    ExtrLiBriActvnOfBeamLoRi: interface=ExtrLiBriCmd1  # Activation of Exterior Light Source | Request the brightness of a light actuator. The percentage value (independent of light actuator type and environment e.g. voltage of electrical system) depends on the functionality that the light source shall be switched on for (e.g. low beam used for daytime running light, or replacement of a defect lamp). | 100 percent means full power of the light actuator.
    ExtrLiBriActvnOfBrkLiLe: interface=ExtrLiBriCmd1  # Activation of Exterior Light Source | Request the brightness of a light actuator. The percentage value (independent of light actuator type and environment e.g. voltage of electrical system) depends on the functionality that the light source shall be switched on for (e.g. low beam used for daytime running light, or replacement of a defect lamp). | 100 percent means full power of the light actuator.
    ExtrLiBriActvnOfBrkLiRi: interface=ExtrLiBriCmd1  # Activation of Exterior Light Source | Request the brightness of a light actuator. The percentage value (independent of light actuator type and environment e.g. voltage of electrical system) depends on the functionality that the light source shall be switched on for (e.g. low beam used for daytime running light, or replacement of a defect lamp). | 100 percent means full power of the light actuator.
    ExtrLiBriActvnOfBrkLiTrlrLe: interface=ExtrLiBriCmd1  # Activation of Exterior Light Source | Request the brightness of a light actuator. The percentage value (independent of light actuator type and environment e.g. voltage of electrical system) depends on the functionality that the light source shall be switched on for (e.g. low beam used for daytime running light, or replacement of a defect lamp). | 100 percent means full power of the light actuator.
    ExtrLiBriActvnOfBrkLiTrlrRi: interface=ExtrLiBriCmd1  # Activation of Exterior Light Source | Request the brightness of a light actuator. The percentage value (independent of light actuator type and environment e.g. voltage of electrical system) depends on the functionality that the light source shall be switched on for (e.g. low beam used for daytime running light, or replacement of a defect lamp). | 100 percent means full power of the light actuator.
    ExtrLiBriActvnOfCornrMkrCenLe: interface=ExtrLiBriCmd1  # Activation of Exterior Light Source | Request the brightness of a light actuator. The percentage value (independent of light actuator type and environment e.g. voltage of electrical system) depends on the functionality that the light source shall be switched on for (e.g. low beam used for daytime running light, or replacement of a defect lamp). | 100 percent means full power of the light actuator.
    ExtrLiBriActvnOfCornrMkrCenRi: interface=ExtrLiBriCmd1  # Activation of Exterior Light Source | Request the brightness of a light actuator. The percentage value (independent of light actuator type and environment e.g. voltage of electrical system) depends on the functionality that the light source shall be switched on for (e.g. low beam used for daytime running light, or replacement of a defect lamp). | 100 percent means full power of the light actuator.
    ExtrLiBriActvnOfCornrMkrFrntLe: interface=ExtrLiBriCmd1  # Activation of Exterior Light Source | Request the brightness of a light actuator. The percentage value (independent of light actuator type and environment e.g. voltage of electrical system) depends on the functionality that the light source shall be switched on for (e.g. low beam used for daytime running light, or replacement of a defect lamp). | 100 percent means full power of the light actuator.
    ExtrLiBriActvnOfCornrMkrFrntRi: interface=ExtrLiBriCmd1  # Activation of Exterior Light Source | Request the brightness of a light actuator. The percentage value (independent of light actuator type and environment e.g. voltage of electrical system) depends on the functionality that the light source shall be switched on for (e.g. low beam used for daytime running light, or replacement of a defect lamp). | 100 percent means full power of the light actuator.
    ExtrLiBriActvnOfCornrMkrReLe: interface=ExtrLiBriCmd1  # Activation of Exterior Light Source | Request the brightness of a light actuator. The percentage value (independent of light actuator type and environment e.g. voltage of electrical system) depends on the functionality that the light source shall be switched on for (e.g. low beam used for daytime running light, or replacement of a defect lamp). | 100 percent means full power of the light actuator.
    ExtrLiBriActvnOfCornrMkrReRi: interface=ExtrLiBriCmd1  # Activation of Exterior Light Source | Request the brightness of a light actuator. The percentage value (independent of light actuator type and environment e.g. voltage of electrical system) depends on the functionality that the light source shall be switched on for (e.g. low beam used for daytime running light, or replacement of a defect lamp). | 100 percent means full power of the light actuator.
    ExtrLiBriActvnOfFogLiFrntLe: interface=ExtrLiBriCmd1  # Activation of Exterior Light Source | Request the brightness of a light actuator. The percentage value (independent of light actuator type and environment e.g. voltage of electrical system) depends on the functionality that the light source shall be switched on for (e.g. low beam used for daytime running light, or replacement of a defect lamp). | 100 percent means full power of the light actuator.
    ExtrLiBriActvnOfFogLiFrntRi: interface=ExtrLiBriCmd1  # Activation of Exterior Light Source | Request the brightness of a light actuator. The percentage value (independent of light actuator type and environment e.g. voltage of electrical system) depends on the functionality that the light source shall be switched on for (e.g. low beam used for daytime running light, or replacement of a defect lamp). | 100 percent means full power of the light actuator.
    ExtrLiBriActvnOfFogLiReLe: interface=ExtrLiBriCmd1  # Activation of Exterior Light Source | Request the brightness of a light actuator. The percentage value (independent of light actuator type and environment e.g. voltage of electrical system) depends on the functionality that the light source shall be switched on for (e.g. low beam used for daytime running light, or replacement of a defect lamp). | 100 percent means full power of the light actuator.
    ExtrLiBriActvnOfFogLiReRi: interface=ExtrLiBriCmd1  # Activation of Exterior Light Source | Request the brightness of a light actuator. The percentage value (independent of light actuator type and environment e.g. voltage of electrical system) depends on the functionality that the light source shall be switched on for (e.g. low beam used for daytime running light, or replacement of a defect lamp). | 100 percent means full power of the light actuator.
    ExtrLiBriActvnOfFogLiTrlrLe: interface=ExtrLiBriCmd1  # Activation of Exterior Light Source | Request the brightness of a light actuator. The percentage value (independent of light actuator type and environment e.g. voltage of electrical system) depends on the functionality that the light source shall be switched on for (e.g. low beam used for daytime running light, or replacement of a defect lamp). | 100 percent means full power of the light actuator.
    ExtrLiBriActvnOfFogLiTrlrRi: interface=ExtrLiBriCmd1  # Activation of Exterior Light Source | Request the brightness of a light actuator. The percentage value (independent of light actuator type and environment e.g. voltage of electrical system) depends on the functionality that the light source shall be switched on for (e.g. low beam used for daytime running light, or replacement of a defect lamp). | 100 percent means full power of the light actuator.
    ExtrLiBriActvnOfIndcrFrntLe: interface=ExtrLiBriCmd1  # Activation of Exterior Light Source | Request the brightness of a light actuator. The percentage value (independent of light actuator type and environment e.g. voltage of electrical system) depends on the functionality that the light source shall be switched on for (e.g. low beam used for daytime running light, or replacement of a defect lamp). | 100 percent means full power of the light actuator.
    ExtrLiBriActvnOfIndcrFrntRi: interface=ExtrLiBriCmd1  # Activation of Exterior Light Source | Request the brightness of a light actuator. The percentage value (independent of light actuator type and environment e.g. voltage of electrical system) depends on the functionality that the light source shall be switched on for (e.g. low beam used for daytime running light, or replacement of a defect lamp). | 100 percent means full power of the light actuator.
    ExtrLiBriActvnOfIndcrReLe: interface=ExtrLiBriCmd1  # Activation of Exterior Light Source | Request the brightness of a light actuator. The percentage value (independent of light actuator type and environment e.g. voltage of electrical system) depends on the functionality that the light source shall be switched on for (e.g. low beam used for daytime running light, or replacement of a defect lamp). | 100 percent means full power of the light actuator.
    ExtrLiBriActvnOfIndcrReRi: interface=ExtrLiBriCmd1  # Activation of Exterior Light Source | Request the brightness of a light actuator. The percentage value (independent of light actuator type and environment e.g. voltage of electrical system) depends on the functionality that the light source shall be switched on for (e.g. low beam used for daytime running light, or replacement of a defect lamp). | 100 percent means full power of the light actuator.
    ExtrLiBriActvnOfIndcrSideLe: interface=ExtrLiBriCmd1  # Activation of Exterior Light Source | Request the brightness of a light actuator. The percentage value (independent of light actuator type and environment e.g. voltage of electrical system) depends on the functionality that the light source shall be switched on for (e.g. low beam used for daytime running light, or replacement of a defect lamp). | 100 percent means full power of the light actuator.
    ExtrLiBriActvnOfIndcrSideRi: interface=ExtrLiBriCmd1  # Activation of Exterior Light Source | Request the brightness of a light actuator. The percentage value (independent of light actuator type and environment e.g. voltage of electrical system) depends on the functionality that the light source shall be switched on for (e.g. low beam used for daytime running light, or replacement of a defect lamp). | 100 percent means full power of the light actuator.
    ExtrLiBriActvnOfIndcrTrlrLe: interface=ExtrLiBriCmd1  # Activation of Exterior Light Source | Request the brightness of a light actuator. The percentage value (independent of light actuator type and environment e.g. voltage of electrical system) depends on the functionality that the light source shall be switched on for (e.g. low beam used for daytime running light, or replacement of a defect lamp). | 100 percent means full power of the light actuator.
    ExtrLiBriActvnOfIndcrTrlrRi: interface=ExtrLiBriCmd1  # Activation of Exterior Light Source | Request the brightness of a light actuator. The percentage value (independent of light actuator type and environment e.g. voltage of electrical system) depends on the functionality that the light source shall be switched on for (e.g. low beam used for daytime running light, or replacement of a defect lamp). | 100 percent means full power of the light actuator.
    ExtrLiBriActvnOfLampForStopOfBrkLiCenHiMntd: interface=ExtrLiBriCmd1  # Activation of Exterior Light Source | Request the brightness of a light actuator. The percentage value (independent of light actuator type and environment e.g. voltage of electrical system) depends on the functionality that the light source shall be switched on for (e.g. low beam used for daytime running light, or replacement of a defect lamp). | 100 percent means full power of the light actuator.
    ExtrLiBriActvnOfLiDaytiRunngFrntLe: interface=ExtrLiBriCmd1  # Activation of Exterior Light Source | Request the brightness of a light actuator. The percentage value (independent of light actuator type and environment e.g. voltage of electrical system) depends on the functionality that the light source shall be switched on for (e.g. low beam used for daytime running light, or replacement of a defect lamp). | 100 percent means full power of the light actuator.
    ExtrLiBriActvnOfLiDaytiRunngFrntRi: interface=ExtrLiBriCmd1  # Activation of Exterior Light Source | Request the brightness of a light actuator. The percentage value (independent of light actuator type and environment e.g. voltage of electrical system) depends on the functionality that the light source shall be switched on for (e.g. low beam used for daytime running light, or replacement of a defect lamp). | 100 percent means full power of the light actuator.
    ExtrLiBriActvnOfLiLeForRvsg: interface=ExtrLiBriCmd1  # Activation of Exterior Light Source | Request the brightness of a light actuator. The percentage value (independent of light actuator type and environment e.g. voltage of electrical system) depends on the functionality that the light source shall be switched on for (e.g. low beam used for daytime running light, or replacement of a defect lamp). | 100 percent means full power of the light actuator.
    ExtrLiBriActvnOfLiRiForRvsg: interface=ExtrLiBriCmd1  # Activation of Exterior Light Source | Request the brightness of a light actuator. The percentage value (independent of light actuator type and environment e.g. voltage of electrical system) depends on the functionality that the light source shall be switched on for (e.g. low beam used for daytime running light, or replacement of a defect lamp). | 100 percent means full power of the light actuator.
    ExtrLiBriActvnOfLiTrlrPlateNr: interface=ExtrLiBriCmd1  # Activation of Exterior Light Source | Request the brightness of a light actuator. The percentage value (independent of light actuator type and environment e.g. voltage of electrical system) depends on the functionality that the light source shall be switched on for (e.g. low beam used for daytime running light, or replacement of a defect lamp). | 100 percent means full power of the light actuator.
    ExtrLiBriActvnOfLiVehPlateNr: interface=ExtrLiBriCmd1  # Activation of Exterior Light Source | Request the brightness of a light actuator. The percentage value (independent of light actuator type and environment e.g. voltage of electrical system) depends on the functionality that the light source shall be switched on for (e.g. low beam used for daytime running light, or replacement of a defect lamp). | 100 percent means full power of the light actuator.
    ExtrLiBriActvnOfPrkgLiFrntLe: interface=ExtrLiBriCmd1  # Activation of Exterior Light Source | Request the brightness of a light actuator. The percentage value (independent of light actuator type and environment e.g. voltage of electrical system) depends on the functionality that the light source shall be switched on for (e.g. low beam used for daytime running light, or replacement of a defect lamp). | 100 percent means full power of the light actuator.
    ExtrLiBriActvnOfPrkgLiFrntRi: interface=ExtrLiBriCmd1  # Activation of Exterior Light Source | Request the brightness of a light actuator. The percentage value (independent of light actuator type and environment e.g. voltage of electrical system) depends on the functionality that the light source shall be switched on for (e.g. low beam used for daytime running light, or replacement of a defect lamp). | 100 percent means full power of the light actuator.
    ExtrLiBriActvnOfPrkgLiReLe: interface=ExtrLiBriCmd1  # Activation of Exterior Light Source | Request the brightness of a light actuator. The percentage value (independent of light actuator type and environment e.g. voltage of electrical system) depends on the functionality that the light source shall be switched on for (e.g. low beam used for daytime running light, or replacement of a defect lamp). | 100 percent means full power of the light actuator.
    ExtrLiBriActvnOfPrkgLiReRi: interface=ExtrLiBriCmd1  # Activation of Exterior Light Source | Request the brightness of a light actuator. The percentage value (independent of light actuator type and environment e.g. voltage of electrical system) depends on the functionality that the light source shall be switched on for (e.g. low beam used for daytime running light, or replacement of a defect lamp). | 100 percent means full power of the light actuator.
    ExtrLiBriActvnOfPrkgLiTrlrLe: interface=ExtrLiBriCmd1  # Activation of Exterior Light Source | Request the brightness of a light actuator. The percentage value (independent of light actuator type and environment e.g. voltage of electrical system) depends on the functionality that the light source shall be switched on for (e.g. low beam used for daytime running light, or replacement of a defect lamp). | 100 percent means full power of the light actuator.
    ExtrLiBriActvnOfPrkgLiTrlrRi: interface=ExtrLiBriCmd1  # Activation of Exterior Light Source | Request the brightness of a light actuator. The percentage value (independent of light actuator type and environment e.g. voltage of electrical system) depends on the functionality that the light source shall be switched on for (e.g. low beam used for daytime running light, or replacement of a defect lamp). | 100 percent means full power of the light actuator.
    ExtrLiBriActvnOfPuddleLiFrntLe: interface=ExtrLiBriCmd1  # Activation of Exterior Light Source | Request the brightness of a light actuator. The percentage value (independent of light actuator type and environment e.g. voltage of electrical system) depends on the functionality that the light source shall be switched on for (e.g. low beam used for daytime running light, or replacement of a defect lamp). | 100 percent means full power of the light actuator.
    ExtrLiBriActvnOfPuddleLiFrntRi: interface=ExtrLiBriCmd1  # Activation of Exterior Light Source | Request the brightness of a light actuator. The percentage value (independent of light actuator type and environment e.g. voltage of electrical system) depends on the functionality that the light source shall be switched on for (e.g. low beam used for daytime running light, or replacement of a defect lamp). | 100 percent means full power of the light actuator.
    ExtrLiBriActvnOfPuddleLiReLe: interface=ExtrLiBriCmd1  # Activation of Exterior Light Source | Request the brightness of a light actuator. The percentage value (independent of light actuator type and environment e.g. voltage of electrical system) depends on the functionality that the light source shall be switched on for (e.g. low beam used for daytime running light, or replacement of a defect lamp). | 100 percent means full power of the light actuator.
    ExtrLiBriActvnOfPuddleLiReRi: interface=ExtrLiBriCmd1  # Activation of Exterior Light Source | Request the brightness of a light actuator. The percentage value (independent of light actuator type and environment e.g. voltage of electrical system) depends on the functionality that the light source shall be switched on for (e.g. low beam used for daytime running light, or replacement of a defect lamp). | 100 percent means full power of the light actuator.
    ExtrLiBriActvnOfSideMkrCenLe: interface=ExtrLiBriCmd1  # Activation of Exterior Light Source | Request the brightness of a light actuator. The percentage value (independent of light actuator type and environment e.g. voltage of electrical system) depends on the functionality that the light source shall be switched on for (e.g. low beam used for daytime running light, or replacement of a defect lamp). | 100 percent means full power of the light actuator.
    ExtrLiBriActvnOfSideMkrCenRi: interface=ExtrLiBriCmd1  # Activation of Exterior Light Source | Request the brightness of a light actuator. The percentage value (independent of light actuator type and environment e.g. voltage of electrical system) depends on the functionality that the light source shall be switched on for (e.g. low beam used for daytime running light, or replacement of a defect lamp). | 100 percent means full power of the light actuator.
    ExtrLiBriActvnOfSideMkrFrntLe: interface=ExtrLiBriCmd1  # Activation of Exterior Light Source | Request the brightness of a light actuator. The percentage value (independent of light actuator type and environment e.g. voltage of electrical system) depends on the functionality that the light source shall be switched on for (e.g. low beam used for daytime running light, or replacement of a defect lamp). | 100 percent means full power of the light actuator.
    ExtrLiBriActvnOfSideMkrFrntRi: interface=ExtrLiBriCmd1  # Activation of Exterior Light Source | Request the brightness of a light actuator. The percentage value (independent of light actuator type and environment e.g. voltage of electrical system) depends on the functionality that the light source shall be switched on for (e.g. low beam used for daytime running light, or replacement of a defect lamp). | 100 percent means full power of the light actuator.
    ExtrLiBriActvnOfSideMkrReLe: interface=ExtrLiBriCmd1  # Activation of Exterior Light Source | Request the brightness of a light actuator. The percentage value (independent of light actuator type and environment e.g. voltage of electrical system) depends on the functionality that the light source shall be switched on for (e.g. low beam used for daytime running light, or replacement of a defect lamp). | 100 percent means full power of the light actuator.
    ExtrLiBriActvnOfSideMkrReRi: interface=ExtrLiBriCmd1  # Activation of Exterior Light Source | Request the brightness of a light actuator. The percentage value (independent of light actuator type and environment e.g. voltage of electrical system) depends on the functionality that the light source shall be switched on for (e.g. low beam used for daytime running light, or replacement of a defect lamp). | 100 percent means full power of the light actuator.
    ExtrLiBriActvnOfTrlrLiLeForRvsg: interface=ExtrLiBriCmd1  # Activation of Exterior Light Source | Request the brightness of a light actuator. The percentage value (independent of light actuator type and environment e.g. voltage of electrical system) depends on the functionality that the light source shall be switched on for (e.g. low beam used for daytime running light, or replacement of a defect lamp). | 100 percent means full power of the light actuator.
    ExtrLiBriActvnOfTrlrLiRiForRvsg: interface=ExtrLiBriCmd1  # Activation of Exterior Light Source | Request the brightness of a light actuator. The percentage value (independent of light actuator type and environment e.g. voltage of electrical system) depends on the functionality that the light source shall be switched on for (e.g. low beam used for daytime running light, or replacement of a defect lamp). | 100 percent means full power of the light actuator.
    FanSt: interface=FanSt1  # Fan State | Activation state of climatisation or ventilation
    FbAlrmAcoust: interface=AlrmAcoustCmd1  # Acoustical Feedback Alarm | Acoustical Feedback from the alarm device
    FbPanicAlrmAcoust: interface=PanicAlrmAcoustCmd1  # Acoustical Feedback Panic Alarm | Acoustical Feedback from the panic alarm device
    FbPanicAlrmVis: interface=PanicAlrmVisCmd1  # Visual Feedback Panic Alarm | Visual Feedback from the panic alarm device
    FlashBeam: interface=LiExtCmd1  # Flash Beam | This port provides Flash beam command
    FlashBeamIndcn: interface=ExtrLiDisp1  # Flash Beam Indication | This port provides Indication to the instrument cluster about the Flash beam on/off status
    FlashBeamOut: interface=LiExtCmd1  # Flash Beam Output | This port provides Flash beam command
    FltOfSeatClima: interface=FltStOfSeatClima1  # Seat Climatisation Fault From Actuator
    FobId: interface=Authn1  # Fob Identifier | Identifier of the Fob, for validation by Immobilizer.
    FobIdReq: interface=Authn1  # Fob Identifier Request | Request for Fob identifier from Immobilizer.
    FogFrnt: interface=LiExtCmd1  # Front Fog Light | This port provides command to turn on/off front fog lights
    FogFrntOut: interface=LiExtCmd1  # Front Fog Light Output | This port provides command to turn on/off front fog lights
    FogIndcnFrnt: interface=ExtrLiDisp1  # Front Fog Light Indication | This port provides Indication to the instrument cluster about the Front fog lights on/off status
    FogIndcnRe: interface=ExtrLiDisp1  # Rear Fog Light Indication | This port provides Indication to the instrument cluster about the Rear fog lights on/off status
    FogRe: interface=LiExtCmd1  # Rear Fog Light | This port provides command to turn on/off rear fog lights
    FogReOut: interface=LiExtCmd1  # Rear Fog Light Output | This port provides command to turn on/off rear fog lights
    FricCoeffEstimd: interface=FricCoeffEstimd1  # Friction Coefficient Estimated | Estimated used road friction coefficient.
    FricCoeffEstimd1: interface=FricCoeff1  # Friction Coefficient Estimated | Estimated used road friction coefficient.
    GbxCtrsftActv: interface=TrsmFlgCtrsftActv1  # Gearbox: Countershaft Active | Indicates whether the gear is in low range mode, e.g. for sport utility vehicles (SUV) or Offroad-vehicles with countershaft gearboxes (high range / low range). - 0: countershaft inactive (standard condition) - 1: countershaft active
    GearParkEngd: interface=TrsmFlgParkLockEngd1  # Gear Park Engaged | Status of gearbox on engaged parking lock (P-drive) of the Automatic Transmission (AT). 0 : not engaged 1 : engaged
    GearParkReq: interface=GearParkReq1  # Gear Park Request | Parking lock request from Stand Still Manager to automatic transmission to set parking position.
    GearRatAct: interface=TrsmRatGearAct1  # Gear Ratio Actual | Actual gear ratio The gear ratio being currently engaged in the gear box.
    GearShiftDwnReqFromDrvr: interface=GearShiftDwnReqFromDrvr1  # Gear shift down request by driver
    GearShiftPrevnCmftReqByAcc: interface=GearShiftPrevn1  # Gear Shift Prevention Comfort Request by ACC | Avoid change of gear for comfort reasons requested by Adaptive Cruise Control (ACC) to be arbitrated by Vehicle Longitudinal Control (VLC).
    GearShiftPrevnCmftReqByVlc: interface=GearShiftPrevn1  # Gear Shift Prevention Comfort Request by Vehicle Longitudinal Control (VLC) | Request to avoid change of gear for comfort reasons: Request to avoid shifting request includes aspects from traffic point of view. Final decision remains in the actuator control. Acceleration request tolerance band has higher priority than the gear shift prevention comfort. | This request should be sent synchronously with maximum and minimum torque request.
    GearShiftPrevnStaby: interface=GearShiftPrevn1  # Gear Shift Prevention Stability | Command to avoid change of gear for stability reasons.
    GearShiftUpReqFromDrvr: interface=GearShiftUpReqFromDrvr1  # Gear shift up request by driver
    GlvBoxHmi: interface=TogReq1  # Glove Box HMI | User request to lock / unlock the glovebox
    GlvBoxLockSt: interface=LockSt1  # Glove Box Lock State | Locking state of the glove box
    GlvBoxLockgCmd: interface=LockCmd1  # Glove Box Locking Command | Command to lock the glove box
    GlvBoxLtchRels: interface=DiagcLtchRels1  # Glove Box Latch Release | Diagnostic request to the sensor component to release/unlock the latch of the glovebox
    GlvBoxLtchRelsTog: interface=DiagcTog1  # Glove Box Latch Release Toggle | Diagnostic request to the sensor component to request a "Toggle-Function" of the latch of the glovebox
    GlvBoxSt: interface=OpendClsdSt1  # Glove Box State | Information related to the glove box, it indicates whether the glove box is opened or closed
    HdlampLvlgMan: interface=LvlgReq1  # Headlamp Manual Leveling | Port to request the position of a headlamp leveling actuator. 100% means most upward position (of the headlamps). 0% means most downward position (e.g. low beam adjusted maximum down to the road).
    HdlampLvlgRef: interface=LvlgCmd1  # Headlamp Leveling Command | This port commands the position of a headlamp leveling actuator.
    HdlampWshngFromHmi: interface=WshngReq1  # Head Lamp Washing from HMI | Carries a user request to activate the washing of headlamps. This demand is provided by the Human Machine Interface (HMI) of the vehicle
    HeatFltOfDrvrSeat: interface=FltStOfSeatClima1  # Heating Fault from Actuator | Seat Heating Fault From Actuator
    HeatFltOfPassSeat: interface=FltStOfSeatClima1  # Heating Fault from Actuator | Seat Heating Fault From Actuator
    HeatFltOfSeatReLe: interface=FltStOfSeatClima1  # Heating Fault from Actuator | Seat Heating Fault From Actuator
    HeatFltOfSeatReRi: interface=FltStOfSeatClima1  # Heating Fault from Actuator | Seat Heating Fault From Actuator
    HeatSeatFlt: interface=FltStOfSeatClima1  # Heating Seat Fault from Actuator | Seat Heating Fault From Actuator
    HeatgCmdToActrOfSeatHeatg: interface=SeatClimaCmd1  # Heating Command to Actuator of Seat Heating | Heating command To Actuator Of a Seat
    HldOnDmdSt: interface=HldOnDmdSt1  # Hold on Demand Status | Failure status of the Hold On Demand function
    HldOnDmdSts: interface=HldOnDmdSts1  # Hold on Demand Status | Failure status of the Hold On Demand function
    HndbrkSwt: interface=HndbrkSwt1  # Handbrake Switch | Indication that the handbrake switch is applied.
    HndlgBalCoeff: interface=HndlgBalCoeff1  # Handling Balance Coefficient | Estimated full active suspension handling balance coefficient defined as deviation from defined understeering characteristics. Ranging from maximum applicable understeering to maximum applicable oversteering
    HomeCmngAndHomeLvngOut: interface=LiExtCmd1  # Coming Home Leaving Home Output | This port provides command to activate coming home/leaving home lights
    HomeCmngAndHomeLvngReq: interface=HomeCmngAndHomeLvngReq1  # Coming Home Leaving Home | Request to start coming home/leaving home.
    HoopRollCmd: interface=HoopRollCmd1  # Roll Hoop Command | Command for roll hoop
    HoopRollSt: interface=HoopRollSt1  # Roll Hoop Status | Status of roll hoop actuator
    HoopRollSts: interface=HoopRollSts1  # Roll Hoop Status | Status of roll hoop actuator
    HornActvn: interface=HornCmd1  # Horn Activation Command | Command to activate or deactivate the horn actuator
    HornDispDfct: interface=DispDfct1  # Horn Defect Display | Information on defect related to the horn control
    HornReqFromHmi: interface=HornReq1  # Horn Request from HMI | Request for horn. This request comes from the HMI
    HornSt: interface=HornSt1  # Horn Status | Fault state of the horn actuator
    HornSts: interface=HornSts1  # Horn Status | Fault state of the horn actuator
    HtlMod: interface=HtlModReq1  # Hotel Mode | Request to activate or deactivate the hotel mode. Hotel mode is a subset of the customer mode, example: minimum access to the vehicle without any access to the glovebox.
    HtlModSt: interface=HtlModSt1  # Hotel Mode Status | Information of the activation/deactivation of the hotel mode
    HtlModSts: interface=HtlModSts1  # Hotel Mode Status | Information of the activation/deactivation of the hotel mode
    HvacDefrstReqFrnt: interface=LvlDefrstReq1  # Front Defrost Request from Hvac | Port for Front Defrost Request From Hvac
    HvacDefrstReqRe: interface=LvlDefrstReq1  # Rear Defrost Request from Hvac | Port for Rear Defrost Request From Hvac
    HvacDefrstStFrnt: interface=LvlDefrstSt1  # Front Defrost Status to Hvac | Port for Front Defrost Status To Hvac
    HvacDefrstStRe: interface=LvlDefrstSt1  # Rear Defrost Status to Hvac | Port for Rear Defrost Status To Hvac
    HvacDefrstStsFrnt: interface=LvlDefrstSts1  # Front Defrost Status to Hvac | Port for Front Defrost Status To Hvac
    HvacDefrstStsRe: interface=LvlDefrstSts1  # Rear Defrost Status to Hvac | Port for Rear Defrost Status To Hvac
    HvacTq: interface=HvacTq1  # Mechanical Torque for A/C Compressor | Mechanical torque for Air Conditioning (A/C) compressor. This value must take into account all relevant dynamic effects, e.g. transient torque increase during activation of the Air Conditioning (A/C) compressor. It is converted to engine crankshaft torque by the provider. | Default value after reset is zero.
    HvacTqReq: interface=HvacTqReq1  # Requested Mechanical Torque for A/C Compressor | Requested mechanical torque for Air Conditioning (A/C) compressor. This value represents the torque consumption in a predicted future state. It is converted to engine crankshaft torque by the provider. Examples of realization: Before activation of the Air Conditioning (A/C) compressor this interface could contain either - the predicted highest torque consumption during the activation process. - the predicted torque consumption in steady state after the activation is finished. | Default value after reset is zero.
    HzrdWarn: interface=ExtrLiDisp1  # Hazard Warning | This port provides Indication to Instrument cluster and other body functionalities of Hazard lamps activation status. Use case: illumination of hazard switch is often used for functional indication too (see Internal Lights)
    ImobAlrmReq: interface=AlrmAcoustCmd1  # Immobilizer Alarm Request | Request to activate/deactivate the acoustic indication
    ImobSt: interface=ImobSt1  # Immobilizer Status | Status of the Immobilizer
    ImobSts: interface=ImobSts1  # Immobilizer Status | Status of the Immobilizer
    ImobnWirels: interface=ImobnWirelsReq1  # Immobilization Request from Wireless | Signal to immobilize the vehicle from a wireless terminal
    ImpctLocnEstimdOfCrashAtFrnt: interface=LocnOfImpctAtCrash1  # Impact Location Estimated of Crash at Front | Estimated impact locations of frontal crash
    ImpctLocnEstimdOfCrashAtLe: interface=LocnOfImpctAtCrash1  # Impact Location Estimated of Crash at Left | Estimated impact locations of left side crash
    ImpctLocnEstimdOfCrashAtRe: interface=LocnOfImpctAtCrash1  # Impact Location Estimated of Crash at Rear | Estimated impact locations of rear crash
    ImpctLocnEstimdOfCrashAtRi: interface=LocnOfImpctAtCrash1  # Impact Location Estimated of Crash at Right | Estimated impact locations of right side crash
    IndcrDisp: interface=IndcrDisp1  # Indicator Display | This port provides Indication to Instrument cluster of Left/Right turn indicator activation status.
    IndcrOut: interface=IndcrTurnCmd1  # Indicator Output | This port provides request to Turn on or off the turn indicators
    IndcrPat: interface=IndcrPatCmd1  # Indicator Pattern | This port provides request to Set a pattern for flashing sequence
    IntrLiBriActvn: interface=BriCmd1  # Interior Light Brightness Activation | The brightness of a light source is requested by a percentage value (independent of light actuator type and environment e.g. voltage of electrical system). It depends on the functionality when the light source shall be switched on. | 100 percent means full power of the light actuator
    IntrLiBriActvnOfAshtrayLiFrntCen: interface=BriCmd1  # Activation of Interior Light Source Brightness | The brightness of a interior light source is requested by the interior light manager. The percentage value (independent of light actuator type and environment e.g. voltage of electrical system) depends on the functionality that the light source shall be switched on. 100 percent means full power of the light actuator
    IntrLiBriActvnOfAshtrayLiFrntLe: interface=BriCmd1  # Activation of Interior Light Source Brightness | The brightness of a interior light source is requested by the interior light manager. The percentage value (independent of light actuator type and environment e.g. voltage of electrical system) depends on the functionality that the light source shall be switched on. 100 percent means full power of the light actuator
    IntrLiBriActvnOfAshtrayLiFrntRi: interface=BriCmd1  # Activation of Interior Light Source Brightness | The brightness of a interior light source is requested by the interior light manager. The percentage value (independent of light actuator type and environment e.g. voltage of electrical system) depends on the functionality that the light source shall be switched on. 100 percent means full power of the light actuator
    IntrLiBriActvnOfAshtrayLiGroup: interface=BriCmd1  # Activation of Interior Light Source Brightness | The brightness of a interior light source is requested by the interior light manager. The percentage value (independent of light actuator type and environment e.g. voltage of electrical system) depends on the functionality that the light source shall be switched on. 100 percent means full power of the light actuator
    IntrLiBriActvnOfAshtrayLiMidCen: interface=BriCmd1  # Activation of Interior Light Source Brightness | The brightness of a interior light source is requested by the interior light manager. The percentage value (independent of light actuator type and environment e.g. voltage of electrical system) depends on the functionality that the light source shall be switched on. 100 percent means full power of the light actuator
    IntrLiBriActvnOfAshtrayLiMidLe: interface=BriCmd1  # Activation of Interior Light Source Brightness | The brightness of a interior light source is requested by the interior light manager. The percentage value (independent of light actuator type and environment e.g. voltage of electrical system) depends on the functionality that the light source shall be switched on. 100 percent means full power of the light actuator
    IntrLiBriActvnOfAshtrayLiMidRi: interface=BriCmd1  # Activation of Interior Light Source Brightness | The brightness of a interior light source is requested by the interior light manager. The percentage value (independent of light actuator type and environment e.g. voltage of electrical system) depends on the functionality that the light source shall be switched on. 100 percent means full power of the light actuator
    IntrLiBriActvnOfAshtrayLiReCen: interface=BriCmd1  # Activation of Interior Light Source Brightness | The brightness of a interior light source is requested by the interior light manager. The percentage value (independent of light actuator type and environment e.g. voltage of electrical system) depends on the functionality that the light source shall be switched on. 100 percent means full power of the light actuator
    IntrLiBriActvnOfAshtrayLiReLe: interface=BriCmd1  # Activation of Interior Light Source Brightness | The brightness of a interior light source is requested by the interior light manager. The percentage value (independent of light actuator type and environment e.g. voltage of electrical system) depends on the functionality that the light source shall be switched on. 100 percent means full power of the light actuator
    IntrLiBriActvnOfAshtrayLiReRi: interface=BriCmd1  # Activation of Interior Light Source Brightness | The brightness of a interior light source is requested by the interior light manager. The percentage value (independent of light actuator type and environment e.g. voltage of electrical system) depends on the functionality that the light source shall be switched on. 100 percent means full power of the light actuator
    IntrLiBriActvnOfCbnLiFrntCen: interface=BriCmd1  # Activation of Interior Light Source Brightness | The brightness of a interior light source is requested by the interior light manager. The percentage value (independent of light actuator type and environment e.g. voltage of electrical system) depends on the functionality that the light source shall be switched on. 100 percent means full power of the light actuator
    IntrLiBriActvnOfCbnLiFrntLe: interface=BriCmd1  # Activation of Interior Light Source Brightness | The brightness of a interior light source is requested by the interior light manager. The percentage value (independent of light actuator type and environment e.g. voltage of electrical system) depends on the functionality that the light source shall be switched on. 100 percent means full power of the light actuator
    IntrLiBriActvnOfCbnLiFrntRi: interface=BriCmd1  # Activation of Interior Light Source Brightness | The brightness of a interior light source is requested by the interior light manager. The percentage value (independent of light actuator type and environment e.g. voltage of electrical system) depends on the functionality that the light source shall be switched on. 100 percent means full power of the light actuator
    IntrLiBriActvnOfCbnLiGroup: interface=BriCmd1  # Activation of Interior Light Source Brightness | The brightness of a interior light source is requested by the interior light manager. The percentage value (independent of light actuator type and environment e.g. voltage of electrical system) depends on the functionality that the light source shall be switched on. 100 percent means full power of the light actuator
    IntrLiBriActvnOfCbnLiMidCen: interface=BriCmd1  # Activation of Interior Light Source Brightness | The brightness of a interior light source is requested by the interior light manager. The percentage value (independent of light actuator type and environment e.g. voltage of electrical system) depends on the functionality that the light source shall be switched on. 100 percent means full power of the light actuator
    IntrLiBriActvnOfCbnLiMidLe: interface=BriCmd1  # Activation of Interior Light Source Brightness | The brightness of a interior light source is requested by the interior light manager. The percentage value (independent of light actuator type and environment e.g. voltage of electrical system) depends on the functionality that the light source shall be switched on. 100 percent means full power of the light actuator
    IntrLiBriActvnOfCbnLiMidRi: interface=BriCmd1  # Activation of Interior Light Source Brightness | The brightness of a interior light source is requested by the interior light manager. The percentage value (independent of light actuator type and environment e.g. voltage of electrical system) depends on the functionality that the light source shall be switched on. 100 percent means full power of the light actuator
    IntrLiBriActvnOfCbnLiReCen: interface=BriCmd1  # Activation of Interior Light Source Brightness | The brightness of a interior light source is requested by the interior light manager. The percentage value (independent of light actuator type and environment e.g. voltage of electrical system) depends on the functionality that the light source shall be switched on. 100 percent means full power of the light actuator
    IntrLiBriActvnOfCbnLiReLe: interface=BriCmd1  # Activation of Interior Light Source Brightness | The brightness of a interior light source is requested by the interior light manager. The percentage value (independent of light actuator type and environment e.g. voltage of electrical system) depends on the functionality that the light source shall be switched on. 100 percent means full power of the light actuator
    IntrLiBriActvnOfCbnLiReRi: interface=BriCmd1  # Activation of Interior Light Source Brightness | The brightness of a interior light source is requested by the interior light manager. The percentage value (independent of light actuator type and environment e.g. voltage of electrical system) depends on the functionality that the light source shall be switched on. 100 percent means full power of the light actuator
    IntrLiBriActvnOfCurbLiFrntLe: interface=BriCmd1  # Activation of Interior Light Source Brightness | The brightness of a interior light source is requested by the interior light manager. The percentage value (independent of light actuator type and environment e.g. voltage of electrical system) depends on the functionality that the light source shall be switched on. 100 percent means full power of the light actuator
    IntrLiBriActvnOfCurbLiFrntRi: interface=BriCmd1  # Activation of Interior Light Source Brightness | The brightness of a interior light source is requested by the interior light manager. The percentage value (independent of light actuator type and environment e.g. voltage of electrical system) depends on the functionality that the light source shall be switched on. 100 percent means full power of the light actuator
    IntrLiBriActvnOfCurbLiGroup: interface=BriCmd1  # Activation of Interior Light Source Brightness | The brightness of a interior light source is requested by the interior light manager. The percentage value (independent of light actuator type and environment e.g. voltage of electrical system) depends on the functionality that the light source shall be switched on. 100 percent means full power of the light actuator
    IntrLiBriActvnOfCurbLiMidLe: interface=BriCmd1  # Activation of Interior Light Source Brightness | The brightness of a interior light source is requested by the interior light manager. The percentage value (independent of light actuator type and environment e.g. voltage of electrical system) depends on the functionality that the light source shall be switched on. 100 percent means full power of the light actuator
    IntrLiBriActvnOfCurbLiMidRi: interface=BriCmd1  # Activation of Interior Light Source Brightness | The brightness of a interior light source is requested by the interior light manager. The percentage value (independent of light actuator type and environment e.g. voltage of electrical system) depends on the functionality that the light source shall be switched on. 100 percent means full power of the light actuator
    IntrLiBriActvnOfCurbLiReLe: interface=BriCmd1  # Activation of Interior Light Source Brightness | The brightness of a interior light source is requested by the interior light manager. The percentage value (independent of light actuator type and environment e.g. voltage of electrical system) depends on the functionality that the light source shall be switched on. 100 percent means full power of the light actuator
    IntrLiBriActvnOfCurbLiReRi: interface=BriCmd1  # Activation of Interior Light Source Brightness | The brightness of a interior light source is requested by the interior light manager. The percentage value (independent of light actuator type and environment e.g. voltage of electrical system) depends on the functionality that the light source shall be switched on. 100 percent means full power of the light actuator
    IntrLiBriActvnOfEngCmptmtLi: interface=BriCmd1  # Activation of Interior Light Source Brightness | The brightness of a interior light source is requested by the interior light manager. The percentage value (independent of light actuator type and environment e.g. voltage of electrical system) depends on the functionality that the light source shall be switched on. 100 percent means full power of the light actuator
    IntrLiBriActvnOfExtrLiSwtIllmn: interface=BriCmd1  # Activation of Interior Light Source Brightness | The brightness of a interior light source is requested by the interior light manager. The percentage value (independent of light actuator type and environment e.g. voltage of electrical system) depends on the functionality that the light source shall be switched on. 100 percent means full power of the light actuator
    IntrLiBriActvnOfFootwellGroup: interface=BriCmd1  # Activation of Interior Light Source Brightness | The brightness of a interior light source is requested by the interior light manager. The percentage value (independent of light actuator type and environment e.g. voltage of electrical system) depends on the functionality that the light source shall be switched on. 100 percent means full power of the light actuator
    IntrLiBriActvnOfFootwellLiFrntCen: interface=BriCmd1  # Activation of Interior Light Source Brightness | The brightness of a interior light source is requested by the interior light manager. The percentage value (independent of light actuator type and environment e.g. voltage of electrical system) depends on the functionality that the light source shall be switched on. 100 percent means full power of the light actuator
    IntrLiBriActvnOfFootwellLiFrntLe: interface=BriCmd1  # Activation of Interior Light Source Brightness | The brightness of a interior light source is requested by the interior light manager. The percentage value (independent of light actuator type and environment e.g. voltage of electrical system) depends on the functionality that the light source shall be switched on. 100 percent means full power of the light actuator
    IntrLiBriActvnOfFootwellLiFrntRi: interface=BriCmd1  # Activation of Interior Light Source Brightness | The brightness of a interior light source is requested by the interior light manager. The percentage value (independent of light actuator type and environment e.g. voltage of electrical system) depends on the functionality that the light source shall be switched on. 100 percent means full power of the light actuator
    IntrLiBriActvnOfFootwellLiMidCen: interface=BriCmd1  # Activation of Interior Light Source Brightness | The brightness of a interior light source is requested by the interior light manager. The percentage value (independent of light actuator type and environment e.g. voltage of electrical system) depends on the functionality that the light source shall be switched on. 100 percent means full power of the light actuator
    IntrLiBriActvnOfFootwellLiMidLe: interface=BriCmd1  # Activation of Interior Light Source Brightness | The brightness of a interior light source is requested by the interior light manager. The percentage value (independent of light actuator type and environment e.g. voltage of electrical system) depends on the functionality that the light source shall be switched on. 100 percent means full power of the light actuator
    IntrLiBriActvnOfFootwellLiMidRi: interface=BriCmd1  # Activation of Interior Light Source Brightness | The brightness of a interior light source is requested by the interior light manager. The percentage value (independent of light actuator type and environment e.g. voltage of electrical system) depends on the functionality that the light source shall be switched on. 100 percent means full power of the light actuator
    IntrLiBriActvnOfFootwellLiReCen: interface=BriCmd1  # Activation of Interior Light Source Brightness | The brightness of a interior light source is requested by the interior light manager. The percentage value (independent of light actuator type and environment e.g. voltage of electrical system) depends on the functionality that the light source shall be switched on. 100 percent means full power of the light actuator
    IntrLiBriActvnOfFootwellLiReLe: interface=BriCmd1  # Activation of Interior Light Source Brightness | The brightness of a interior light source is requested by the interior light manager. The percentage value (independent of light actuator type and environment e.g. voltage of electrical system) depends on the functionality that the light source shall be switched on. 100 percent means full power of the light actuator
    IntrLiBriActvnOfFootwellLiReRi: interface=BriCmd1  # Activation of Interior Light Source Brightness | The brightness of a interior light source is requested by the interior light manager. The percentage value (independent of light actuator type and environment e.g. voltage of electrical system) depends on the functionality that the light source shall be switched on. 100 percent means full power of the light actuator
    IntrLiBriActvnOfGlvCmptmtLi: interface=BriCmd1  # Activation of Interior Light Source Brightness | The brightness of a interior light source is requested by the interior light manager. The percentage value (independent of light actuator type and environment e.g. voltage of electrical system) depends on the functionality that the light source shall be switched on. 100 percent means full power of the light actuator
    IntrLiBriActvnOfIgnSwtIllmn: interface=BriCmd1  # Activation of Interior Light Source Brightness | The brightness of a interior light source is requested by the interior light manager. The percentage value (independent of light actuator type and environment e.g. voltage of electrical system) depends on the functionality that the light source shall be switched on. 100 percent means full power of the light actuator
    IntrLiBriActvnOfIntrLiGroup0: interface=BriCmd1  # Activation of Interior Light Source Brightness | The brightness of a interior light source is requested by the interior light manager. The percentage value (independent of light actuator type and environment e.g. voltage of electrical system) depends on the functionality that the light source shall be switched on. 100 percent means full power of the light actuator
    IntrLiBriActvnOfIntrLiGroup1: interface=BriCmd1  # Activation of Interior Light Source Brightness | The brightness of a interior light source is requested by the interior light manager. The percentage value (independent of light actuator type and environment e.g. voltage of electrical system) depends on the functionality that the light source shall be switched on. 100 percent means full power of the light actuator
    IntrLiBriActvnOfIntrLiGroup{10..15}: interface=BriCmd1  # Activation of Interior Light Source Brightness | The brightness of a interior light source is requested by the interior light manager. The percentage value (independent of light actuator type and environment e.g. voltage of electrical system) depends on the functionality that the light source shall be switched on. 100 percent means full power of the light actuator
    IntrLiBriActvnOfIntrLiGroup{2..9}: interface=BriCmd1  # Activation of Interior Light Source Brightness | The brightness of a interior light source is requested by the interior light manager. The percentage value (independent of light actuator type and environment e.g. voltage of electrical system) depends on the functionality that the light source shall be switched on. 100 percent means full power of the light actuator
    IntrLiBriActvnOfLiForCigaretteLighterIllmnAtTrLe: interface=BriCmd1  # Activation of Interior Light Source Brightness | The brightness of a interior light source is requested by the interior light manager. The percentage value (independent of light actuator type and environment e.g. voltage of electrical system) depends on the functionality that the light source shall be switched on. 100 percent means full power of the light actuator
    IntrLiBriActvnOfLiForCigaretteLighterIllmnAtTrRi: interface=BriCmd1  # Activation of Interior Light Source Brightness | The brightness of a interior light source is requested by the interior light manager. The percentage value (independent of light actuator type and environment e.g. voltage of electrical system) depends on the functionality that the light source shall be switched on. 100 percent means full power of the light actuator
    IntrLiBriActvnOfLiForCigaretteLighterIllmnFrntCen: interface=BriCmd1  # Activation of Interior Light Source Brightness | The brightness of a interior light source is requested by the interior light manager. The percentage value (independent of light actuator type and environment e.g. voltage of electrical system) depends on the functionality that the light source shall be switched on. 100 percent means full power of the light actuator
    IntrLiBriActvnOfLiForCigaretteLighterIllmnFrntLe: interface=BriCmd1  # Activation of Interior Light Source Brightness | The brightness of a interior light source is requested by the interior light manager. The percentage value (independent of light actuator type and environment e.g. voltage of electrical system) depends on the functionality that the light source shall be switched on. 100 percent means full power of the light actuator
    IntrLiBriActvnOfLiForCigaretteLighterIllmnFrntRi: interface=BriCmd1  # Activation of Interior Light Source Brightness | The brightness of a interior light source is requested by the interior light manager. The percentage value (independent of light actuator type and environment e.g. voltage of electrical system) depends on the functionality that the light source shall be switched on. 100 percent means full power of the light actuator
    IntrLiBriActvnOfLiForCigaretteLighterIllmnGroup: interface=BriCmd1  # Activation of Interior Light Source Brightness | The brightness of a interior light source is requested by the interior light manager. The percentage value (independent of light actuator type and environment e.g. voltage of electrical system) depends on the functionality that the light source shall be switched on. 100 percent means full power of the light actuator
    IntrLiBriActvnOfLiForCigaretteLighterIllmnMidCen: interface=BriCmd1  # Activation of Interior Light Source Brightness | The brightness of a interior light source is requested by the interior light manager. The percentage value (independent of light actuator type and environment e.g. voltage of electrical system) depends on the functionality that the light source shall be switched on. 100 percent means full power of the light actuator
    IntrLiBriActvnOfLiForCigaretteLighterIllmnMidLe: interface=BriCmd1  # Activation of Interior Light Source Brightness | The brightness of a interior light source is requested by the interior light manager. The percentage value (independent of light actuator type and environment e.g. voltage of electrical system) depends on the functionality that the light source shall be switched on. 100 percent means full power of the light actuator
    IntrLiBriActvnOfLiForCigaretteLighterIllmnMidRi: interface=BriCmd1  # Activation of Interior Light Source Brightness | The brightness of a interior light source is requested by the interior light manager. The percentage value (independent of light actuator type and environment e.g. voltage of electrical system) depends on the functionality that the light source shall be switched on. 100 percent means full power of the light actuator
    IntrLiBriActvnOfLiForCigaretteLighterIllmnReCen: interface=BriCmd1  # Activation of Interior Light Source Brightness | The brightness of a interior light source is requested by the interior light manager. The percentage value (independent of light actuator type and environment e.g. voltage of electrical system) depends on the functionality that the light source shall be switched on. 100 percent means full power of the light actuator
    IntrLiBriActvnOfLiForCigaretteLighterIllmnReLe: interface=BriCmd1  # Activation of Interior Light Source Brightness | The brightness of a interior light source is requested by the interior light manager. The percentage value (independent of light actuator type and environment e.g. voltage of electrical system) depends on the functionality that the light source shall be switched on. 100 percent means full power of the light actuator
    IntrLiBriActvnOfLiForCigaretteLighterIllmnReRi: interface=BriCmd1  # Activation of Interior Light Source Brightness | The brightness of a interior light source is requested by the interior light manager. The percentage value (independent of light actuator type and environment e.g. voltage of electrical system) depends on the functionality that the light source shall be switched on. 100 percent means full power of the light actuator
    IntrLiBriActvnOfLiForDoorOpenerIllmnFrntLe: interface=BriCmd1  # Activation of Interior Light Source Brightness | The brightness of a interior light source is requested by the interior light manager. The percentage value (independent of light actuator type and environment e.g. voltage of electrical system) depends on the functionality that the light source shall be switched on. 100 percent means full power of the light actuator
    IntrLiBriActvnOfLiForDoorOpenerIllmnFrntRi: interface=BriCmd1  # Activation of Interior Light Source Brightness | The brightness of a interior light source is requested by the interior light manager. The percentage value (independent of light actuator type and environment e.g. voltage of electrical system) depends on the functionality that the light source shall be switched on. 100 percent means full power of the light actuator
    IntrLiBriActvnOfLiForDoorOpenerIllmnGroup: interface=BriCmd1  # Activation of Interior Light Source Brightness | The brightness of a interior light source is requested by the interior light manager. The percentage value (independent of light actuator type and environment e.g. voltage of electrical system) depends on the functionality that the light source shall be switched on. 100 percent means full power of the light actuator
    IntrLiBriActvnOfLiForDoorOpenerIllmnMidLe: interface=BriCmd1  # Activation of Interior Light Source Brightness | The brightness of a interior light source is requested by the interior light manager. The percentage value (independent of light actuator type and environment e.g. voltage of electrical system) depends on the functionality that the light source shall be switched on. 100 percent means full power of the light actuator
    IntrLiBriActvnOfLiForDoorOpenerIllmnMidRi: interface=BriCmd1  # Activation of Interior Light Source Brightness | The brightness of a interior light source is requested by the interior light manager. The percentage value (independent of light actuator type and environment e.g. voltage of electrical system) depends on the functionality that the light source shall be switched on. 100 percent means full power of the light actuator
    IntrLiBriActvnOfLiForDoorOpenerIllmnReLe: interface=BriCmd1  # Activation of Interior Light Source Brightness | The brightness of a interior light source is requested by the interior light manager. The percentage value (independent of light actuator type and environment e.g. voltage of electrical system) depends on the functionality that the light source shall be switched on. 100 percent means full power of the light actuator
    IntrLiBriActvnOfLiForDoorOpenerIllmnReRi: interface=BriCmd1  # Activation of Interior Light Source Brightness | The brightness of a interior light source is requested by the interior light manager. The percentage value (independent of light actuator type and environment e.g. voltage of electrical system) depends on the functionality that the light source shall be switched on. 100 percent means full power of the light actuator
    IntrLiBriActvnOfLiForDoorSillIllmnFrntLe: interface=BriCmd1  # Activation of Interior Light Source Brightness | The brightness of a interior light source is requested by the interior light manager. The percentage value (independent of light actuator type and environment e.g. voltage of electrical system) depends on the functionality that the light source shall be switched on. 100 percent means full power of the light actuator
    IntrLiBriActvnOfLiForDoorSillIllmnFrntRi: interface=BriCmd1  # Activation of Interior Light Source Brightness | The brightness of a interior light source is requested by the interior light manager. The percentage value (independent of light actuator type and environment e.g. voltage of electrical system) depends on the functionality that the light source shall be switched on. 100 percent means full power of the light actuator
    IntrLiBriActvnOfLiForDoorSillIllmnGroup: interface=BriCmd1  # Activation of Interior Light Source Brightness | The brightness of a interior light source is requested by the interior light manager. The percentage value (independent of light actuator type and environment e.g. voltage of electrical system) depends on the functionality that the light source shall be switched on. 100 percent means full power of the light actuator
    IntrLiBriActvnOfLiForDoorSillIllmnMidLe: interface=BriCmd1  # Activation of Interior Light Source Brightness | The brightness of a interior light source is requested by the interior light manager. The percentage value (independent of light actuator type and environment e.g. voltage of electrical system) depends on the functionality that the light source shall be switched on. 100 percent means full power of the light actuator
    IntrLiBriActvnOfLiForDoorSillIllmnMidRi: interface=BriCmd1  # Activation of Interior Light Source Brightness | The brightness of a interior light source is requested by the interior light manager. The percentage value (independent of light actuator type and environment e.g. voltage of electrical system) depends on the functionality that the light source shall be switched on. 100 percent means full power of the light actuator
    IntrLiBriActvnOfLiForDoorSillIllmnReLe: interface=BriCmd1  # Activation of Interior Light Source Brightness | The brightness of a interior light source is requested by the interior light manager. The percentage value (independent of light actuator type and environment e.g. voltage of electrical system) depends on the functionality that the light source shall be switched on. 100 percent means full power of the light actuator
    IntrLiBriActvnOfLiForDoorSillIllmnReRi: interface=BriCmd1  # Activation of Interior Light Source Brightness | The brightness of a interior light source is requested by the interior light manager. The percentage value (independent of light actuator type and environment e.g. voltage of electrical system) depends on the functionality that the light source shall be switched on. 100 percent means full power of the light actuator
    IntrLiBriActvnOfLiForReadingAtRowThrdCen: interface=BriCmd1  # Activation of Interior Light Source Brightness | The brightness of a interior light source is requested by the interior light manager. The percentage value (independent of light actuator type and environment e.g. voltage of electrical system) depends on the functionality that the light source shall be switched on. 100 percent means full power of the light actuator
    IntrLiBriActvnOfLiForReadingAtRowThrdLe: interface=BriCmd1  # Activation of Interior Light Source Brightness | The brightness of a interior light source is requested by the interior light manager. The percentage value (independent of light actuator type and environment e.g. voltage of electrical system) depends on the functionality that the light source shall be switched on. 100 percent means full power of the light actuator
    IntrLiBriActvnOfLiForReadingAtRowThrdRi: interface=BriCmd1  # Activation of Interior Light Source Brightness | The brightness of a interior light source is requested by the interior light manager. The percentage value (independent of light actuator type and environment e.g. voltage of electrical system) depends on the functionality that the light source shall be switched on. 100 percent means full power of the light actuator
    IntrLiBriActvnOfLiForReadingFrntCen: interface=BriCmd1  # Activation of Interior Light Source Brightness | The brightness of a interior light source is requested by the interior light manager. The percentage value (independent of light actuator type and environment e.g. voltage of electrical system) depends on the functionality that the light source shall be switched on. 100 percent means full power of the light actuator
    IntrLiBriActvnOfLiForReadingFrntLe: interface=BriCmd1  # Activation of Interior Light Source Brightness | The brightness of a interior light source is requested by the interior light manager. The percentage value (independent of light actuator type and environment e.g. voltage of electrical system) depends on the functionality that the light source shall be switched on. 100 percent means full power of the light actuator
    IntrLiBriActvnOfLiForReadingFrntRi: interface=BriCmd1  # Activation of Interior Light Source Brightness | The brightness of a interior light source is requested by the interior light manager. The percentage value (independent of light actuator type and environment e.g. voltage of electrical system) depends on the functionality that the light source shall be switched on. 100 percent means full power of the light actuator
    IntrLiBriActvnOfLiForReadingGroup: interface=BriCmd1  # Activation of Interior Light Source Brightness | The brightness of a interior light source is requested by the interior light manager. The percentage value (independent of light actuator type and environment e.g. voltage of electrical system) depends on the functionality that the light source shall be switched on. 100 percent means full power of the light actuator
    IntrLiBriActvnOfLiForReadingReCen: interface=BriCmd1  # Activation of Interior Light Source Brightness | The brightness of a interior light source is requested by the interior light manager. The percentage value (independent of light actuator type and environment e.g. voltage of electrical system) depends on the functionality that the light source shall be switched on. 100 percent means full power of the light actuator
    IntrLiBriActvnOfLiForReadingReLe: interface=BriCmd1  # Activation of Interior Light Source Brightness | The brightness of a interior light source is requested by the interior light manager. The percentage value (independent of light actuator type and environment e.g. voltage of electrical system) depends on the functionality that the light source shall be switched on. 100 percent means full power of the light actuator
    IntrLiBriActvnOfLiForReadingReRi: interface=BriCmd1  # Activation of Interior Light Source Brightness | The brightness of a interior light source is requested by the interior light manager. The percentage value (independent of light actuator type and environment e.g. voltage of electrical system) depends on the functionality that the light source shall be switched on. 100 percent means full power of the light actuator
    IntrLiBriActvnOfLiForSftyBltLockIllmnFrntCen: interface=BriCmd1  # Activation of Interior Light Source Brightness | The brightness of a interior light source is requested by the interior light manager. The percentage value (independent of light actuator type and environment e.g. voltage of electrical system) depends on the functionality that the light source shall be switched on. 100 percent means full power of the light actuator
    IntrLiBriActvnOfLiForSftyBltLockIllmnFrntLe: interface=BriCmd1  # Activation of Interior Light Source Brightness | The brightness of a interior light source is requested by the interior light manager. The percentage value (independent of light actuator type and environment e.g. voltage of electrical system) depends on the functionality that the light source shall be switched on. 100 percent means full power of the light actuator
    IntrLiBriActvnOfLiForSftyBltLockIllmnFrntRi: interface=BriCmd1  # Activation of Interior Light Source Brightness | The brightness of a interior light source is requested by the interior light manager. The percentage value (independent of light actuator type and environment e.g. voltage of electrical system) depends on the functionality that the light source shall be switched on. 100 percent means full power of the light actuator
    IntrLiBriActvnOfLiForSftyBltLockIllmnGroup: interface=BriCmd1  # Activation of Interior Light Source Brightness | The brightness of a interior light source is requested by the interior light manager. The percentage value (independent of light actuator type and environment e.g. voltage of electrical system) depends on the functionality that the light source shall be switched on. 100 percent means full power of the light actuator
    IntrLiBriActvnOfLiForSftyBltLockIllmnMidCen: interface=BriCmd1  # Activation of Interior Light Source Brightness | The brightness of a interior light source is requested by the interior light manager. The percentage value (independent of light actuator type and environment e.g. voltage of electrical system) depends on the functionality that the light source shall be switched on. 100 percent means full power of the light actuator
    IntrLiBriActvnOfLiForSftyBltLockIllmnMidLe: interface=BriCmd1  # Activation of Interior Light Source Brightness | The brightness of a interior light source is requested by the interior light manager. The percentage value (independent of light actuator type and environment e.g. voltage of electrical system) depends on the functionality that the light source shall be switched on. 100 percent means full power of the light actuator
    IntrLiBriActvnOfLiForSftyBltLockIllmnMidRi: interface=BriCmd1  # Activation of Interior Light Source Brightness | The brightness of a interior light source is requested by the interior light manager. The percentage value (independent of light actuator type and environment e.g. voltage of electrical system) depends on the functionality that the light source shall be switched on. 100 percent means full power of the light actuator
    IntrLiBriActvnOfLiForSftyBltLockIllmnReCen: interface=BriCmd1  # Activation of Interior Light Source Brightness | The brightness of a interior light source is requested by the interior light manager. The percentage value (independent of light actuator type and environment e.g. voltage of electrical system) depends on the functionality that the light source shall be switched on. 100 percent means full power of the light actuator
    IntrLiBriActvnOfLiForSftyBltLockIllmnReLe: interface=BriCmd1  # Activation of Interior Light Source Brightness | The brightness of a interior light source is requested by the interior light manager. The percentage value (independent of light actuator type and environment e.g. voltage of electrical system) depends on the functionality that the light source shall be switched on. 100 percent means full power of the light actuator
    IntrLiBriActvnOfLiForSftyBltLockIllmnReRi: interface=BriCmd1  # Activation of Interior Light Source Brightness | The brightness of a interior light source is requested by the interior light manager. The percentage value (independent of light actuator type and environment e.g. voltage of electrical system) depends on the functionality that the light source shall be switched on. 100 percent means full power of the light actuator
    IntrLiBriActvnOfSwtIllmnForHzrdWarn: interface=BriCmd1  # Interior Light Brightness Activation of Hazard Warning Switch Illumination | Activation Of Interior Hazard Warning Switch Illumination (percentage value)
    IntrLiBriActvnOfTrCmptmtGroup: interface=BriCmd1  # Activation of Interior Light Source Brightness | The brightness of a interior light source is requested by the interior light manager. The percentage value (independent of light actuator type and environment e.g. voltage of electrical system) depends on the functionality that the light source shall be switched on. 100 percent means full power of the light actuator
    IntrLiBriActvnOfTrCmptmtLiCen: interface=BriCmd1  # Activation of Interior Light Source Brightness | The brightness of a interior light source is requested by the interior light manager. The percentage value (independent of light actuator type and environment e.g. voltage of electrical system) depends on the functionality that the light source shall be switched on. 100 percent means full power of the light actuator
    IntrLiBriActvnOfTrCmptmtLiLoLe: interface=BriCmd1  # Activation of Interior Light Source Brightness | The brightness of a interior light source is requested by the interior light manager. The percentage value (independent of light actuator type and environment e.g. voltage of electrical system) depends on the functionality that the light source shall be switched on. 100 percent means full power of the light actuator
    IntrLiBriActvnOfTrCmptmtLiLoRi: interface=BriCmd1  # Activation of Interior Light Source Brightness | The brightness of a interior light source is requested by the interior light manager. The percentage value (independent of light actuator type and environment e.g. voltage of electrical system) depends on the functionality that the light source shall be switched on. 100 percent means full power of the light actuator
    IntrLiBriActvnOfTrCmptmtLiUpLe: interface=BriCmd1  # Activation of Interior Light Source Brightness | The brightness of a interior light source is requested by the interior light manager. The percentage value (independent of light actuator type and environment e.g. voltage of electrical system) depends on the functionality that the light source shall be switched on. 100 percent means full power of the light actuator
    IntrLiBriActvnOfTrCmptmtLiUpRi: interface=BriCmd1  # Activation of Interior Light Source Brightness | The brightness of a interior light source is requested by the interior light manager. The percentage value (independent of light actuator type and environment e.g. voltage of electrical system) depends on the functionality that the light source shall be switched on. 100 percent means full power of the light actuator
    IntrLiBriActvnOfVanityLiFrntLe: interface=BriCmd1  # Activation of Interior Light Source Brightness | The brightness of a interior light source is requested by the interior light manager. The percentage value (independent of light actuator type and environment e.g. voltage of electrical system) depends on the functionality that the light source shall be switched on. 100 percent means full power of the light actuator
    IntrLiBriActvnOfVanityLiFrntRi: interface=BriCmd1  # Activation of Interior Light Source Brightness | The brightness of a interior light source is requested by the interior light manager. The percentage value (independent of light actuator type and environment e.g. voltage of electrical system) depends on the functionality that the light source shall be switched on. 100 percent means full power of the light actuator
    IntrLiBriActvnOfVanityLiGroup: interface=BriCmd1  # Activation of Interior Light Source Brightness | The brightness of a interior light source is requested by the interior light manager. The percentage value (independent of light actuator type and environment e.g. voltage of electrical system) depends on the functionality that the light source shall be switched on. 100 percent means full power of the light actuator
    IntrLiBriActvnOfVanityLiMidLe: interface=BriCmd1  # Activation of Interior Light Source Brightness | The brightness of a interior light source is requested by the interior light manager. The percentage value (independent of light actuator type and environment e.g. voltage of electrical system) depends on the functionality that the light source shall be switched on. 100 percent means full power of the light actuator
    IntrLiBriActvnOfVanityLiMidRi: interface=BriCmd1  # Activation of Interior Light Source Brightness | The brightness of a interior light source is requested by the interior light manager. The percentage value (independent of light actuator type and environment e.g. voltage of electrical system) depends on the functionality that the light source shall be switched on. 100 percent means full power of the light actuator
    IntrLiBriActvnOfVanityLiReLe: interface=BriCmd1  # Activation of Interior Light Source Brightness | The brightness of a interior light source is requested by the interior light manager. The percentage value (independent of light actuator type and environment e.g. voltage of electrical system) depends on the functionality that the light source shall be switched on. 100 percent means full power of the light actuator
    IntrLiBriActvnOfVanityLiReRi: interface=BriCmd1  # Activation of Interior Light Source Brightness | The brightness of a interior light source is requested by the interior light manager. The percentage value (independent of light actuator type and environment e.g. voltage of electrical system) depends on the functionality that the light source shall be switched on. 100 percent means full power of the light actuator
    IntrLiReqFromHmiToAshtrayLiFrntCen: interface=IntrLiReq1  # HMI Switch for Interior Light Source | User request to activate / deactivate an interior light source (switch on/off or automatic mode).
    IntrLiReqFromHmiToAshtrayLiFrntLe: interface=IntrLiReq1  # HMI Switch for Interior Light Source | User request to activate / deactivate an interior light source (switch on/off or automatic mode).
    IntrLiReqFromHmiToAshtrayLiFrntRi: interface=IntrLiReq1  # HMI Switch for Interior Light Source | User request to activate / deactivate an interior light source (switch on/off or automatic mode).
    IntrLiReqFromHmiToAshtrayLiGroup: interface=IntrLiReq1  # HMI Switch for Interior Light Source | User request to activate / deactivate an interior light source (switch on/off or automatic mode).
    IntrLiReqFromHmiToAshtrayLiMidCen: interface=IntrLiReq1  # HMI Switch for Interior Light Source | User request to activate / deactivate an interior light source (switch on/off or automatic mode).
    IntrLiReqFromHmiToAshtrayLiMidLe: interface=IntrLiReq1  # HMI Switch for Interior Light Source | User request to activate / deactivate an interior light source (switch on/off or automatic mode).
    IntrLiReqFromHmiToAshtrayLiMidRi: interface=IntrLiReq1  # HMI Switch for Interior Light Source | User request to activate / deactivate an interior light source (switch on/off or automatic mode).
    IntrLiReqFromHmiToAshtrayLiReCen: interface=IntrLiReq1  # HMI Switch for Interior Light Source | User request to activate / deactivate an interior light source (switch on/off or automatic mode).
    IntrLiReqFromHmiToAshtrayLiReLe: interface=IntrLiReq1  # HMI Switch for Interior Light Source | User request to activate / deactivate an interior light source (switch on/off or automatic mode).
    IntrLiReqFromHmiToAshtrayLiReRi: interface=IntrLiReq1  # HMI Switch for Interior Light Source | User request to activate / deactivate an interior light source (switch on/off or automatic mode).
    IntrLiReqFromHmiToCbnLiFrntCen: interface=IntrLiReq1  # HMI Switch for Interior Light Source | User request to activate / deactivate an interior light source (switch on/off or automatic mode).
    IntrLiReqFromHmiToCbnLiFrntLe: interface=IntrLiReq1  # HMI Switch for Interior Light Source | User request to activate / deactivate an interior light source (switch on/off or automatic mode).
    IntrLiReqFromHmiToCbnLiFrntRi: interface=IntrLiReq1  # HMI Switch for Interior Light Source | User request to activate / deactivate an interior light source (switch on/off or automatic mode).
    IntrLiReqFromHmiToCbnLiGroup: interface=IntrLiReq1  # HMI Switch for Interior Light Source | User request to activate / deactivate an interior light source (switch on/off or automatic mode).
    IntrLiReqFromHmiToCbnLiMidCen: interface=IntrLiReq1  # HMI Switch for Interior Light Source | User request to activate / deactivate an interior light source (switch on/off or automatic mode).
    IntrLiReqFromHmiToCbnLiMidLe: interface=IntrLiReq1  # HMI Switch for Interior Light Source | User request to activate / deactivate an interior light source (switch on/off or automatic mode).
    IntrLiReqFromHmiToCbnLiMidRi: interface=IntrLiReq1  # HMI Switch for Interior Light Source | User request to activate / deactivate an interior light source (switch on/off or automatic mode).
    IntrLiReqFromHmiToCbnLiReCen: interface=IntrLiReq1  # HMI Switch for Interior Light Source | User request to activate / deactivate an interior light source (switch on/off or automatic mode).
    IntrLiReqFromHmiToCbnLiReLe: interface=IntrLiReq1  # HMI Switch for Interior Light Source | User request to activate / deactivate an interior light source (switch on/off or automatic mode).
    IntrLiReqFromHmiToCbnLiReRi: interface=IntrLiReq1  # HMI Switch for Interior Light Source | User request to activate / deactivate an interior light source (switch on/off or automatic mode).
    IntrLiReqFromHmiToCurbLiFrntLe: interface=IntrLiReq1  # HMI Switch for Interior Light Source | User request to activate / deactivate an interior light source (switch on/off or automatic mode).
    IntrLiReqFromHmiToCurbLiFrntRi: interface=IntrLiReq1  # HMI Switch for Interior Light Source | User request to activate / deactivate an interior light source (switch on/off or automatic mode).
    IntrLiReqFromHmiToCurbLiGroup: interface=IntrLiReq1  # HMI Switch for Interior Light Source | User request to activate / deactivate an interior light source (switch on/off or automatic mode).
    IntrLiReqFromHmiToCurbLiMidLe: interface=IntrLiReq1  # HMI Switch for Interior Light Source | User request to activate / deactivate an interior light source (switch on/off or automatic mode).
    IntrLiReqFromHmiToCurbLiMidRi: interface=IntrLiReq1  # HMI Switch for Interior Light Source | User request to activate / deactivate an interior light source (switch on/off or automatic mode).
    IntrLiReqFromHmiToCurbLiReLe: interface=IntrLiReq1  # HMI Switch for Interior Light Source | User request to activate / deactivate an interior light source (switch on/off or automatic mode).
    IntrLiReqFromHmiToCurbLiReRi: interface=IntrLiReq1  # HMI Switch for Interior Light Source | User request to activate / deactivate an interior light source (switch on/off or automatic mode).
    IntrLiReqFromHmiToEngCmptmtLi: interface=IntrLiReq1  # HMI Switch for Interior Light Source | User request to activate / deactivate an interior light source (switch on/off or automatic mode).
    IntrLiReqFromHmiToExtrLiSwtIllmn: interface=IntrLiReq1  # HMI Switch for Interior Light Source | User request to activate / deactivate an interior light source (switch on/off or automatic mode).
    IntrLiReqFromHmiToFootwellGroup: interface=IntrLiReq1  # HMI Switch for Interior Light Source | User request to activate / deactivate an interior light source (switch on/off or automatic mode).
    IntrLiReqFromHmiToFootwellLiFrntCen: interface=IntrLiReq1  # HMI Switch for Interior Light Source | User request to activate / deactivate an interior light source (switch on/off or automatic mode).
    IntrLiReqFromHmiToFootwellLiFrntLe: interface=IntrLiReq1  # HMI Switch for Interior Light Source | User request to activate / deactivate an interior light source (switch on/off or automatic mode).
    IntrLiReqFromHmiToFootwellLiFrntRi: interface=IntrLiReq1  # HMI Switch for Interior Light Source | User request to activate / deactivate an interior light source (switch on/off or automatic mode).
    IntrLiReqFromHmiToFootwellLiMidCen: interface=IntrLiReq1  # HMI Switch for Interior Light Source | User request to activate / deactivate an interior light source (switch on/off or automatic mode).
    IntrLiReqFromHmiToFootwellLiMidLe: interface=IntrLiReq1  # HMI Switch for Interior Light Source | User request to activate / deactivate an interior light source (switch on/off or automatic mode).
    IntrLiReqFromHmiToFootwellLiMidRi: interface=IntrLiReq1  # HMI Switch for Interior Light Source | User request to activate / deactivate an interior light source (switch on/off or automatic mode).
    IntrLiReqFromHmiToFootwellLiReCen: interface=IntrLiReq1  # HMI Switch for Interior Light Source | User request to activate / deactivate an interior light source (switch on/off or automatic mode).
    IntrLiReqFromHmiToFootwellLiReLe: interface=IntrLiReq1  # HMI Switch for Interior Light Source | User request to activate / deactivate an interior light source (switch on/off or automatic mode).
    IntrLiReqFromHmiToFootwellLiReRi: interface=IntrLiReq1  # HMI Switch for Interior Light Source | User request to activate / deactivate an interior light source (switch on/off or automatic mode).
    IntrLiReqFromHmiToGlvCmptmtLi: interface=IntrLiReq1  # HMI Switch for Interior Light Source | User request to activate / deactivate an interior light source (switch on/off or automatic mode).
    IntrLiReqFromHmiToIgnSwtIllmn: interface=IntrLiReq1  # HMI Switch for Interior Light Source | User request to activate / deactivate an interior light source (switch on/off or automatic mode).
    IntrLiReqFromHmiToIntrLiGroup0: interface=IntrLiReq1  # HMI Switch for Interior Light Source | User request to activate / deactivate an interior light source (switch on/off or automatic mode).
    IntrLiReqFromHmiToIntrLiGroup1: interface=IntrLiReq1  # HMI Switch for Interior Light Source | User request to activate / deactivate an interior light source (switch on/off or automatic mode).
    IntrLiReqFromHmiToIntrLiGroup{10..15}: interface=IntrLiReq1  # HMI Switch for Interior Light Source | User request to activate / deactivate an interior light source (switch on/off or automatic mode).
    IntrLiReqFromHmiToIntrLiGroup{2..9}: interface=IntrLiReq1  # HMI Switch for Interior Light Source | User request to activate / deactivate an interior light source (switch on/off or automatic mode).
    IntrLiReqFromHmiToLiForCigaretteLighterIllmnAtTrLe: interface=IntrLiReq1  # HMI Switch for Interior Light Source | User request to activate / deactivate an interior light source (switch on/off or automatic mode).
    IntrLiReqFromHmiToLiForCigaretteLighterIllmnAtTrRi: interface=IntrLiReq1  # HMI Switch for Interior Light Source | User request to activate / deactivate an interior light source (switch on/off or automatic mode).
    IntrLiReqFromHmiToLiForCigaretteLighterIllmnFrntCen: interface=IntrLiReq1  # HMI Switch for Interior Light Source | User request to activate / deactivate an interior light source (switch on/off or automatic mode).
    IntrLiReqFromHmiToLiForCigaretteLighterIllmnFrntLe: interface=IntrLiReq1  # HMI Switch for Interior Light Source | User request to activate / deactivate an interior light source (switch on/off or automatic mode).
    IntrLiReqFromHmiToLiForCigaretteLighterIllmnFrntRi: interface=IntrLiReq1  # HMI Switch for Interior Light Source | User request to activate / deactivate an interior light source (switch on/off or automatic mode).
    IntrLiReqFromHmiToLiForCigaretteLighterIllmnGroup: interface=IntrLiReq1  # HMI Switch for Interior Light Source | User request to activate / deactivate an interior light source (switch on/off or automatic mode).
    IntrLiReqFromHmiToLiForCigaretteLighterIllmnMidCen: interface=IntrLiReq1  # HMI Switch for Interior Light Source | User request to activate / deactivate an interior light source (switch on/off or automatic mode).
    IntrLiReqFromHmiToLiForCigaretteLighterIllmnMidLe: interface=IntrLiReq1  # HMI Switch for Interior Light Source | User request to activate / deactivate an interior light source (switch on/off or automatic mode).
    IntrLiReqFromHmiToLiForCigaretteLighterIllmnMidRi: interface=IntrLiReq1  # HMI Switch for Interior Light Source | User request to activate / deactivate an interior light source (switch on/off or automatic mode).
    IntrLiReqFromHmiToLiForCigaretteLighterIllmnReCen: interface=IntrLiReq1  # HMI Switch for Interior Light Source | User request to activate / deactivate an interior light source (switch on/off or automatic mode).
    IntrLiReqFromHmiToLiForCigaretteLighterIllmnReLe: interface=IntrLiReq1  # HMI Switch for Interior Light Source | User request to activate / deactivate an interior light source (switch on/off or automatic mode).
    IntrLiReqFromHmiToLiForCigaretteLighterIllmnReRi: interface=IntrLiReq1  # HMI Switch for Interior Light Source | User request to activate / deactivate an interior light source (switch on/off or automatic mode).
    IntrLiReqFromHmiToLiForDoorOpenerIllmnFrntLe: interface=IntrLiReq1  # HMI Switch for Interior Light Source | User request to activate / deactivate an interior light source (switch on/off or automatic mode).
    IntrLiReqFromHmiToLiForDoorOpenerIllmnFrntRi: interface=IntrLiReq1  # HMI Switch for Interior Light Source | User request to activate / deactivate an interior light source (switch on/off or automatic mode).
    IntrLiReqFromHmiToLiForDoorOpenerIllmnGroup: interface=IntrLiReq1  # HMI Switch for Interior Light Source | User request to activate / deactivate an interior light source (switch on/off or automatic mode).
    IntrLiReqFromHmiToLiForDoorOpenerIllmnMidLe: interface=IntrLiReq1  # HMI Switch for Interior Light Source | User request to activate / deactivate an interior light source (switch on/off or automatic mode).
    IntrLiReqFromHmiToLiForDoorOpenerIllmnMidRi: interface=IntrLiReq1  # HMI Switch for Interior Light Source | User request to activate / deactivate an interior light source (switch on/off or automatic mode).
    IntrLiReqFromHmiToLiForDoorOpenerIllmnReLe: interface=IntrLiReq1  # HMI Switch for Interior Light Source | User request to activate / deactivate an interior light source (switch on/off or automatic mode).
    IntrLiReqFromHmiToLiForDoorOpenerIllmnReRi: interface=IntrLiReq1  # HMI Switch for Interior Light Source | User request to activate / deactivate an interior light source (switch on/off or automatic mode).
    IntrLiReqFromHmiToLiForDoorSillIllmnFrntLe: interface=IntrLiReq1  # HMI Switch for Interior Light Source | User request to activate / deactivate an interior light source (switch on/off or automatic mode).
    IntrLiReqFromHmiToLiForDoorSillIllmnFrntRi: interface=IntrLiReq1  # HMI Switch for Interior Light Source | User request to activate / deactivate an interior light source (switch on/off or automatic mode).
    IntrLiReqFromHmiToLiForDoorSillIllmnGroup: interface=IntrLiReq1  # HMI Switch for Interior Light Source | User request to activate / deactivate an interior light source (switch on/off or automatic mode).
    IntrLiReqFromHmiToLiForDoorSillIllmnMidLe: interface=IntrLiReq1  # HMI Switch for Interior Light Source | User request to activate / deactivate an interior light source (switch on/off or automatic mode).
    IntrLiReqFromHmiToLiForDoorSillIllmnMidRi: interface=IntrLiReq1  # HMI Switch for Interior Light Source | User request to activate / deactivate an interior light source (switch on/off or automatic mode).
    IntrLiReqFromHmiToLiForDoorSillIllmnReLe: interface=IntrLiReq1  # HMI Switch for Interior Light Source | User request to activate / deactivate an interior light source (switch on/off or automatic mode).
    IntrLiReqFromHmiToLiForDoorSillIllmnReRi: interface=IntrLiReq1  # HMI Switch for Interior Light Source | User request to activate / deactivate an interior light source (switch on/off or automatic mode).
    IntrLiReqFromHmiToLiForReadingAtRowThrdCen: interface=IntrLiReq1  # HMI Switch for Interior Light Source | User request to activate / deactivate an interior light source (switch on/off or automatic mode).
    IntrLiReqFromHmiToLiForReadingAtRowThrdLe: interface=IntrLiReq1  # HMI Switch for Interior Light Source | User request to activate / deactivate an interior light source (switch on/off or automatic mode).
    IntrLiReqFromHmiToLiForReadingAtRowThrdRi: interface=IntrLiReq1  # HMI Switch for Interior Light Source | User request to activate / deactivate an interior light source (switch on/off or automatic mode).
    IntrLiReqFromHmiToLiForReadingFrntCen: interface=IntrLiReq1  # HMI Switch for Interior Light Source | User request to activate / deactivate an interior light source (switch on/off or automatic mode).
    IntrLiReqFromHmiToLiForReadingFrntLe: interface=IntrLiReq1  # HMI Switch for Interior Light Source | User request to activate / deactivate an interior light source (switch on/off or automatic mode).
    IntrLiReqFromHmiToLiForReadingFrntRi: interface=IntrLiReq1  # HMI Switch for Interior Light Source | User request to activate / deactivate an interior light source (switch on/off or automatic mode).
    IntrLiReqFromHmiToLiForReadingGroup: interface=IntrLiReq1  # HMI Switch for Interior Light Source | User request to activate / deactivate an interior light source (switch on/off or automatic mode).
    IntrLiReqFromHmiToLiForReadingReCen: interface=IntrLiReq1  # HMI Switch for Interior Light Source | User request to activate / deactivate an interior light source (switch on/off or automatic mode).
    IntrLiReqFromHmiToLiForReadingReLe: interface=IntrLiReq1  # HMI Switch for Interior Light Source | User request to activate / deactivate an interior light source (switch on/off or automatic mode).
    IntrLiReqFromHmiToLiForReadingReRi: interface=IntrLiReq1  # HMI Switch for Interior Light Source | User request to activate / deactivate an interior light source (switch on/off or automatic mode).
    IntrLiReqFromHmiToLiForSftyBltLockIllmnFrntCen: interface=IntrLiReq1  # HMI Switch for Interior Light Source | User request to activate / deactivate an interior light source (switch on/off or automatic mode).
    IntrLiReqFromHmiToLiForSftyBltLockIllmnFrntLe: interface=IntrLiReq1  # HMI Switch for Interior Light Source | User request to activate / deactivate an interior light source (switch on/off or automatic mode).
    IntrLiReqFromHmiToLiForSftyBltLockIllmnFrntRi: interface=IntrLiReq1  # HMI Switch for Interior Light Source | User request to activate / deactivate an interior light source (switch on/off or automatic mode).
    IntrLiReqFromHmiToLiForSftyBltLockIllmnGroup: interface=IntrLiReq1  # HMI Switch for Interior Light Source | User request to activate / deactivate an interior light source (switch on/off or automatic mode).
    IntrLiReqFromHmiToLiForSftyBltLockIllmnMidCen: interface=IntrLiReq1  # HMI Switch for Interior Light Source | User request to activate / deactivate an interior light source (switch on/off or automatic mode).
    IntrLiReqFromHmiToLiForSftyBltLockIllmnMidLe: interface=IntrLiReq1  # HMI Switch for Interior Light Source | User request to activate / deactivate an interior light source (switch on/off or automatic mode).
    IntrLiReqFromHmiToLiForSftyBltLockIllmnMidRi: interface=IntrLiReq1  # HMI Switch for Interior Light Source | User request to activate / deactivate an interior light source (switch on/off or automatic mode).
    IntrLiReqFromHmiToLiForSftyBltLockIllmnReCen: interface=IntrLiReq1  # HMI Switch for Interior Light Source | User request to activate / deactivate an interior light source (switch on/off or automatic mode).
    IntrLiReqFromHmiToLiForSftyBltLockIllmnReLe: interface=IntrLiReq1  # HMI Switch for Interior Light Source | User request to activate / deactivate an interior light source (switch on/off or automatic mode).
    IntrLiReqFromHmiToLiForSftyBltLockIllmnReRi: interface=IntrLiReq1  # HMI Switch for Interior Light Source | User request to activate / deactivate an interior light source (switch on/off or automatic mode).
    IntrLiReqFromHmiToTrCmptmtGroup: interface=IntrLiReq1  # HMI Switch for Interior Light Source | User request to activate / deactivate an interior light source (switch on/off or automatic mode).
    IntrLiReqFromHmiToTrCmptmtLiCen: interface=IntrLiReq1  # HMI Switch for Interior Light Source | User request to activate / deactivate an interior light source (switch on/off or automatic mode).
    IntrLiReqFromHmiToTrCmptmtLiLoLe: interface=IntrLiReq1  # HMI Switch for Interior Light Source | User request to activate / deactivate an interior light source (switch on/off or automatic mode).
    IntrLiReqFromHmiToTrCmptmtLiLoRi: interface=IntrLiReq1  # HMI Switch for Interior Light Source | User request to activate / deactivate an interior light source (switch on/off or automatic mode).
    IntrLiReqFromHmiToTrCmptmtLiUpLe: interface=IntrLiReq1  # HMI Switch for Interior Light Source | User request to activate / deactivate an interior light source (switch on/off or automatic mode).
    IntrLiReqFromHmiToTrCmptmtLiUpRi: interface=IntrLiReq1  # HMI Switch for Interior Light Source | User request to activate / deactivate an interior light source (switch on/off or automatic mode).
    IntrLiReqFromHmiToVanityLiFrntLe: interface=IntrLiReq1  # HMI Switch for Interior Light Source | User request to activate / deactivate an interior light source (switch on/off or automatic mode).
    IntrLiReqFromHmiToVanityLiFrntRi: interface=IntrLiReq1  # HMI Switch for Interior Light Source | User request to activate / deactivate an interior light source (switch on/off or automatic mode).
    IntrLiReqFromHmiToVanityLiGroup: interface=IntrLiReq1  # HMI Switch for Interior Light Source | User request to activate / deactivate an interior light source (switch on/off or automatic mode).
    IntrLiReqFromHmiToVanityLiMidLe: interface=IntrLiReq1  # HMI Switch for Interior Light Source | User request to activate / deactivate an interior light source (switch on/off or automatic mode).
    IntrLiReqFromHmiToVanityLiMidRi: interface=IntrLiReq1  # HMI Switch for Interior Light Source | User request to activate / deactivate an interior light source (switch on/off or automatic mode).
    IntrLiReqFromHmiToVanityLiReLe: interface=IntrLiReq1  # HMI Switch for Interior Light Source | User request to activate / deactivate an interior light source (switch on/off or automatic mode).
    IntrLiReqFromHmiToVanityLiReRi: interface=IntrLiReq1  # HMI Switch for Interior Light Source | User request to activate / deactivate an interior light source (switch on/off or automatic mode).
    KeyAcsRem: interface=LockgCenReq1  # Access Remote Key | Request to lock or unlock the vehicle required from remote keys
    KeyAuthn: interface=AntithftPasSt1  # Key Authorization | Status of key authorization by Immobilizer
    KeyInsertSt: interface=KeyInsertSt1  # Key Insert State | Information related to the mechanical key. It indicates whether the key is inserted into key cylinder or not
    KeyMecl: interface=LockgCenReq1  # Door Mechanical Key | Locking request with the mechanical key from the door
    KeyMeclOfDoorLockReLe: interface=LockgCenReq1  # Rear Door Mechanical Key | Locking request with the mechanical key from a rear door
    KeyMeclOfDoorLockReRi: interface=LockgCenReq1  # Rear Door Mechanical Key | Locking request with the mechanical key from a rear door
    KeyMeclOfDrvrDoorLock: interface=LockgCenReq1  # Front Door Mechanical Key | Locking request with the mechanical key from the front door
    KeyMeclOfLidRe: interface=LockgCenReq1  # Rear Lid Door Mechanical Key | Locking request with the mechanical key from the rear lid
    KeyMeclOfPassDoorLock: interface=LockgCenReq1  # Front Door Mechanical Key | Locking request with the mechanical key from the front door
    KeyPadOfLidRe: interface=LockgCenReq1  # Rear Lid Keypad | Request to activate central locking master on the rear lid from lid key pad
    KnobRotyBndlsStep15: interface=KnobRotyBndlsStep15  # Boundless Rotary Knob 15 Steps | The value represents the relative number of steps/positions (out of 15 values) the knob has been moved since the last reported movement. Positive values denote clockwise, negative counter clockwise rotation.
    KnobRotyBndlsStep7: interface=KnobRotyBndlsStep7  # Boundless Rotary Knob 7 Steps | The value represents the relative number of steps/positions (out of 7 values) the knob has been moved since the last reported movement. Positive values denote clockwise, negative counter clockwise rotation.
    LedFbVis: interface=LedCmd1  # Visual Feedback LED | Command to control the light emitting diode (LED) visual feedback
    LiAutReq: interface=LiExtReq1  # Auto Light Request | Request to turn on/off automatic light
    LiDaytiRunng: interface=LiExtCmd1  # Daytime Running Light | This port provides command to turn on/off day time running lights
    LiDaytiRunngIndcn: interface=ExtrLiDisp1  # Daytime Running Light Indication | This port provides Indication to the instrument cluster about the day time running lights on/off status
    LiDaytiRunngOut: interface=LiExtCmd1  # Daytime Running Light Output | This port provides command to turn on/off day time running lights
    LiDimGlb: interface=LiDimGlbCmd1  # Global Dimming Command | This port provides global dimming request for Interior Lights
    LiFlt: interface=LiFltSt1  # Light Source Fault Status | Feedback from the light actuator to be informed of possible fault situation; initial value: NoFlt
    LiFltOfAshtrayLiFrntCen: interface=LiFltSts1  # Interior Light Source Fault Status | Feedback from the light actuators to be informed of possible fault situation; initial value: NoFlt
    LiFltOfAshtrayLiFrntLe: interface=LiFltSt1  # Interior Light Source Fault Status | Feedback from the light actuators to be informed of possible fault situation; initial value: NoFlt
    LiFltOfAshtrayLiFrntRi: interface=LiFltSt1  # Interior Light Source Fault Status | Feedback from the light actuators to be informed of possible fault situation; initial value: NoFlt
    LiFltOfAshtrayLiGroup: interface=LiFltSt1  # Interior Light Source Fault Status | Feedback from the light actuators to be informed of possible fault situation; initial value: NoFlt
    LiFltOfAshtrayLiMidCen: interface=LiFltSt1  # Interior Light Source Fault Status | Feedback from the light actuators to be informed of possible fault situation; initial value: NoFlt
    LiFltOfAshtrayLiMidLe: interface=LiFltSt1  # Interior Light Source Fault Status | Feedback from the light actuators to be informed of possible fault situation; initial value: NoFlt
    LiFltOfAshtrayLiMidRi: interface=LiFltSt1  # Interior Light Source Fault Status | Feedback from the light actuators to be informed of possible fault situation; initial value: NoFlt
    LiFltOfAshtrayLiReCen: interface=LiFltSt1  # Interior Light Source Fault Status | Feedback from the light actuators to be informed of possible fault situation; initial value: NoFlt
    LiFltOfAshtrayLiReLe: interface=LiFltSt1  # Interior Light Source Fault Status | Feedback from the light actuators to be informed of possible fault situation; initial value: NoFlt
    LiFltOfAshtrayLiReRi: interface=LiFltSt1  # Interior Light Source Fault Status | Feedback from the light actuators to be informed of possible fault situation; initial value: NoFlt
    LiFltOfBeamHiLe: interface=LiFltSt1  # Exterior Light Source Fault Status | Feedback for Exterior Light Source Fault Status
    LiFltOfBeamHiRi: interface=LiFltSt1  # Exterior Light Source Fault Status | Feedback for Exterior Light Source Fault Status
    LiFltOfBeamLoLe: interface=LiFltSt1  # Exterior Light Source Fault Status | Feedback for Exterior Light Source Fault Status
    LiFltOfBeamLoRi: interface=LiFltSt1  # Exterior Light Source Fault Status | Feedback for Exterior Light Source Fault Status
    LiFltOfBrkLiLe: interface=LiFltSt1  # Exterior Light Source Fault Status | Feedback for Exterior Light Source Fault Status
    LiFltOfBrkLiRi: interface=LiFltSt1  # Exterior Light Source Fault Status | Feedback for Exterior Light Source Fault Status
    LiFltOfBrkLiTrlrLe: interface=LiFltSt1  # Exterior Light Source Fault Status | Feedback for Exterior Light Source Fault Status
    LiFltOfBrkLiTrlrRi: interface=LiFltSt1  # Exterior Light Source Fault Status | Feedback for Exterior Light Source Fault Status
    LiFltOfCbnLiFrntCen: interface=LiFltSt1  # Interior Light Source Fault Status | Feedback from the light actuators to be informed of possible fault situation; initial value: NoFlt
    LiFltOfCbnLiFrntLe: interface=LiFltSt1  # Interior Light Source Fault Status | Feedback from the light actuators to be informed of possible fault situation; initial value: NoFlt
    LiFltOfCbnLiFrntRi: interface=LiFltSt1  # Interior Light Source Fault Status | Feedback from the light actuators to be informed of possible fault situation; initial value: NoFlt
    LiFltOfCbnLiGroup: interface=LiFltSt1  # Interior Light Source Fault Status | Feedback from the light actuators to be informed of possible fault situation; initial value: NoFlt
    LiFltOfCbnLiMidCen: interface=LiFltSt1  # Interior Light Source Fault Status | Feedback from the light actuators to be informed of possible fault situation; initial value: NoFlt
    LiFltOfCbnLiMidLe: interface=LiFltSt1  # Interior Light Source Fault Status | Feedback from the light actuators to be informed of possible fault situation; initial value: NoFlt
    LiFltOfCbnLiMidRi: interface=LiFltSt1  # Interior Light Source Fault Status | Feedback from the light actuators to be informed of possible fault situation; initial value: NoFlt
    LiFltOfCbnLiReCen: interface=LiFltSt1  # Interior Light Source Fault Status | Feedback from the light actuators to be informed of possible fault situation; initial value: NoFlt
    LiFltOfCbnLiReLe: interface=LiFltSt1  # Interior Light Source Fault Status | Feedback from the light actuators to be informed of possible fault situation; initial value: NoFlt
    LiFltOfCbnLiReRi: interface=LiFltSt1  # Interior Light Source Fault Status | Feedback from the light actuators to be informed of possible fault situation; initial value: NoFlt
    LiFltOfCornrMkrCenLe: interface=LiFltSt1  # Exterior Light Source Fault Status | Feedback for Exterior Light Source Fault Status
    LiFltOfCornrMkrCenRi: interface=LiFltSt1  # Exterior Light Source Fault Status | Feedback for Exterior Light Source Fault Status
    LiFltOfCornrMkrFrntLe: interface=LiFltSt1  # Exterior Light Source Fault Status | Feedback for Exterior Light Source Fault Status
    LiFltOfCornrMkrFrntRi: interface=LiFltSt1  # Exterior Light Source Fault Status | Feedback for Exterior Light Source Fault Status
    LiFltOfCornrMkrReLe: interface=LiFltSt1  # Exterior Light Source Fault Status | Feedback for Exterior Light Source Fault Status
    LiFltOfCornrMkrReRi: interface=LiFltSt1  # Exterior Light Source Fault Status | Feedback for Exterior Light Source Fault Status
    LiFltOfCurbLiFrntLe: interface=LiFltSt1  # Interior Light Source Fault Status | Feedback from the light actuators to be informed of possible fault situation; initial value: NoFlt
    LiFltOfCurbLiFrntRi: interface=LiFltSt1  # Interior Light Source Fault Status | Feedback from the light actuators to be informed of possible fault situation; initial value: NoFlt
    LiFltOfCurbLiGroup: interface=LiFltSt1  # Interior Light Source Fault Status | Feedback from the light actuators to be informed of possible fault situation; initial value: NoFlt
    LiFltOfCurbLiMidLe: interface=LiFltSt1  # Interior Light Source Fault Status | Feedback from the light actuators to be informed of possible fault situation; initial value: NoFlt
    LiFltOfCurbLiMidRi: interface=LiFltSt1  # Interior Light Source Fault Status | Feedback from the light actuators to be informed of possible fault situation; initial value: NoFlt
    LiFltOfCurbLiReLe: interface=LiFltSt1  # Interior Light Source Fault Status | Feedback from the light actuators to be informed of possible fault situation; initial value: NoFlt
    LiFltOfCurbLiReRi: interface=LiFltSt1  # Interior Light Source Fault Status | Feedback from the light actuators to be informed of possible fault situation; initial value: NoFlt
    LiFltOfEngCmptmtLi: interface=LiFltSt1  # Interior Light Source Fault Status | Feedback from the light actuators to be informed of possible fault situation; initial value: NoFlt
    LiFltOfExtrLiSwtIllmn: interface=LiFltSt1  # Interior Light Source Fault Status | Feedback from the light actuators to be informed of possible fault situation; initial value: NoFlt
    LiFltOfFogLiFrntLe: interface=LiFltSt1  # Exterior Light Source Fault Status | Feedback for Exterior Light Source Fault Status
    LiFltOfFogLiFrntRi: interface=LiFltSt1  # Exterior Light Source Fault Status | Feedback for Exterior Light Source Fault Status
    LiFltOfFogLiReLe: interface=LiFltSt1  # Exterior Light Source Fault Status | Feedback for Exterior Light Source Fault Status
    LiFltOfFogLiReRi: interface=LiFltSt1  # Exterior Light Source Fault Status | Feedback for Exterior Light Source Fault Status
    LiFltOfFogLiTrlrLe: interface=LiFltSt1  # Exterior Light Source Fault Status | Feedback for Exterior Light Source Fault Status
    LiFltOfFogLiTrlrRi: interface=LiFltSt1  # Exterior Light Source Fault Status | Feedback for Exterior Light Source Fault Status
    LiFltOfFootwellGroup: interface=LiFltSt1  # Interior Light Source Fault Status | Feedback from the light actuators to be informed of possible fault situation; initial value: NoFlt
    LiFltOfFootwellLiFrntCen: interface=LiFltSt1  # Interior Light Source Fault Status | Feedback from the light actuators to be informed of possible fault situation; initial value: NoFlt
    LiFltOfFootwellLiFrntLe: interface=LiFltSt1  # Interior Light Source Fault Status | Feedback from the light actuators to be informed of possible fault situation; initial value: NoFlt
    LiFltOfFootwellLiFrntRi: interface=LiFltSt1  # Interior Light Source Fault Status | Feedback from the light actuators to be informed of possible fault situation; initial value: NoFlt
    LiFltOfFootwellLiMidCen: interface=LiFltSt1  # Interior Light Source Fault Status | Feedback from the light actuators to be informed of possible fault situation; initial value: NoFlt
    LiFltOfFootwellLiMidLe: interface=LiFltSt1  # Interior Light Source Fault Status | Feedback from the light actuators to be informed of possible fault situation; initial value: NoFlt
    LiFltOfFootwellLiMidRi: interface=LiFltSt1  # Interior Light Source Fault Status | Feedback from the light actuators to be informed of possible fault situation; initial value: NoFlt
    LiFltOfFootwellLiReCen: interface=LiFltSt1  # Interior Light Source Fault Status | Feedback from the light actuators to be informed of possible fault situation; initial value: NoFlt
    LiFltOfFootwellLiReLe: interface=LiFltSt1  # Interior Light Source Fault Status | Feedback from the light actuators to be informed of possible fault situation; initial value: NoFlt
    LiFltOfFootwellLiReRi: interface=LiFltSt1  # Interior Light Source Fault Status | Feedback from the light actuators to be informed of possible fault situation; initial value: NoFlt
    LiFltOfGlvCmptmtLi: interface=LiFltSt1  # Interior Light Source Fault Status | Feedback from the light actuators to be informed of possible fault situation; initial value: NoFlt
    LiFltOfIgnSwtIllmn: interface=LiFltSt1  # Interior Light Source Fault Status | Feedback from the light actuators to be informed of possible fault situation; initial value: NoFlt
    LiFltOfIndcrFrntLe: interface=LiFltSt1  # Exterior Light Source Fault Status | Feedback for Exterior Light Source Fault Status
    LiFltOfIndcrFrntRi: interface=LiFltSt1  # Exterior Light Source Fault Status | Feedback for Exterior Light Source Fault Status
    LiFltOfIndcrReLe: interface=LiFltSt1  # Exterior Light Source Fault Status | Feedback for Exterior Light Source Fault Status
    LiFltOfIndcrReRi: interface=LiFltSt1  # Exterior Light Source Fault Status | Feedback for Exterior Light Source Fault Status
    LiFltOfIndcrSideLe: interface=LiFltSt1  # Exterior Light Source Fault Status | Feedback for Exterior Light Source Fault Status
    LiFltOfIndcrSideRi: interface=LiFltSt1  # Exterior Light Source Fault Status | Feedback for Exterior Light Source Fault Status
    LiFltOfIndcrTrlrLe: interface=LiFltSt1  # Exterior Light Source Fault Status | Feedback for Exterior Light Source Fault Status
    LiFltOfIndcrTrlrRi: interface=LiFltSt1  # Exterior Light Source Fault Status | Feedback for Exterior Light Source Fault Status
    LiFltOfIntrLiGroup0: interface=LiFltSt1  # Interior Light Source Fault Status | Feedback from the light actuators to be informed of possible fault situation; initial value: NoFlt
    LiFltOfIntrLiGroup1: interface=LiFltSt1  # Interior Light Source Fault Status | Feedback from the light actuators to be informed of possible fault situation; initial value: NoFlt
    LiFltOfIntrLiGroup{10..15}: interface=LiFltSt1  # Interior Light Source Fault Status | Feedback from the light actuators to be informed of possible fault situation; initial value: NoFlt
    LiFltOfIntrLiGroup{2..9}: interface=LiFltSt1  # Interior Light Source Fault Status | Feedback from the light actuators to be informed of possible fault situation; initial value: NoFlt
    LiFltOfLampForStopOfBrkLiCenHiMntd: interface=LiFltSt1  # Exterior Light Source Fault Status | Feedback for Exterior Light Source Fault Status
    LiFltOfLiDaytiRunngFrntLe: interface=LiFltSt1  # Exterior Light Source Fault Status | Feedback for Exterior Light Source Fault Status
    LiFltOfLiDaytiRunngFrntRi: interface=LiFltSt1  # Exterior Light Source Fault Status | Feedback for Exterior Light Source Fault Status
    LiFltOfLiForCigaretteLighterIllmnAtTrLe: interface=LiFltSt1  # Interior Light Source Fault Status | Feedback from the light actuators to be informed of possible fault situation; initial value: NoFlt
    LiFltOfLiForCigaretteLighterIllmnAtTrRi: interface=LiFltSt1  # Interior Light Source Fault Status | Feedback from the light actuators to be informed of possible fault situation; initial value: NoFlt
    LiFltOfLiForCigaretteLighterIllmnFrntCen: interface=LiFltSt1  # Interior Light Source Fault Status | Feedback from the light actuators to be informed of possible fault situation; initial value: NoFlt
    LiFltOfLiForCigaretteLighterIllmnFrntLe: interface=LiFltSt1  # Interior Light Source Fault Status | Feedback from the light actuators to be informed of possible fault situation; initial value: NoFlt
    LiFltOfLiForCigaretteLighterIllmnFrntRi: interface=LiFltSt1  # Interior Light Source Fault Status | Feedback from the light actuators to be informed of possible fault situation; initial value: NoFlt
    LiFltOfLiForCigaretteLighterIllmnGroup: interface=LiFltSt1  # Interior Light Source Fault Status | Feedback from the light actuators to be informed of possible fault situation; initial value: NoFlt
    LiFltOfLiForCigaretteLighterIllmnMidCen: interface=LiFltSt1  # Interior Light Source Fault Status | Feedback from the light actuators to be informed of possible fault situation; initial value: NoFlt
    LiFltOfLiForCigaretteLighterIllmnMidLe: interface=LiFltSt1  # Interior Light Source Fault Status | Feedback from the light actuators to be informed of possible fault situation; initial value: NoFlt
    LiFltOfLiForCigaretteLighterIllmnMidRi: interface=LiFltSt1  # Interior Light Source Fault Status | Feedback from the light actuators to be informed of possible fault situation; initial value: NoFlt
    LiFltOfLiForCigaretteLighterIllmnReCen: interface=LiFltSt1  # Interior Light Source Fault Status | Feedback from the light actuators to be informed of possible fault situation; initial value: NoFlt
    LiFltOfLiForCigaretteLighterIllmnReLe: interface=LiFltSt1  # Interior Light Source Fault Status | Feedback from the light actuators to be informed of possible fault situation; initial value: NoFlt
    LiFltOfLiForCigaretteLighterIllmnReRi: interface=LiFltSt1  # Interior Light Source Fault Status | Feedback from the light actuators to be informed of possible fault situation; initial value: NoFlt
    LiFltOfLiForDoorOpenerIllmnFrntLe: interface=LiFltSt1  # Interior Light Source Fault Status | Feedback from the light actuators to be informed of possible fault situation; initial value: NoFlt
    LiFltOfLiForDoorOpenerIllmnFrntRi: interface=LiFltSt1  # Interior Light Source Fault Status | Feedback from the light actuators to be informed of possible fault situation; initial value: NoFlt
    LiFltOfLiForDoorOpenerIllmnGroup: interface=LiFltSt1  # Interior Light Source Fault Status | Feedback from the light actuators to be informed of possible fault situation; initial value: NoFlt
    LiFltOfLiForDoorOpenerIllmnMidLe: interface=LiFltSt1  # Interior Light Source Fault Status | Feedback from the light actuators to be informed of possible fault situation; initial value: NoFlt
    LiFltOfLiForDoorOpenerIllmnMidRi: interface=LiFltSt1  # Interior Light Source Fault Status | Feedback from the light actuators to be informed of possible fault situation; initial value: NoFlt
    LiFltOfLiForDoorOpenerIllmnReLe: interface=LiFltSt1  # Interior Light Source Fault Status | Feedback from the light actuators to be informed of possible fault situation; initial value: NoFlt
    LiFltOfLiForDoorOpenerIllmnReRi: interface=LiFltSt1  # Interior Light Source Fault Status | Feedback from the light actuators to be informed of possible fault situation; initial value: NoFlt
    LiFltOfLiForDoorSillIllmnFrntLe: interface=LiFltSt1  # Interior Light Source Fault Status | Feedback from the light actuators to be informed of possible fault situation; initial value: NoFlt
    LiFltOfLiForDoorSillIllmnFrntRi: interface=LiFltSt1  # Interior Light Source Fault Status | Feedback from the light actuators to be informed of possible fault situation; initial value: NoFlt
    LiFltOfLiForDoorSillIllmnGroup: interface=LiFltSt1  # Interior Light Source Fault Status | Feedback from the light actuators to be informed of possible fault situation; initial value: NoFlt
    LiFltOfLiForDoorSillIllmnMidLe: interface=LiFltSt1  # Interior Light Source Fault Status | Feedback from the light actuators to be informed of possible fault situation; initial value: NoFlt
    LiFltOfLiForDoorSillIllmnMidRi: interface=LiFltSt1  # Interior Light Source Fault Status | Feedback from the light actuators to be informed of possible fault situation; initial value: NoFlt
    LiFltOfLiForDoorSillIllmnReLe: interface=LiFltSt1  # Interior Light Source Fault Status | Feedback from the light actuators to be informed of possible fault situation; initial value: NoFlt
    LiFltOfLiForDoorSillIllmnReRi: interface=LiFltSt1  # Interior Light Source Fault Status | Feedback from the light actuators to be informed of possible fault situation; initial value: NoFlt
    LiFltOfLiForReadingAtRowThrdCen: interface=LiFltSt1  # Interior Light Source Fault Status | Feedback from the light actuators to be informed of possible fault situation; initial value: NoFlt
    LiFltOfLiForReadingAtRowThrdLe: interface=LiFltSt1  # Interior Light Source Fault Status | Feedback from the light actuators to be informed of possible fault situation; initial value: NoFlt
    LiFltOfLiForReadingAtRowThrdRi: interface=LiFltSt1  # Interior Light Source Fault Status | Feedback from the light actuators to be informed of possible fault situation; initial value: NoFlt
    LiFltOfLiForReadingFrntCen: interface=LiFltSt1  # Interior Light Source Fault Status | Feedback from the light actuators to be informed of possible fault situation; initial value: NoFlt
    LiFltOfLiForReadingFrntLe: interface=LiFltSt1  # Interior Light Source Fault Status | Feedback from the light actuators to be informed of possible fault situation; initial value: NoFlt
    LiFltOfLiForReadingFrntRi: interface=LiFltSt1  # Interior Light Source Fault Status | Feedback from the light actuators to be informed of possible fault situation; initial value: NoFlt
    LiFltOfLiForReadingGroup: interface=LiFltSt1  # Interior Light Source Fault Status | Feedback from the light actuators to be informed of possible fault situation; initial value: NoFlt
    LiFltOfLiForReadingReCen: interface=LiFltSt1  # Interior Light Source Fault Status | Feedback from the light actuators to be informed of possible fault situation; initial value: NoFlt
    LiFltOfLiForReadingReLe: interface=LiFltSt1  # Interior Light Source Fault Status | Feedback from the light actuators to be informed of possible fault situation; initial value: NoFlt
    LiFltOfLiForReadingReRi: interface=LiFltSt1  # Interior Light Source Fault Status | Feedback from the light actuators to be informed of possible fault situation; initial value: NoFlt
    LiFltOfLiForSftyBltLockIllmnFrntCen: interface=LiFltSt1  # Interior Light Source Fault Status | Feedback from the light actuators to be informed of possible fault situation; initial value: NoFlt
    LiFltOfLiForSftyBltLockIllmnFrntLe: interface=LiFltSt1  # Interior Light Source Fault Status | Feedback from the light actuators to be informed of possible fault situation; initial value: NoFlt
    LiFltOfLiForSftyBltLockIllmnFrntRi: interface=LiFltSt1  # Interior Light Source Fault Status | Feedback from the light actuators to be informed of possible fault situation; initial value: NoFlt
    LiFltOfLiForSftyBltLockIllmnGroup: interface=LiFltSt1  # Interior Light Source Fault Status | Feedback from the light actuators to be informed of possible fault situation; initial value: NoFlt
    LiFltOfLiForSftyBltLockIllmnMidCen: interface=LiFltSt1  # Interior Light Source Fault Status | Feedback from the light actuators to be informed of possible fault situation; initial value: NoFlt
    LiFltOfLiForSftyBltLockIllmnMidLe: interface=LiFltSt1  # Interior Light Source Fault Status | Feedback from the light actuators to be informed of possible fault situation; initial value: NoFlt
    LiFltOfLiForSftyBltLockIllmnMidRi: interface=LiFltSt1  # Interior Light Source Fault Status | Feedback from the light actuators to be informed of possible fault situation; initial value: NoFlt
    LiFltOfLiForSftyBltLockIllmnReCen: interface=LiFltSt1  # Interior Light Source Fault Status | Feedback from the light actuators to be informed of possible fault situation; initial value: NoFlt
    LiFltOfLiForSftyBltLockIllmnReLe: interface=LiFltSt1  # Interior Light Source Fault Status | Feedback from the light actuators to be informed of possible fault situation; initial value: NoFlt
    LiFltOfLiForSftyBltLockIllmnReRi: interface=LiFltSt1  # Interior Light Source Fault Status | Feedback from the light actuators to be informed of possible fault situation; initial value: NoFlt
    LiFltOfLiLeForRvsg: interface=LiFltSt1  # Exterior Light Source Fault Status | Feedback for Exterior Light Source Fault Status
    LiFltOfLiRiForRvsg: interface=LiFltSt1  # Exterior Light Source Fault Status | Feedback for Exterior Light Source Fault Status
    LiFltOfLiTrlrPlateNr: interface=LiFltSt1  # Exterior Light Source Fault Status | Feedback for Exterior Light Source Fault Status
    LiFltOfLiVehPlateNr: interface=LiFltSt1  # Exterior Light Source Fault Status | Feedback for Exterior Light Source Fault Status
    LiFltOfPrkgLiFrntLe: interface=LiFltSt1  # Exterior Light Source Fault Status | Feedback for Exterior Light Source Fault Status
    LiFltOfPrkgLiFrntRi: interface=LiFltSt1  # Exterior Light Source Fault Status | Feedback for Exterior Light Source Fault Status
    LiFltOfPrkgLiReLe: interface=LiFltSt1  # Exterior Light Source Fault Status | Feedback for Exterior Light Source Fault Status
    LiFltOfPrkgLiReRi: interface=LiFltSt1  # Exterior Light Source Fault Status | Feedback for Exterior Light Source Fault Status
    LiFltOfPrkgLiTrlrLe: interface=LiFltSt1  # Exterior Light Source Fault Status | Feedback for Exterior Light Source Fault Status
    LiFltOfPrkgLiTrlrRi: interface=LiFltSt1  # Exterior Light Source Fault Status | Feedback for Exterior Light Source Fault Status
    LiFltOfPuddleLiFrntLe: interface=LiFltSt1  # Exterior Light Source Fault Status | Feedback for Exterior Light Source Fault Status
    LiFltOfPuddleLiFrntRi: interface=LiFltSt1  # Exterior Light Source Fault Status | Feedback for Exterior Light Source Fault Status
    LiFltOfPuddleLiReLe: interface=LiFltSt1  # Exterior Light Source Fault Status | Feedback for Exterior Light Source Fault Status
    LiFltOfPuddleLiReRi: interface=LiFltSt1  # Exterior Light Source Fault Status | Feedback for Exterior Light Source Fault Status
    LiFltOfSideMkrCenLe: interface=LiFltSt1  # Exterior Light Source Fault Status | Feedback for Exterior Light Source Fault Status
    LiFltOfSideMkrCenRi: interface=LiFltSt1  # Exterior Light Source Fault Status | Feedback for Exterior Light Source Fault Status
    LiFltOfSideMkrFrntLe: interface=LiFltSt1  # Exterior Light Source Fault Status | Feedback for Exterior Light Source Fault Status
    LiFltOfSideMkrFrntRi: interface=LiFltSt1  # Exterior Light Source Fault Status | Feedback for Exterior Light Source Fault Status
    LiFltOfSideMkrReLe: interface=LiFltSt1  # Exterior Light Source Fault Status | Feedback for Exterior Light Source Fault Status
    LiFltOfSideMkrReRi: interface=LiFltSt1  # Exterior Light Source Fault Status | Feedback for Exterior Light Source Fault Status
    LiFltOfSwtIllmnForHzrdWarn: interface=LiFltSt1  # Fault Status of Hazard Warning Switch Illumination | Feedback from the hazard warning switch light actuators to be informed of possible fault situation; initial value: NoFlt
    LiFltOfTrCmptmtGroup: interface=LiFltSt1  # Interior Light Source Fault Status | Feedback from the light actuators to be informed of possible fault situation; initial value: NoFlt
    LiFltOfTrCmptmtLiCen: interface=LiFltSt1  # Interior Light Source Fault Status | Feedback from the light actuators to be informed of possible fault situation; initial value: NoFlt
    LiFltOfTrCmptmtLiLoLe: interface=LiFltSt1  # Interior Light Source Fault Status | Feedback from the light actuators to be informed of possible fault situation; initial value: NoFlt
    LiFltOfTrCmptmtLiLoRi: interface=LiFltSt1  # Interior Light Source Fault Status | Feedback from the light actuators to be informed of possible fault situation; initial value: NoFlt
    LiFltOfTrCmptmtLiUpLe: interface=LiFltSt1  # Interior Light Source Fault Status | Feedback from the light actuators to be informed of possible fault situation; initial value: NoFlt
    LiFltOfTrCmptmtLiUpRi: interface=LiFltSt1  # Interior Light Source Fault Status | Feedback from the light actuators to be informed of possible fault situation; initial value: NoFlt
    LiFltOfTrlrLiLeForRvsg: interface=LiFltSt1  # Exterior Light Source Fault Status | Feedback for Exterior Light Source Fault Status
    LiFltOfTrlrLiRiForRvsg: interface=LiFltSt1  # Exterior Light Source Fault Status | Feedback for Exterior Light Source Fault Status
    LiFltOfVanityLiFrntLe: interface=LiFltSt1  # Interior Light Source Fault Status | Feedback from the light actuators to be informed of possible fault situation; initial value: NoFlt
    LiFltOfVanityLiFrntRi: interface=LiFltSt1  # Interior Light Source Fault Status | Feedback from the light actuators to be informed of possible fault situation; initial value: NoFlt
    LiFltOfVanityLiGroup: interface=LiFltSt1  # Interior Light Source Fault Status | Feedback from the light actuators to be informed of possible fault situation; initial value: NoFlt
    LiFltOfVanityLiMidLe: interface=LiFltSt1  # Interior Light Source Fault Status | Feedback from the light actuators to be informed of possible fault situation; initial value: NoFlt
    LiFltOfVanityLiMidRi: interface=LiFltSt1  # Interior Light Source Fault Status | Feedback from the light actuators to be informed of possible fault situation; initial value: NoFlt
    LiFltOfVanityLiReLe: interface=LiFltSt1  # Interior Light Source Fault Status | Feedback from the light actuators to be informed of possible fault situation; initial value: NoFlt
    LiFltOfVanityLiReRi: interface=LiFltSt1  # Interior Light Source Fault Status | Feedback from the light actuators to be informed of possible fault situation; initial value: NoFlt
    LiHomeCmngAndHomeLvng: interface=LiExtCmd1  # Coming Home Leaving Home Light | This port provides command to activate coming home/leaving home lights
    LiOnWarn: interface=LiOnWarnReq1  # Lights On Warning | This port provides request for chimer (buzzer) signalling the Lights On status e.g. when Ignition was turned off with Lights On and driver door opened.
    LiPlateNr: interface=LiExtCmd1  # License Plate Illumniation | This port provides command to turn on/off number plate lights
    LiPlateNrOut: interface=LiExtCmd1  # License Plate Illumination Output | This port provides command to turn on/off number plate lights
    LiRvsg: interface=LiExtCmd1  # Reversing Light | This port provides command to turn on/off reverse lights
    LiRvsgOut: interface=LiExtCmd1  # Reversing Light Output | This port provides command to turn on/off reverse lights
    LidAcsRemRe: interface=LockgCenReq1  # Access Remote Rear Lid | Request to activate the central locking master by a remote system to have access to the rear lid
    LidReFromHmiExt: interface=LtchRelsReq1  # Lid Rear from HMI External | User request to release/unlock the rear lid of the vehicle. This request is done outside the vehicle.
    LidReFromHmiInt: interface=LtchRelsReq1  # Lid Rear from HMI Internal | User request to release/unlock the rear lid of the vehicle. This request is done inside the vehicle.
    LidReSt: interface=DoorSt1  # Rear Lid Status | Information of the rear lid, indicates whether the lid is opened or closed
    LidReSts: interface=DoorSts1  # Rear Lid Status | Information of the rear lid, indicates whether the lid is opened or closed
    ListOfObjData: interface=ListOfObjData1  # List of Object Data | List of object attributes detected by forward looking sensor. This information is used for Adaptive Cruise Control (ACC), but not limited for ACC.
    ListOfObjDataAftFusn: interface=ListOfObjData1  # List of Object Data after Fusion | List of object attributes after sensor data fusion.
    LockSt: interface=LockSt1  # Doorlock Status | information about the current locking state of the door
    LockStOfDoorLockReLe: interface=LockSt1  # Rear Doorlock State | information about the current locking state of a rear door
    LockStOfDoorLockReRi: interface=LockSt1  # Rear Doorlock State | information about the current locking state of a rear door
    LockStOfDrvrDoorLock: interface=LockSt1  # Front Doorlock State | information about the current locking state of a front door
    LockStOfLidRe: interface=LockSt1  # Rear Lid Lock State | information about the current locking state of the lid
    LockStOfPassDoorLock: interface=LockSt1  # Front Doorlock State | information about the current locking state of a front door
    LockStOfSteerCol: interface=LockStOfSteerCol1  # Steering Column Lock Status | Indication about the locking status of the steering column
    LockStsOfSteerCol: interface=LockStsOfSteerCol1  # Steering Column Lock Status | Indication about the locking status of the steering column
    LockgCen: interface=LockgCenSt1  # Central Locking | Information related to the state of the central locking of the vehicle
    LockgCmd: interface=LockCmd1  # Door Locking Command | Locking command related to a door. This command locks or unlocks the door.
    LockgCmdOfDoorLockReLe: interface=LockCmd1  # Rear Door Locking Command | Locking command related to a rear door. This command locks or unlocks the door.
    LockgCmdOfDoorLockReRi: interface=LockCmd1  # Rear Door Locking Command | Locking command related to a rear door. This command locks or unlocks the door.
    LockgCmdOfDrvrDoorLock: interface=LockCmd1  # Front Door Locking Command | Locking command related to a front door. This command locks or unlocks the door.
    LockgCmdOfLidRe: interface=LockCmd1  # Locking Command of Rear Lid | Locking command related to rear lid. This command locks or unlocks the lid
    LockgCmdOfPassDoorLock: interface=LockCmd1  # Front Door Locking Command | Locking command related to a front door. This command locks or unlocks the door.
    LockgFb: interface=LockgFbReq1  # Locking Feedback | Request to have a feedback on the locking state of the vehicle
    LocnOfPaseKeyls: interface=TrsmPosn1  # Location of Pase Keyless | Needed to know whether the Keyless is inside or outside the car
    LtchRelsOfLidRe: interface=DiagcLtchRels1  # Latch Release of Lid Rear | Diagnostic request to the sensor component to release/unlock the latch of rear lid
    MassgAdj: interface=MassgAdjReq1  # Massage Function Request | Request from Human Machine Interface (HMI) of the desired massage function to be activated
    MassgAdjOfDrvrSeat: interface=MassgAdjReq1  # Massage Function Request | Request from Human Machine Interface (HMI) of the desired massage function to be activated
    MassgAdjOfPassSeat: interface=MassgAdjReq1  # Massage Function Request | Request from Human Machine Interface (HMI) of the desired massage function to be activated
    MassgAdjOfSeatRowFirstMid: interface=MassgAdjReq1  # Massage Function Request | Request from Human Machine Interface (HMI) of the desired massage function to be activated
    MassgAdjOfSeatRowSecLe: interface=MassgAdjReq1  # Massage Function Request | Request from Human Machine Interface (HMI) of the desired massage function to be activated
    MassgAdjOfSeatRowSecMid: interface=MassgAdjReq1  # Massage Function Request | Request from Human Machine Interface (HMI) of the desired massage function to be activated
    MassgAdjOfSeatRowSecRi: interface=MassgAdjReq1  # Massage Function Request | Request from Human Machine Interface (HMI) of the desired massage function to be activated
    MassgAdjOfSeatRowThrdLe: interface=MassgAdjReq1  # Massage Function Request | Request from Human Machine Interface (HMI) of the desired massage function to be activated
    MassgAdjOfSeatRowThrdMid: interface=MassgAdjReq1  # Massage Function Request | Request from Human Machine Interface (HMI) of the desired massage function to be activated
    MassgAdjOfSeatRowThrdRi: interface=MassgAdjReq1  # Massage Function Request | Request from Human Machine Interface (HMI) of the desired massage function to be activated
    MassgSt: interface=MassgAdjSt1  # Massage Function Status | status of the active massage functions
    MassgStOfDrvrSeat: interface=MassgAdjSt1  # Massage Function Status | Inform Human Machine Interface (HMI) about status of the active massage functions
    MassgStOfPassSeat: interface=MassgAdjSt1  # Massage Function Status | Inform Human Machine Interface (HMI) about status of the active massage functions
    MassgStOfSeatRowFirstMid: interface=MassgAdjSt1  # Massage Function Status | Inform Human Machine Interface (HMI) about status of the active massage functions
    MassgStOfSeatRowSecLe: interface=MassgAdjSt1  # Massage Function Status | Inform Human Machine Interface (HMI) about status of the active massage functions
    MassgStOfSeatRowSecMid: interface=MassgAdjSt1  # Massage Function Status | Inform Human Machine Interface (HMI) about status of the active massage functions
    MassgStOfSeatRowSecRi: interface=MassgAdjSt1  # Massage Function Status | Inform Human Machine Interface (HMI) about status of the active massage functions
    MassgStOfSeatRowThrdLe: interface=MassgAdjSt1  # Massage Function Status | Inform Human Machine Interface (HMI) about status of the active massage functions
    MassgStOfSeatRowThrdMid: interface=MassgAdjSt1  # Massage Function Status | Inform Human Machine Interface (HMI) about status of the active massage functions
    MassgStOfSeatRowThrdRi: interface=MassgAdjSt1  # Massage Function Status | Inform Human Machine Interface (HMI) about status of the active massage functions
    MassgSts: interface=MassgAdjSts1  # Massage Function Status | status of the active massage functions
    MassgStsOfDrvrSeat: interface=MassgAdjSts1  # Massage Function Status | Inform Human Machine Interface (HMI) about status of the active massage functions
    MassgStsOfPassSeat: interface=MassgAdjSts1  # Massage Function Status | Inform Human Machine Interface (HMI) about status of the active massage functions
    MassgStsOfSeatRowFirstMid: interface=MassgAdjSts1  # Massage Function Status | Inform Human Machine Interface (HMI) about status of the active massage functions
    MassgStsOfSeatRowSecLe: interface=MassgAdjSts1  # Massage Function Status | Inform Human Machine Interface (HMI) about status of the active massage functions
    MassgStsOfSeatRowSecMid: interface=MassgAdjSts1  # Massage Function Status | Inform Human Machine Interface (HMI) about status of the active massage functions
    MassgStsOfSeatRowSecRi: interface=MassgAdjSts1  # Massage Function Status | Inform Human Machine Interface (HMI) about status of the active massage functions
    MassgStsOfSeatRowThrdLe: interface=MassgAdjSts1  # Massage Function Status | Inform Human Machine Interface (HMI) about status of the active massage functions
    MassgStsOfSeatRowThrdMid: interface=MassgAdjSts1  # Massage Function Status | Inform Human Machine Interface (HMI) about status of the active massage functions
    MassgStsOfSeatRowThrdRi: interface=MassgAdjSts1  # Massage Function Status | Inform Human Machine Interface (HMI) about status of the active massage functions
    Milg: interface=Milg1  # Mileage | Travelled total distance (in km) of the vehicle.
    MirrActnSt: interface=MirrActnSt1  # Mirror Action State | Information on the mirror, it indicates whether the mirror is in action or not
    MirrActvn: interface=MirrMoveCmd1  # Mirror Activation | Command to activate/deactivate the movement of the mirror.
    MirrAdjAutToRestoreProf{0..3}FromHmi: interface=MirrPanAdjAutReq1  # Mirror Auto Adjust Restore Profile {0..3} from HMI | User request to move the mirror automatically according to the profile {0..3}
    MirrAdjAutToStoreProf0FromHmi: interface=MirrPanAdjAutReq1  # Mirror Auto Adjust Store Profile 0 from HMI | User request to store the mirror position in the profile 0.
    MirrAdjAutToStoreProf1FromHmi: interface=MirrPanAdjAutReq1  # Mirror Auto Adjust Store Profile 1 from HMI | User request to store the mirror position in the profile 1.
    MirrAdjAutToStoreProf2FromHmi: interface=MirrPanAdjAutReq1  # Mirror Auto Adjust Store Profile 2 from HMI | User request to store the mirror position in the profile 2.
    MirrAdjAutToStoreProf3FromHmi: interface=MirrPanAdjAutReq1  # Mirror Auto Adjust Store Profile 3 from HMI | User request to store the mirror position in the profile 3.
    MirrDefrstReqFromHmi: interface=DefrstReq1  # Mirror Defrost Request from HMI | Port for Mirror Defrost Request From Hmi
    MirrFlt: interface=MirrFltSt1  # Mirror Fault | Information related to the state of the mirror (broken or not)
    MirrMemPosnStore: interface=MirrPosnStoreToMemReq1  # Store Mirror Position into Memory | Request to store the position of the mirror in a non volatile memory
    MirrMove: interface=MirrMoveReq1  # Mirror Move | Request to move the mirror
    MirrMoveAut: interface=MirrMoveAutReq1  # Mirror Auto Move | Request to move the mirror automatically
    MirrMoveSt: interface=MirrMoveSt1  # Mirror Move Status | Information on the movement of the mirror
    MirrMoveSts: interface=MirrMoveSts1  # Mirror Move Status | Information on the movement of the mirror
    MirrMovmtManFromHmi: interface=PanAdjmtManReq1  # Mirror Manual Movement from HMI | User request to move the axis of the mirror manually in a certain direction.
    MirrPosn: interface=MirrPosnSt1  # Mirror Position | Status of position of the mirror
    MirrPosnRestore: interface=MemOfMirrPosn1  # Restore Mirror Position | Request to restore the position of the mirror saved in a non volatile memory
    MirrPosnStore: interface=MirrPosnStoreReq1  # Mirror Store Position | Request to save and store the position of the mirror
    MonrPReqForTirePMon: interface=MonrPReqForTirePMon1  # Monitored Pressure Request for Tire Pressure Monitoring | Request by driver that the current measured tire pressure values have to be monitored by Tire Pressure Monitoring (direct measuring systems).
    MonrPTarReqForTirePMon: interface=MonrPTarReqForTirePMon1  # Monitored Pressure Target Request for Tire Pressure Monitoring | Indication that the transmitted target tire pressure values have to be monitored by Tire Pressure Monitoring (direct measuring systems).
    NightPanActv: interface=NightPanReq1  # Night Panel Active | This port provides the information about the "Night-Panel-Switch" (e.g. switch for dimming down all interior lights except for speedometer)
    NoFuCutOffReq: interface=NoFuCutOffReq1  # No Fuel Cut Off Request | Request suppression of engine fuel cut off.
    NozHeatrActvn: interface=NozHeatrCmd1  # Nozzle Heater Activation | Activate nozzle and/or tube heating.
    NozHeatrActvnOfNozHeatrFrnt: interface=NozHeatrCmd1  # Activation of Nozzle Heater | Activate nozzle and/or tube heating.
    NozHeatrActvnOfNozHeatrHdlamp: interface=NozHeatrCmd1  # Activation of Nozzle Heater | Activate nozzle and/or tube heating.
    NozHeatrActvnOfNozHeatrRe: interface=NozHeatrCmd1  # Activation of Nozzle Heater | Activate nozzle and/or tube heating.
    NozHeatrSt: interface=NozHeatrSt1  # Nozzle Heater Status | Feedback on nozzle heater status and failure.
    NozHeatrStOfNozHeatrFrnt: interface=NozHeatrSt1  # Status of Nozzle Heater | Feedback on nozzle heater status and failure.
    NozHeatrStOfNozHeatrHdlamp: interface=NozHeatrSt1  # Status of Nozzle Heater | Feedback on nozzle heater status and failure.
    NozHeatrStOfNozHeatrRe: interface=NozHeatrSt1  # Status of Nozzle Heater | Feedback on nozzle heater status and failure.
    NozHeatrSts: interface=NozHeatrSts1  # Nozzle Heater Status | Feedback on nozzle heater status and failure.
    NozHeatrStsOfNozHeatrFrnt: interface=NozHeatrSts1  # Status of Nozzle Heater | Feedback on nozzle heater status and failure.
    NozHeatrStsOfNozHeatrHdlamp: interface=NozHeatrSts1  # Status of Nozzle Heater | Feedback on nozzle heater status and failure.
    NozHeatrStsOfNozHeatrRe: interface=NozHeatrSts1  # Status of Nozzle Heater | Feedback on nozzle heater status and failure.
    ObjTarSelnForFolwCtrl: interface=ObjTarSelnForFolwCtrl1  # Object Target Selection for Follow Control | List of relevant object attributes and prioritization of objects for Follow Control.
    ObstclDstInPrkgSegFrntInnrLe: interface=ObstclDstInPrkgSeg1  # Obstacle Distance Park Segment Front Inner Left | Distance to obstacle detected in front inner left park segment measured by ultrasonic sensors. Triangulation is considered (fused signal).
    ObstclDstInPrkgSegFrntInnrRi: interface=ObstclDstInPrkgSeg1  # Obstacle Distance Park Segment Front Inner Right | Distance to obstacle detected in front inner right park segment measured by ultrasonic sensors. Triangulation is considered (fused signal).
    ObstclDstInPrkgSegFrntOutrLe: interface=ObstclDstInPrkgSeg1  # Obstacle Distance Park Segment Front Outer Left | Distance to obstacle detected in front outer left park segment measured by ultrasonic sensors. Triangulation is considered (fused signal).
    ObstclDstInPrkgSegFrntOutrRi: interface=ObstclDstInPrkgSeg1  # Obstacle Distance Park Segment Front Outer Right | Distance to obstacle detected in front outer right park segment measured by ultrasonic sensors. Triangulation is considered (fused signal).
    ObstclDstInPrkgSegReInnrLe: interface=ObstclDstInPrkgSeg1  # Obstacle Distance Park Segment Rear Inner Left | Distance to obstacle detected in rear inner left park segment measured by ultrasonic sensors. Triangulation is considered (fused signal).
    ObstclDstInPrkgSegReInnrRi: interface=ObstclDstInPrkgSeg1  # Obstacle Distance Park Segment Rear Inner Right | Distance to obstacle detected in rear inner right park segment measured by ultrasonic sensors. Triangulation is considered (fused signal).
    ObstclDstInPrkgSegReOutrLe: interface=ObstclDstInPrkgSeg1  # Obstacle Distance Park Segment Rear Outer Left | Distance to obstacle detected in rear outer left park segment measured by ultrasonic sensors. Triangulation is considered (fused signal).
    ObstclDstInPrkgSegReOutrRi: interface=ObstclDstInPrkgSeg1  # Obstacle Distance Park Segment Rear Outer Right | Distance to obstacle detected in rear outer right park segment measured by ultrasonic sensors. Triangulation is considered (fused signal).
    OccptClassAtDrvr: interface=OccptClass1  # Occupant Class at Driver | classification of driver
    OccptClassAtPass: interface=OccptClass1  # Occupant Class at Passenger | classification of passenger
    OccptClassAtRowFirstMid: interface=OccptClass1  # Occupant Class at Row First Middle | classification of occupant at first row, middle seat position
    OccptClassAtRowSecLe: interface=OccptClass1  # Occupant Class at Row Second Left | classification of occupant at second row, left seat position
    OccptClassAtRowSecMid: interface=OccptClass1  # Occupant Class at Row Second Middle | classification of occupant at second row, middle seat position
    OccptClassAtRowSecRi: interface=OccptClass1  # Occupant Class at Row Second Right | classification of occupant at second row, right seat position
    OccptClassAtRowThrdLe: interface=OccptClass1  # Occupant Class at Row Third Left | classification of occupant at third row, left seat position
    OccptClassAtRowThrdMid: interface=OccptClass1  # Occupant Class at Row Third Middle | classification of occupant at third row, middle seat position
    OccptClassAtRowThrdRi: interface=OccptClass1  # Occupant Class at Row Third Right | classification of occupant at third row, right seat position
    OccptOutOfPosAtDrvr: interface=OccptOutOfPos1  # Occupant out of Position at Driver | Detection of OOP (out of position) condition at driver position
    OccptOutOfPosAtPass: interface=OccptOutOfPos1  # Occupant out of Position at Passenger | Detection of OOP (out of position) condition at passenger position
    OccptOutOfPosAtRowFirstMid: interface=OccptOutOfPos1  # Occupant out of Position at Row First Middle | Detection of OOP (out of position) condition at first row, middle position
    OccptOutOfPosAtRowSecLe: interface=OccptOutOfPos1  # Occupant out of Position at Row Second Left | Detection of OOP (out of position) condition at second row, left position
    OccptOutOfPosAtRowSecMid: interface=OccptOutOfPos1  # Occupant out of Position at Row Second Middle | Detection of OOP (out of position) condition at second row, middle position
    OccptOutOfPosAtRowSecRi: interface=OccptOutOfPos1  # Occupant out of Position at Row Second Right | Detection of OOP (out of position) condition at second row, right position
    OccptOutOfPosAtRowThrdLe: interface=OccptOutOfPos1  # Occupant out of Position at Row Third Left | Detection of OOP (out of position) condition at third row, left position
    OccptOutOfPosAtRowThrdMid: interface=OccptOutOfPos1  # Occupant out of Position at Row Third Middle | Detection of OOP (out of position) condition at third row, middle position
    OccptOutOfPosAtRowThrdRi: interface=OccptOutOfPos1  # Occupant out of Position at Row Third Right | Detection of OOP (out of position) condition at third row, right position
    OccptWghtMeasdAtDrvr: interface=OccptWght1  # Occupant Weight Measured at Driver | weight of driver
    OccptWghtMeasdAtPass: interface=OccptWght1  # Occupant Weight Measured at Passenger | weight of passenger
    OccptWghtMeasdAtRowFirstMid: interface=OccptWght1  # Occupant Weight Measured at Row First Middle | weight of occupant at first row, middle seat position
    OccptWghtMeasdAtRowSecLe: interface=OccptWght1  # Occupant Weight Measured at Row Second Left | weight of occupant at second row, left seat position
    OccptWghtMeasdAtRowSecMid: interface=OccptWght1  # Occupant Weight Measured at Row Second Middle | weight of occupant at second row, middle seat position
    OccptWghtMeasdAtRowSecRi: interface=OccptWght1  # Occupant Weight Measured at Row Second Right | weight of occupant at second row, right seat position
    OccptWghtMeasdAtRowThrdLe: interface=OccptWght1  # Occupant Weight Measured at Row Third Left | weight of occupant at third row, left seat position
    OccptWghtMeasdAtRowThrdMid: interface=OccptWght1  # Occupant Weight Measured at Row Third Middle | weight of occupant at third row, middle seat position
    OccptWghtMeasdAtRowThrdRi: interface=OccptWght1  # Occupant Weight Measured at Row Third Right | weight of occupant at third row, right seat position
    OccptWghtStdAtDrvr: interface=OccptWght1  # Occupant Weight Standard at Driver | weight of driver
    OccptWghtStdAtPass: interface=OccptWght1  # Occupant Weight Standard at Passenger | weight of passenger
    OccptWghtStdAtRowFirstMid: interface=OccptWght1  # Occupant Weight Standard at Row First Middle | weight of occupant at first row, middle seat position
    OccptWghtStdAtRowSecLe: interface=OccptWght1  # Occupant Weight Standard at Row Second Left | weight of occupant at second row, left seat position
    OccptWghtStdAtRowSecMid: interface=OccptWght1  # Occupant Weight Standard at Row Second Middle | weight of occupant at second row, middle seat position
    OccptWghtStdAtRowSecRi: interface=OccptWght1  # Occupant Weight Standard at Row Second Right | weight of occupant at second row, right seat position
    OccptWghtStdAtRowThrdLe: interface=OccptWght1  # Occupant Weight Standard at Row Third Left | weight of occupant at third row, left seat position
    OccptWghtStdAtRowThrdMid: interface=OccptWght1  # Occupant Weight Standard at Row Third Middle | weight of occupant at third row, middle seat position
    OccptWghtStdAtRowThrdRi: interface=OccptWght1  # Occupant Weight Standard at Row Third Right | weight of occupant at third row, right seat position
    OpenClsCmft: interface=LockgCenReq1  # Comfort Open Close | Locking request for comfort devices such as sunroof or windows
    OperMod: interface=OperModSt1  # Operation Mode | This port provides the vehicle operation states. It can be seen as an abstraction and extension of the normal ignition switch position (also called "clamp position") which is traditionally used to guide functional operation of the vehicle. It also includes information about what state the engine is in, i.e. running or not. This port should be used to control which functionalities / components are active in the vehicle. All states have to be implemented in all vehicles, but not necessarily used.
    OutdBri: interface=OutdBriSt1  # Outside Brightness | information on outside brightness
    OutdT: interface=AmbAirT1  # Outside Temperature | Current outside temperature of the vehicle.
    OutpMplSt256: interface=OutpMplSt256  # Multiple Output 256 States | The value is used to generate feedback to the user about the system's current state. The value represents one of 256 states, mutually excluding each other, the system can be in or has changed to.
    OutpMplSt4: interface=OutpMplSt4  # Multiple Output 4 States | The value is used to generate feedback to the user about the system's current state. The value represents one of four states, mutually excluding each other, the system can be in or has changed to.
    OutpMplSt8: interface=OutpMplSt8  # Multiple Output 8 States | The value is used to generate feedback to the user about the system's current state. The value represents one of eight states, mutually excluding each other, the system can be in or has changed to.
    PInDoorAtFrntLe: interface=PExtForOccptPedSfty1  # Pressure in Door at Front Left | Differential pressure measured in front left door of vehicle (locking in driving direction)
    PInDoorAtFrntRi: interface=PExtForOccptPedSfty1  # Pressure in Door at Front Right | Differential pressure measured in front right door of vehicle (locking in driving direction)
    PInDoorAtReLe: interface=PExtForOccptPedSfty1  # Pressure in Door at Rear Left | Differential pressure measured in rear left door of vehicle (locking in driving direction)
    PInDoorAtReRi: interface=PExtForOccptPedSfty1  # Pressure in Door at Rear Right | Differential pressure measured in rear right door of vehicle (locking in driving direction)
    PanAdjAut: interface=SeatAdjAut1  # Automatic Seat Adjust Panel | Indicates the user's demands to store and recall seat positions.
    PanAdjAutOfDrvrSeat: interface=SeatAdjAut1  # Automatic Seat Adjust Panel | Indicates the user's demands to store and recall seat positions.
    PanAdjAutOfPassSeat: interface=SeatAdjAut1  # Automatic Seat Adjust Panel | Indicates the user's demands to store and recall seat positions.
    PanAdjAutOfSeatRowFirstMid: interface=SeatAdjAut1  # Automatic Seat Adjust Panel | Indicates the user's demands to store and recall seat positions.
    PanAdjAutOfSeatRowSecLe: interface=SeatAdjAut1  # Automatic Seat Adjust Panel | Indicates the user's demands to store and recall seat positions.
    PanAdjAutOfSeatRowSecMid: interface=SeatAdjAut1  # Automatic Seat Adjust Panel | Indicates the user's demands to store and recall seat positions.
    PanAdjAutOfSeatRowSecRi: interface=SeatAdjAut1  # Automatic Seat Adjust Panel | Indicates the user's demands to store and recall seat positions.
    PanAdjAutOfSeatRowThrdLe: interface=SeatAdjAut1  # Automatic Seat Adjust Panel | Indicates the user's demands to store and recall seat positions.
    PanAdjAutOfSeatRowThrdMid: interface=SeatAdjAut1  # Automatic Seat Adjust Panel | Indicates the user's demands to store and recall seat positions.
    PanAdjAutOfSeatRowThrdRi: interface=SeatAdjAut1  # Automatic Seat Adjust Panel | Indicates the user's demands to store and recall seat positions.
    PanAdjMan: interface=SeatAdjMan1  # Manual Seat Adjust Panel | Enables the user to activate one or more seat actuators using a manual movement control panel.
    PanAdjManOfDrvrSeat: interface=SeatAdjMan1  # Manual Seat Adjust Panel | Enables the user to activate one or more seat actuators using a manual movement control panel.
    PanAdjManOfPassSeat: interface=SeatAdjMan1  # Manual Seat Adjust Panel | Enables the user to activate one or more seat actuators using a manual movement control panel.
    PanAdjManOfSeatRowFirstMid: interface=SeatAdjMan1  # Manual Seat Adjust Panel | Enables the user to activate one or more seat actuators using a manual movement control panel.
    PanAdjManOfSeatRowSecLe: interface=SeatAdjMan1  # Manual Seat Adjust Panel | Enables the user to activate one or more seat actuators using a manual movement control panel.
    PanAdjManOfSeatRowSecMid: interface=SeatAdjMan1  # Manual Seat Adjust Panel | Enables the user to activate one or more seat actuators using a manual movement control panel.
    PanAdjManOfSeatRowSecRi: interface=SeatAdjMan1  # Manual Seat Adjust Panel | Enables the user to activate one or more seat actuators using a manual movement control panel.
    PanAdjManOfSeatRowThrdLe: interface=SeatAdjMan1  # Manual Seat Adjust Panel | Enables the user to activate one or more seat actuators using a manual movement control panel.
    PanAdjManOfSeatRowThrdMid: interface=SeatAdjMan1  # Manual Seat Adjust Panel | Enables the user to activate one or more seat actuators using a manual movement control panel.
    PanAdjManOfSeatRowThrdRi: interface=SeatAdjMan1  # Manual Seat Adjust Panel | Enables the user to activate one or more seat actuators using a manual movement control panel.
    PanicActvnMan: interface=PanicTog1  # Manual Panic Alarm Activation Switch | Information related to panic alarm activation | Example of usage: driver presses a button in order to start/stop panic alarm warning with horn and/or flashers.
    PanicAlrmSt: interface=PanicAlrmSt1  # Panic Alarm State | State of the panic alarm
    PaseAcsRemKeylsForTrsm: interface=LockgCenReq1  # Pase Access Remote Keyless for Transmission | Request for locking or unlocking from the transmitter of Passive Entry (PASE)
    PaseAcsRemKeylsRxn: interface=LockgCenReq1  # Access Remote Pase Keyless Reception | Request for locking or unlocking from the transmitter to the receiver of Passive Entry (PASE)
    PaseActvn: interface=PaseActvnSt1  # Pase Activation | Information related to the activation of passive entry activity
    PaseIdCfmd: interface=IdCfmdSt1  # Passive Entry Identifier Comfirmed | Information that the Passive entry emitter is known signalised within the state of the identifier: confirmed or not
    PaseKeylsInvld: interface=PaseKeylsInvldSt1  # Pase Keyless Invalid | State on the validity of the functionality passive entry
    PasePanic: interface=PasePanicReq1  # Pase Panic | Request related to the panic alert communicated by the passive entry system
    PassBtnForSeatClima: interface=HmiBtn1  # Passenger Button from HMI for Seat Climatisation | Passenger Button Activation From Hmi (on, off) for Seat Climatisation
    PassDoorKeyPad: interface=LockgCenReq1  # Passenger Door Keypad | Request to activate central locking master from the passenger door key pad
    PassDoorKeyPadOfLidRe: interface=LockgCenReq1  # Passenger Door Keypad Rear Lid | Request to activate central locking master on the rear lid from the passenger door key pad
    PassStgDispForSeatClima: interface=StgDisp1  # Passenger Stage Display for Seat Climatisation to HMI | Feedback to Hmi of Passenger Stage requested
    PassStgForSeatClima: interface=StgReq1  # Passenger Stage Request for Seat Climatisation | Passenger Stage Request (no climatisation, heating level, cooling level)
    PedCrashSevCalcd: interface=CrashSev1  # Pedestrian Crash Severity Caculated | Calculated severity of front crash to pedestrian
    PedCrashYposCalcd: interface=CrashYpos1  # Pedestrian Crash Yposition Calculated | Impact position of pedestrian at front bumper in case of vehicle-to-pedestrian collision
    PinionSteerAgFrntBas: interface=PinionSteerAg1  # Pinion Steering Angle Front Base | Measured pinion steer angle at the front steering device.
    PinionSteerAgFrntMeasd: interface=PinionSteerAg1  # Pinion Steering Angle Front Measured | Calculated pinion steer angle at the front steering device. Conditioned Signal (Filtering, Offset-Compensation, Model-based Plausibility Check, etc.)
    PinionSteerAgFrntRaw: interface=PinionSteerAg1  # Pinion Steering Angle Front Raw | Measured pinion steer angle at the front steering device.
    PinionSteerAgFrntStd: interface=PinionSteerAg1  # Pinion Steering Angle Front Standard | Calculated pinion steer angle at the front steering device. Conditioned Signal (Filtering, Offset-Compensation, Model-based Plausibility Check, etc.)
    PinionSteerAgReBas: interface=PinionSteerAg1  # Pinion Steering Angle Rear Base | Pinion angle at rear wheels (measured) if the rear wheel steering system is rack and pinion based. Conditioned Signal (Filtering, Offset-Compensation, Model-based Plausibility Check, etc.)
    PinionSteerAgReMeasd: interface=PinionSteerAg1  # Pinion Steering Angle Rear Measured | Pinion angle at rear wheels (measured) if the rear wheel steering system is rack and pinion based. Conditioned Signal (Filtering, Offset-Compensation, Model-based Plausibility Check, etc.)
    PinionSteerAgReRaw: interface=PinionSteerAg1  # Pinion Steering Angle Rear Raw | Pinion angle at rear wheels (measured) if the rear wheel steering system is rack and pinion based. Conditioned Signal (Filtering, Offset-Compensation, Model-based Plausibility Check, etc.)
    PinionSteerAgReStd: interface=PinionSteerAg1  # Pinion Steering Angle Rear Standard | Pinion angle at rear wheels (measured) if the rear wheel steering system is rack and pinion based. Conditioned Signal (Filtering, Offset-Compensation, Model-based Plausibility Check, etc.)
    PinionSteerAgSpdFrntMeasd: interface=PinionSteerAgSpd1  # Pinion Steering Angle Speed Front Measured | Calculated pinion steer angle speed at the front steering device. Conditioned Signal (Filtering, Offset-Compensation, Model-based Plausibility Check, etc.)
    PinionSteerAgSpdFrntStd: interface=PinionSteerAgSpd1  # Pinion Steering Angle Speed Front Standard | Calculated pinion steer angle speed at the front steering device. Conditioned Signal (Filtering, Offset-Compensation, Model-based Plausibility Check, etc.)
    PinionSteerAgSpdReMeasd: interface=PinionSteerAgSpd1  # Pinion Steering Angle Speed Rear Measured | Pinion speed at rear wheels (measured) if the rear wheel steering system is rack and pinion based. Conditioned Signal (Filtering, Offset-Compensation, Model-based Plausibility Check, etc.)
    PinionSteerAgSpdReStd: interface=PinionSteerAgSpd1  # Pinion Steering Angle Speed Rear Standard | Pinion speed at rear wheels (measured) if the rear wheel steering system is rack and pinion based. Conditioned Signal (Filtering, Offset-Compensation, Model-based Plausibility Check, etc.)
