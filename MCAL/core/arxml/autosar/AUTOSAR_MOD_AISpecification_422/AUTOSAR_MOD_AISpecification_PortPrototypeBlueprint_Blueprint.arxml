[part 1 of 3: package /AUTOSAR/AISpecification/PortPrototypeBlueprints_Blueprint]
AUTOSAR XML (schema 4-2-2)
package /AUTOSAR/AISpecification/PortPrototypeBlueprints_Blueprint
  2154 x port prototype blueprint:
    AArbnRes: interface=AArbnRes1  # Acceleration Arbitration Result | Feedback from Vehicle Longitudinal Control (VLC) to driver assistance systems (e.g. Adaptive Cruise Control (ACC)) and other systems: Information about which acceleration value is output from arbitration of VLC.
    ALatAtApilLe: interface=AExtForOccptPedSfty1  # Acceleration Lateral at Apillar Left | Lateral high-g acceleration measured at left A-Pillar (locking in driving direction)
    ALatAtApilLe1: interface=AExtForOccptPedSfty2  # Acceleration Lateral at Apillar Left | Lateral high-g acceleration measured at left A-Pillar (locking in driving direction)
    ALatAtApilRi: interface=AExtForOccptPedSfty1  # Acceleration Lateral at Apillar Right | Lateral high-g acceleration measured at right A-Pillar (locking in driving direction)
    ALatAtApilRi1: interface=AExtForOccptPedSfty2  # Acceleration Lateral at Apillar Right | Lateral high-g acceleration measured at right A-Pillar (locking in driving direction)
    ALatAtBpilLe: interface=AExtForOccptPedSfty1  # Acceleration Lateral at Bpillar Left | Lateral high-g acceleration measured at left B-Pillar (locking in driving direction)
    ALatAtBpilLe1: interface=AExtForOccptPedSfty2  # Acceleration Lateral at Bpillar Left | Lateral high-g acceleration measured at left B-Pillar (locking in driving direction)
    ALatAtBpilRi: interface=AExtForOccptPedSfty1  # Acceleration Lateral at Bpillar Right | Lateral high-g acceleration measured at right B-Pillar (locking in driving direction)
    ALatAtBpilRi1: interface=AExtForOccptPedSfty2  # Acceleration Lateral at Bpillar Right | Lateral high-g acceleration measured at right B-Pillar (locking in driving direction)
    ALatAtCen: interface=ACenForOccptPedSfty1  # Acceleration Lateral at Central | Lateral high-g acceleration measured in or nearby center of gravity of vehicle
    ALatAtCen1: interface=ACenForOccptPedSfty2  # Acceleration Lateral at Central | Lateral high-g acceleration measured in or nearby center of gravity of vehicle
    ALatAtCenWithRngLo: interface=ALoForOccptPedSfty1  # Acceleration Lateral at Central Low Range | Lateral low range acceleration measured in or nearby center of gravity of vehicle
    ALatAtCenWithRngMid: interface=AMidForOccptPedSfty1  # Acceleration Lateral at Central Midlde Range | Lateral mid range acceleration measured in or nearby center of gravity of vehicle
    ALatAtCpilLe: interface=AExtForOccptPedSfty1  # Acceleration Lateral at Cpillar Left | Lateral high-g acceleration measured at left C-Pillar (locking in driving direction)
    ALatAtCpilLe1: interface=AExtForOccptPedSfty2  # Acceleration Lateral at Cpillar Left | Lateral high-g acceleration measured at left C-Pillar (locking in driving direction)
    ALatAtCpilRi: interface=AExtForOccptPedSfty1  # Acceleration Lateral at Cpillar Right | Lateral high-g acceleration measured at right C-Pillar (locking in driving direction)
    ALatAtCpilRi1: interface=AExtForOccptPedSfty2  # Acceleration Lateral at Cpillar Right | Lateral high-g acceleration measured at right C-Pillar (locking in driving direction)
    ALatAtFrntLe: interface=AExtForOccptPedSfty1  # Acceleration Lateral at Front Left | Lateral high-g acceleration measured on front left side of vehicle (locking in driving direction)
    ALatAtFrntLe1: interface=AExtForOccptPedSfty2  # Acceleration Lateral at Front Left | Lateral high-g acceleration measured on front left side of vehicle (locking in driving direction)
    ALatAtFrntMid: interface=AExtForOccptPedSfty1  # Acceleration Lateral at Front Middle | Lateral high-g acceleration measured on middle of front of vehicle (locking in driving direction)
    ALatAtFrntMid1: interface=AExtForOccptPedSfty2  # Acceleration Lateral at Front Middle | Lateral high-g acceleration measured on middle of front of vehicle (locking in driving direction)
    ALatAtFrntRi: interface=AExtForOccptPedSfty1  # Acceleration Lateral at Front Right | Lateral high-g acceleration measured on front right side of vehicle (locking in driving direction)
    ALatAtFrntRi1: interface=AExtForOccptPedSfty2  # Acceleration Lateral at Front Right | Lateral high-g acceleration measured on front right side of vehicle (locking in driving direction)
    ALatAtReLe: interface=AExtForOccptPedSfty1  # Acceleration Lateral at Rear Left | Lateral high-g acceleration measured on rear left side of vehicle (locking in driving direction)
    ALatAtReLe1: interface=AExtForOccptPedSfty2  # Acceleration Lateral at Rear Left | Lateral high-g acceleration measured on rear left side of vehicle (locking in driving direction)
    ALatAtReMid: interface=AExtForOccptPedSfty1  # Acceleration Lateral at Rear Middle | Lateral high-g acceleration measured on middle of rear of vehicle (locking in driving direction)
    ALatAtReMid1: interface=AExtForOccptPedSfty2  # Acceleration Lateral at Rear Middle | Lateral high-g acceleration measured on middle of rear of vehicle (locking in driving direction)
    ALatAtReRi: interface=AExtForOccptPedSfty1  # Acceleration Lateral at Rear Right | Lateral high-g acceleration measured on rear right side of vehicle (locking in driving direction)
    ALatAtReRi1: interface=AExtForOccptPedSfty2  # Acceleration Lateral at Rear Right | Lateral high-g acceleration measured on rear right side of vehicle (locking in driving direction)
    ALatBas: interface=ALat1  # Acceleration Lateral Base | Lateral acceleration measured at sensor position; compensated for orientation. Coordinate system according to ISO 8855.
    ALatMeasdByEsc: interface=ALat1  # Acceleration Lateral Measured by ESC | Lateral acceleration based on accelerometer provided by Electronic Stability Control (ESC) Compensated for long term drift. Coordinate system according to ISO 8855. | Transformation into Center of Gravity (COG) not relevant for known receivers.
    ALatMeasdWithRollCmpByEsc: interface=ALat1  # Acceleration Lateral Measured with Roll Compensation by ESC | Lateral acceleration estimated for vehicle COG (ISO 10392) provided by Electronic Stability Control (ESC). Coordinate system according to ISO 8855. Compensated for roll movement of the vehicle body. Compensated for long term drift.
    ALatOnDoorAtFrntLe: interface=AExtForOccptPedSfty1  # Acceleration Lateral on Door at Front Left | Lateral high-g acceleration measured in front left door of vehicle (locking in driving direction)
    ALatOnDoorAtFrntLe1: interface=AExtForOccptPedSfty2  # Acceleration Lateral on Door at Front Left | Lateral high-g acceleration measured in front left door of vehicle (locking in driving direction)
    ALatOnDoorAtFrntRi: interface=AExtForOccptPedSfty1  # Acceleration Lateral on Door at Front Right | Lateral high-g acceleration measured in front right door of vehicle (locking in driving direction)
    ALatOnDoorAtFrntRi1: interface=AExtForOccptPedSfty2  # Acceleration Lateral on Door at Front Right | Lateral high-g acceleration measured in front right door of vehicle (locking in driving direction)
    ALatOnDoorAtReLe: interface=AExtForOccptPedSfty1  # Acceleration Lateral on Door at Rear Left | Lateral high-g acceleration measured in rear left door of vehicle (locking in driving direction)
    ALatOnDoorAtReLe1: interface=AExtForOccptPedSfty2  # Acceleration Lateral on Door at Rear Left | Lateral high-g acceleration measured in rear left door of vehicle (locking in driving direction)
    ALatOnDoorAtReRi: interface=AExtForOccptPedSfty1  # Acceleration Lateral on Door at Rear Right | Lateral high-g acceleration measured in rear right door of vehicle (locking in driving direction)
    ALatOnDoorAtReRi1: interface=AExtForOccptPedSfty2  # Acceleration Lateral on Door at Rear Right | Lateral high-g acceleration measured in rear right door of vehicle (locking in driving direction)
    ALatRaw: interface=ALat1  # Acceleration Lateral Raw | Lateral acceleration measured at sensor position; compensated for orientation. Coordinate system according to ISO 8855.
    ALatStdByEsc: interface=ALat1  # Acceleration Lateral Standard by ESC | Lateral acceleration based on accelerometer provided by Electronic Stability Control (ESC) Compensated for long term drift. Coordinate system according to ISO 8855. | Transformation into Center of Gravity (COG) not relevant for known receivers.
    ALatStdWithRollCmpByEsc: interface=ALat1  # Acceleration Lateral Standard with Roll Compensation by ESC | Lateral acceleration estimated for vehicle COG (ISO 10392) provided by Electronic Stability Control (ESC). Coordinate system according to ISO 8855. Compensated for roll movement of the vehicle body. Compensated for long term drift.
    ALgtAtApilLe: interface=AExtForOccptPedSfty1  # Acceleration Longitudinal at Apillar Left | Longitudinal high-g acceleration measured at left A-Pillar (locking in driving direction)
    ALgtAtApilLe1: interface=AExtForOccptPedSfty2  # Acceleration Longitudinal at Apillar Left | Longitudinal high-g acceleration measured at left A-Pillar (locking in driving direction)
    ALgtAtApilRi: interface=AExtForOccptPedSfty1  # Acceleration Longitudinal at Apillar Right | Longitudinal high-g acceleration measured at right A-Pillar (locking in driving direction)
    ALgtAtApilRi1: interface=AExtForOccptPedSfty2  # Acceleration Longitudinal at Apillar Right | Longitudinal high-g acceleration measured at right A-Pillar (locking in driving direction)
    ALgtAtBpilLe: interface=AExtForOccptPedSfty1  # Acceleration Longitudinal at Bpillar Left | Longitudinal high-g acceleration measured at left B-Pillar (locking in driving direction)
    ALgtAtBpilLe1: interface=AExtForOccptPedSfty2  # Acceleration Longitudinal at Bpillar Left | Longitudinal high-g acceleration measured at left B-Pillar (locking in driving direction)
    ALgtAtBpilRi: interface=AExtForOccptPedSfty1  # Acceleration Longitudinal at Bpillar Right | Longitudinal high-g acceleration measured at right B-Pillar (locking in driving direction)
    ALgtAtBpilRi1: interface=AExtForOccptPedSfty2  # Acceleration Longitudinal at Bpillar Right | Longitudinal high-g acceleration measured at right B-Pillar (locking in driving direction)
    ALgtAtCen: interface=ACenForOccptPedSfty1  # Acceleration Longitudinal at Central | Longitudinal high-g acceleration measured in or nearby center of gravity of vehicle
    ALgtAtCen1: interface=ACenForOccptPedSfty2  # Acceleration Longitudinal at Central | Longitudinal high-g acceleration measured in or nearby center of gravity of vehicle
    ALgtAtCenWithRngLo: interface=ALoForOccptPedSfty1  # Acceleration Longitudinal at Central Low Range | Longitudinal low range acceleration measured in or nearby center of gravity of vehicle
    ALgtAtCenWithRngMid: interface=AMidForOccptPedSfty1  # Acceleration Longitudinal at Central Middle Range | Longitudinal mid range acceleration measured in or nearby center of gravity of vehicle
    ALgtAtCpilLe: interface=AExtForOccptPedSfty1  # Acceleration Longitudinal at Cpillar Left | Longitudinal high-g acceleration measured at left C-Pillar (locking in driving direction)
    ALgtAtCpilLe1: interface=AExtForOccptPedSfty2  # Acceleration Longitudinal at Cpillar Left | Longitudinal high-g acceleration measured at left C-Pillar (locking in driving direction)
    ALgtAtCpilRi: interface=AExtForOccptPedSfty1  # Acceleration Longitudinal at Cpillar Right | Longitudinal high-g acceleration measured at right C-Pillar (locking in driving direction)
    ALgtAtCpilRi1: interface=AExtForOccptPedSfty2  # Acceleration Longitudinal at Cpillar Right | Longitudinal high-g acceleration measured at right C-Pillar (locking in driving direction)
    ALgtAtFrntLe: interface=AExtForOccptPedSfty1  # Acceleration Longitudinal at Front Left | Longitudinal high-g acceleration measured on front left side of vehicle (locking in driving direction)
    ALgtAtFrntLe1: interface=AExtForOccptPedSfty2  # Acceleration Longitudinal at Front Left | Longitudinal high-g acceleration measured on front left side of vehicle (locking in driving direction)
    ALgtAtFrntMid: interface=AExtForOccptPedSfty1  # Acceleration Longitudinal at Front Middle | Longitudinal high-g acceleration measured on middle of front of vehicle (locking in driving direction)
    ALgtAtFrntMid1: interface=AExtForOccptPedSfty2  # Acceleration Longitudinal at Front Middle | Longitudinal high-g acceleration measured on middle of front of vehicle (locking in driving direction)
    ALgtAtFrntRi: interface=AExtForOccptPedSfty1  # Acceleration Longitudinal at Front Right | Longitudinal high-g acceleration measured on front right side of vehicle (locking in driving direction)
    ALgtAtFrntRi1: interface=AExtForOccptPedSfty2  # Acceleration Longitudinal at Front Right | Longitudinal high-g acceleration measured on front right side of vehicle (locking in driving direction)
    ALgtAtReLe: interface=AExtForOccptPedSfty1  # Acceleration Longitudinal at Rear Left | Longitudinal high-g acceleration measured on rear left side of vehicle (locking in driving direction)
    ALgtAtReLe1: interface=AExtForOccptPedSfty2  # Acceleration Longitudinal at Rear Left | Longitudinal high-g acceleration measured on rear left side of vehicle (locking in driving direction)
    ALgtAtReMid: interface=AExtForOccptPedSfty1  # Acceleration Longitudinal at Rear Middle | Longitudinal high-g acceleration measured on middle of rear of vehicle (locking in driving direction)
    ALgtAtReMid1: interface=AExtForOccptPedSfty2  # Acceleration Longitudinal at Rear Middle | Longitudinal high-g acceleration measured on middle of rear of vehicle (locking in driving direction)
    ALgtAtReRi: interface=AExtForOccptPedSfty1  # Acceleration Longitudinal at Rear Right | Longitudinal high-g acceleration measured on rear right side of vehicle (locking in driving direction)
    ALgtAtReRi1: interface=AExtForOccptPedSfty2  # Acceleration Longitudinal at Rear Right | Longitudinal high-g acceleration measured on rear right side of vehicle (locking in driving direction)
    ALgtBas: interface=ALgt1  # Acceleration Longitudinal Base | Longitudinal acceleration measured at sensor position; compensated for orientation. Coordinate system according to ISO 8855.
    ALgtMeasd: interface=ALgt1  # Acceleration Longitudinal Measured | Longitudinal acceleration based on accelerometer. Compensated for long term drift. Coordinate system according to ISO 8855. | Transformation into Center of Gravity (COG) not relevant for known receivers.
    ALgtMeasdFromWhlSpd: interface=ALgt1  # Acceleration Longitudinal Measured from Wheel Speed | Longitudinal acceleration based on wheel speeds. Coordinate system according to ISO 8855. | Degraded during slip control. Invalid in case of failure of slip control functions.
    ALgtMeasdWithPitchCmp: interface=ALgt1  # Acceleration Longitudinal Measured with Pitch Compensation | Longitudinal acceleration based on accelerometer. Coordinate system according to ISO 8855. Compensated for pitch movement of the vehicle body. Compensated for long term drift. | Transformation into Center of Gravity (COG) not relevant for known receivers.
    ALgtOnDoorAtFrntLe: interface=AExtForOccptPedSfty1  # Acceleration Longitudinal on Door at Front Left | Longitudinal high-g acceleration measured in front left door of vehicle (locking in driving direction)
    ALgtOnDoorAtFrntLe1: interface=AExtForOccptPedSfty2  # Acceleration Longitudinal on Door at Front Left | Longitudinal high-g acceleration measured in front left door of vehicle (locking in driving direction)
    ALgtOnDoorAtFrntRi: interface=AExtForOccptPedSfty1  # Acceleration Longitudinal on Door at Front Right | Longitudinal high-g acceleration measured in front right door of vehicle (locking in driving direction)
    ALgtOnDoorAtFrntRi1: interface=AExtForOccptPedSfty2  # Acceleration Longitudinal on Door at Front Right | Longitudinal high-g acceleration measured in front right door of vehicle (locking in driving direction)
    ALgtOnDoorAtReLe: interface=AExtForOccptPedSfty1  # Acceleration Longitudinal on Door at Rear Left | Longitudinal high-g acceleration measured in rear left door of vehicle (locking in driving direction)
    ALgtOnDoorAtReLe1: interface=AExtForOccptPedSfty2  # Acceleration Longitudinal on Door at Rear Left | Longitudinal high-g acceleration measured in rear left door of vehicle (locking in driving direction)
    ALgtOnDoorAtReRi: interface=AExtForOccptPedSfty1  # Acceleration Longitudinal on Door at Rear Right | Longitudinal high-g acceleration measured in rear right door of vehicle (locking in driving direction)
    ALgtOnDoorAtReRi1: interface=AExtForOccptPedSfty2  # Acceleration Longitudinal on Door at Rear Right | Longitudinal high-g acceleration measured in rear right door of vehicle (locking in driving direction)
    ALgtRaw: interface=ALgt1  # Acceleration Longitudinal Raw | Longitudinal acceleration measured at sensor position; compensated for orientation. Coordinate system according to ISO 8855.
    ALgtStd: interface=ALgt1  # Acceleration Longitudinal Standard | Longitudinal acceleration based on accelerometer. Compensated for long term drift. Coordinate system according to ISO 8855. | Transformation into Center of Gravity (COG) not relevant for known receivers.
    ALgtStdFromWhlSpd: interface=ALgt1  # Acceleration Longitudinal Standard from Wheel Speed | Longitudinal acceleration based on wheel speeds. Coordinate system according to ISO 8855. | Degraded during slip control. Invalid in case of failure of slip control functions.
    ALgtStdWithPitchCmp: interface=ALgt1  # Acceleration Longitudinal Standard with Pitch Compensation | Longitudinal acceleration based on accelerometer. Coordinate system according to ISO 8855. Compensated for pitch movement of the vehicle body. Compensated for long term drift. | Transformation into Center of Gravity (COG) not relevant for known receivers.
    AOnBmpAtFrntLe: interface=AExtForOccptPedSfty1  # Acceleration on Bumper at Front Left | Longitudinal high-g acceleration measured in front bumper at left side of vehicle (looking in driving direction)
    AOnBmpAtFrntLe1: interface=AExtForOccptPedSfty2  # Acceleration on Bumper at Front Left | Longitudinal high-g acceleration measured in front bumper at left side of vehicle (looking in driving direction)
    AOnBmpAtFrntMid: interface=AExtForOccptPedSfty1  # Acceleration on Bumper at Front Middle | Longitudinal high-g acceleration measured in front bumper in middle of vehicle (looking in driving direction)
    AOnBmpAtFrntMid1: interface=AExtForOccptPedSfty2  # Acceleration on Bumper at Front Middle | Longitudinal high-g acceleration measured in front bumper in middle of vehicle (looking in driving direction)
    AOnBmpAtFrntMidLe: interface=AExtForOccptPedSfty1  # Acceleration on Bumper at Front Middle Left | Longitudinal high-g acceleration measured in front bumper at middle left side of vehicle (looking in driving direction)
    AOnBmpAtFrntMidLe1: interface=AExtForOccptPedSfty2  # Acceleration on Bumper at Front Middle Left | Longitudinal high-g acceleration measured in front bumper at middle left side of vehicle (looking in driving direction)
    AOnBmpAtFrntMidRi: interface=AExtForOccptPedSfty1  # Acceleration on Bumper at Front Middle Right | Longitudinal high-g acceleration measured in front bumper at middle right side of vehicle (looking in driving direction)
    AOnBmpAtFrntMidRi1: interface=AExtForOccptPedSfty2  # Acceleration on Bumper at Front Middle Right | Longitudinal high-g acceleration measured in front bumper at middle right side of vehicle (looking in driving direction)
    AOnBmpAtFrntRi: interface=AExtForOccptPedSfty1  # Acceleration on Bumper at Front Right | Longitudinal high-g acceleration measured in front bumper at right side of vehicle (looking in driving direction)
    AOnBmpAtFrntRi1: interface=AExtForOccptPedSfty2  # Acceleration on Bumper at Front Right | Longitudinal high-g acceleration measured in front bumper at right side of vehicle (looking in driving direction)
    AReqForCmft: interface=AReqForCmft1  # Acceleration Request for Comfort | Cluster of Data Elements regarding acceleration and jerk requests from Adaptive Cruise Control (ACC) to Vehicle Longitudinal Control (VLC). This information is used for comfort reasons.
    AReqForCmftByCrsCtrlFree: interface=AReqForCmft1  # Acceleration Request for Comfort by Cruise Control Free | Cluster of information regarding acceleration and jerk commands from Free Cruise Control (CrsCtrlFree) to Follow Control and Acceleration Arbitration (FolwCtrlAndAArbn).
    AUpwAtCen: interface=ACenForOccptPedSfty1  # Acceleration Upward at Central | Upward high-g acceleration measured in or nearby center of gravity of vehicle
    AUpwAtCen1: interface=ACenForOccptPedSfty2  # Acceleration Upward at Central | Upward high-g acceleration measured in or nearby center of gravity of vehicle
    AUpwAtCenWithRngLo: interface=ALoForOccptPedSfty1  # Acceleration Upward at Central Low Range | Upward low range acceleration measured in or nearby center of gravity of vehicle
    AUpwAtCenWithRngMid: interface=AMidForOccptPedSfty1  # Acceleration Upward at Central Midlde Range | Upward mid range acceleration measured in or nearby center of gravity of vehicle
    AbsCtrlActvForWhl: interface=AbsCtrlActvForWhl1  # ABS Control Active for Wheel | Antilock Braking System (ABS) control is active (Vector of 4). Information for Roll Stability Control (RSC) only
    AbsCtrlIndcn: interface=AbsCtrlIndcn1  # ABS Control Indication | Antilock Braking System (ABS) control is active.
    AbsCtrlIntvg: interface=AbsCtrlIntvg1  # ABS Control Intervening | Antilock Braking System's (ABS) control is active (at least one wheel)
    AbsCtrlOvrdnByRsc: interface=CtrlOvrdnByRsc1  # ABS Control Overridden by RSC | Flag indicating Roll Stability Control (RSC) brake torque overrides Antilock Braking System (ABS). This enables RSC to request more braking torque than ABS. For wheel lift detection. (Vector of 4)
    AbsFlgActv: interface=AbsCtrlIntvg1  # Antilock Braking System (ABS) Control Active | Antilock Braking System (ABS) control is active (at least one wheel) - 0 = No wheel is in Antilock Braking System (ABS) control - 1 = At least one wheel is in Antilock Braking System (ABS) control
    AcTq: interface=AcTq1  # Mechanical Torque for A/C Compressor | Mechanical torque for Air Conditioning (A/C) compressor. This value must take into account all relevant dynamic effects, e.g. transient torque increase during activation of the Air Conditioning (A/C) compressor. It is converted to engine crankshaft torque by the provider. | Default value after reset is zero.
    AcTqReq: interface=AcTqReq1  # Requested Mechanical Torque for A/C Compressor | Requested mechanical torque for Air Conditioning (A/C) compressor. This value represents the torque consumption in a predicted future state. It is converted to engine crankshaft torque by the provider. Examples of realization: Before activation of the Air Conditioning (A/C) compressor this interface could contain either - the predicted highest torque consumption during the activation process. - the predicted torque consumption in steady state after the activation is finished. | Default value after reset is zero.
    AccActv: interface=AccCtrlActv1  # Adaptive Cruise Control Active | Switch operated by driver to make Adaptive Cruise Control stand-by mode is on.
    AccCtrlActv: interface=AccCtrlActv1  # Adaptive Cruise Control Control Active | Adaptive Cruise Control is engaged and active. This information is used for display feedback for driver as well.
    AccVehDetdIndcn: interface=AccVehDetd1  # Adaptive Cruise Control Vehicle Detected Indication | Target vehicle for Adaptive Cruise Control is detected. This information is used for display feedback for driver.
    AccYawRateSpc: interface=YawRate1  # ACC Yaw Rate Specific | Yaw rate calculated along vehicle z-axis provided by Adaptive Cruise Control Vehicle State Observer. Coordinate system according to ISO 8855. Filtered and offset-compensated based on YawRateBase.
    AccrPedlRat: interface=AccrPedlRat1  # Accelerator Pedal Ratio | Position of the accelerator pedal, not "simulated" value for e.g. Adaptive Cruise Control (ACC),driver. Evaluated signal jitter free without time filtering, including plausibility check, monitoring and replacement value. 0% is driver off the pedal, offsets are removed. 100% must be ensured at end point of the pedal. Shall cover the 100% as well | signal is sent with initialisation
    AccrPedlRatFild: interface=AccrPedlRatFild1  # Filtered Accelerator Pedal Ratio | shaped / time filtered value based on accelerator pedal ratio. (e.g. PT1 with calibratable time constant) Calibration shall make it sure that the signal range is 0 - 100%. 0% is driver off the pedal, offsets are removed. 100% must be ensured at end point of the pedal. Shall cover the 100% as well;
    AccrPedlRatGrdt: interface=AccrPedlRatGrdt1  # Accelerator Pedal Ratio Gradient | time-derivative of position of the accelerator pedal
    AccrPedlRatVirt: interface=DrvReqRatVirtAccrPedl1  # Accelerator Pedal Ratio Virtual | Driver accelerator pedal request, including virtual pedal ratio (e.g. for Adaptive Cruise Control (ACC) or Cruise Control (CC)). Evaluated signal, jitter free, including plausibility check, monitoring and replacement value but without filtering. 0%: (Virtual) driver is off the pedal, offsets are removed. 100% : Must be ensured at end point of the pedal. Shall cover the 100% as well. | Example of realization: Within Adaptive Cruise Control (ACC) / Cruise Control (CC) this is based on the total requested propulsion wheel torque by the driver or Vehicle Longitudinal Control (VLC), otherwise this is the "Accelerator Pedal Ratio" value.Signal is sent with initialisation.
    AcsKeyls: interface=LockgCenReq1  # Keyless Access | Request of central locking from keyless access
    AcsOfSeatRe: interface=EntryReq1  # Rear Seat Access | Indicates the user's demand for access to the rear seats. For cars with only 2 front doors there might be a feature provided called like "easy entry", which facilitates the access to the rear seats. This is usually achieved by means of moving the according front seat (driver side or passenger side) or seat back.
    AcsOfSeatReByDrvrSeat: interface=EntryReq1  # Rear Seat Access | Indicates the user's demand for access to the rear seats. For cars with only 2 front doors there might be a feature provided called like "easy entry", which facilitates the access to the rear seats. This is usually achieved by means of moving the according front seat (driver side or passenger side) or seat back.
    AcsOfSeatReByPassSeat: interface=EntryReq1  # Rear Seat Access | Indicates the user's demand for access to the rear seats. For cars with only 2 front doors there might be a feature provided called like "easy entry", which facilitates the access to the rear seats. This is usually achieved by means of moving the according front seat (driver side or passenger side) or seat back.
    AcsOfSeatReBySeatRowFirstMid: interface=EntryReq1  # Rear Seat Access | Indicates the user's demand for access to the rear seats. For cars with only 2 front doors there might be a feature provided called like "easy entry", which facilitates the access to the rear seats. This is usually achieved by means of moving the according front seat (driver side or passenger side) or seat back.
    AcsOfSeatReBySeatRowSecLe: interface=EntryReq1  # Rear Seat Access | Indicates the user's demand for access to the rear seats. For cars with only 2 front doors there might be a feature provided called like "easy entry", which facilitates the access to the rear seats. This is usually achieved by means of moving the according front seat (driver side or passenger side) or seat back.
    AcsOfSeatReBySeatRowSecMid: interface=EntryReq1  # Rear Seat Access | Indicates the user's demand for access to the rear seats. For cars with only 2 front doors there might be a feature provided called like "easy entry", which facilitates the access to the rear seats. This is usually achieved by means of moving the according front seat (driver side or passenger side) or seat back.
    AcsOfSeatReBySeatRowSecRi: interface=EntryReq1  # Rear Seat Access | Indicates the user's demand for access to the rear seats. For cars with only 2 front doors there might be a feature provided called like "easy entry", which facilitates the access to the rear seats. This is usually achieved by means of moving the according front seat (driver side or passenger side) or seat back.
    AcsOfSeatReBySeatRowThrdLe: interface=EntryReq1  # Rear Seat Access | Indicates the user's demand for access to the rear seats. For cars with only 2 front doors there might be a feature provided called like "easy entry", which facilitates the access to the rear seats. This is usually achieved by means of moving the according front seat (driver side or passenger side) or seat back.
    AcsOfSeatReBySeatRowThrdMid: interface=EntryReq1  # Rear Seat Access | Indicates the user's demand for access to the rear seats. For cars with only 2 front doors there might be a feature provided called like "easy entry", which facilitates the access to the rear seats. This is usually achieved by means of moving the according front seat (driver side or passenger side) or seat back.
    AcsOfSeatReBySeatRowThrdRi: interface=EntryReq1  # Rear Seat Access | Indicates the user's demand for access to the rear seats. For cars with only 2 front doors there might be a feature provided called like "easy entry", which facilitates the access to the rear seats. This is usually achieved by means of moving the according front seat (driver side or passenger side) or seat back.
    ActrBodyLvlSt: interface=ActrBodyLvlSt1  # Actuator Body Level Status | Status provided by body level actuator system
    ActrBodyLvlSts: interface=ActrBodyLvlSts1  # Actuator Body Level Status | Status provided by body level actuator system
    ActrBrkOnDmdFailrInRsc: interface=BrkActrFailrForBrkOnDmd1  # Actuator Brake on Demand Failure in RSC | Brake actuator failure status with respect to availability for brake-on-demand functions related to Roll Stability Control.
    ActrBrkOnDmdFailrInSsm: interface=BrkActrFailrForBrkOnDmd1  # Actuator Brake on Demand Failure in Stand Still Management | Brake actuator failure status with respect to availability for brake-on-demand functions related to the Stand Still Manager.
    ActrBrkOnDmdFailrInVlc: interface=BrkActrFailrForBrkOnDmd1  # Actuator Brake on Demand Failure in Vehicle Longitudinal Control (VLC) | Brake actuator failure status with respect to availability for brake-on-demand functions related to Vehicle Longitudinal Control.
    ActrStConsoldAtDftlForTqTrf: interface=TrsmStTrfCaseDftl1  # Actuator Status Consolidated at Differential for Torque Transfer | Status of the Transfer Case Actuator.
    ActrStsActAtDftlForTqTrf: interface=TrsmStTrfCaseDftl1  # Actuator Status Actual at Differential for Torque Transfer | Status of the Transfer Case Actuator.
    ActrYawCpbyExt: interface=ActrYawCpbyExt1  # Actuator Yaw Capability External | Indicates yaw torque capability of the external yaw rate controller using additional actuators (steering, suspension, ...)
    ActvSuspMod: interface=ActvSuspMod1  # Active Suspension Mode | Active suspension mode for display to the driver and provided to other systems
    ActvSuspSt: interface=ActvSuspSt1  # Active Suspension Status | Status provided by active suspension system
    ActvSuspSts: interface=ActvSuspSts1  # Active Suspension Status | Status provided by active suspension system
    Actvn: interface=LvlDefrstCmd1  # Defrost Activation | Port for Defrost Activation
    ActvnOfActrDefrstFrnt: interface=LvlDefrstCmd1  # Defrost Activation | Port for Defrost Activation
    ActvnOfActrDefrstRe: interface=LvlDefrstCmd1  # Defrost Activation | Port for Defrost Activation
    ActvnOfActrMirrDefrst: interface=LvlDefrstCmd1  # Defrost Activation | Port for Defrost Activation
    ActvnOfWshngCmd: interface=WshngCmd1  # Activation of Washing Command | Command for washing
    ActvnOfWshngCmdOfWshrFrnt: interface=WshngCmd1  # Activation of Washer Front | Users demand for front window washing on/off
    ActvnOfWshngCmdOfWshrHdlamp: interface=WshngCmd1  # Activation of Washer Head Lamp | User's demand for headlamp window washing on/off
    ActvnOfWshngCmdOfWshrRe: interface=WshngCmd1  # Activation of Washer Rear | User's demand for rear window washing on/off
    ActvnTintg: interface=MirrTintgCmd1  # Tinting Activation | Command to activate/deactivate the tinting of the mirror.
    ActvtOfActrAirbFrntAtDrvr: interface=ActvnOfActrForOccptPedSfty1  # Activate of Actuator Airbag Front at Driver | Activate front airbag to protect driver
    ActvtOfActrAirbFrntAtPass: interface=ActvnOfActrForOccptPedSfty1  # Activate of Actuator Airbag Front at Passenger | Activate front airbag to protect passenger
    ActvtOfActrAirbFrntAtRowFirstMid: interface=ActvnOfActrForOccptPedSfty1  # Activate of Actuator Airbag Front at Row First Middle | Activate front airbag to protect occupant at first row middle seat
    ActvtOfActrAirbSideAtDrvr: interface=ActvnOfActrForOccptPedSfty1  # Activate of Actuator Airbag Side at Driver | Activate side airbag at driver position to protect driver at side impact situations
    ActvtOfActrAirbSideAtPass: interface=ActvnOfActrForOccptPedSfty1  # Activate of Actuator Airbag Side at Passenger | Activate side airbag at passenger position to protect passenger at side impact situations
    ActvtOfActrAirbSideAtRowSecLe: interface=ActvnOfActrForOccptPedSfty1  # Activate of Actuator Airbag Side at Row Second Left | Activate side airbag at second row, left side to protect occupant at side impact situations
    ActvtOfActrAirbSideAtRowSecRi: interface=ActvnOfActrForOccptPedSfty1  # Activate of Actuator Airbag Side at Row Second Right | Activate side airbag at second row, right side to protect occupant at side impact situations
    ActvtOfActrAirbSideAtRowThrdLe: interface=ActvnOfActrForOccptPedSfty1  # Activate of Actuator Airbag Side at Row Third Left | Activate side airbag at third row, left side to protect occupant at side impact situations
    ActvtOfActrAirbSideAtRowThrdRi: interface=ActvnOfActrForOccptPedSfty1  # Activate of Actuator Airbag Side at Row Thrid Right | Activate side airbag at third row, right side to protect occupant at side impact situations
    ActvtOfActrAnchrfitgTensnrAtDrvr: interface=ActvnOfActrForOccptPedSfty1  # Activate of Actuator Anchorfitting Tensioner at Driver | Activate anchor fitting tensioner at driver position
    ActvtOfActrAnchrfitgTensnrAtPass: interface=ActvnOfActrForOccptPedSfty1  # Activate of Actuator Anchorfitting Tensioner at Passenger | Activate anchor fitting tensioner at passenger position
    ActvtOfActrAnchrfitgTensnrAtRowFirstMid: interface=ActvnOfActrForOccptPedSfty1  # Activate of Actuator Anchorfitting Tensioner at Row First Middle | Activate anchor fitting tensioner at seat in first row, middle position
    ActvtOfActrAnchrfitgTensnrAtRowSecLe: interface=ActvnOfActrForOccptPedSfty1  # Activate of Actuator Anchorfitting Tensioner at Row Second Left | Activate anchor fitting tensioner at seat in second row, left position
    ActvtOfActrAnchrfitgTensnrAtRowSecMid: interface=ActvnOfActrForOccptPedSfty1  # Activate of Actuator Anchorfitting Tensioner at Row Second Middle | Activate anchor fitting tensioner at seat in second row, middle position
    ActvtOfActrAnchrfitgTensnrAtRowSecRi: interface=ActvnOfActrForOccptPedSfty1  # Activate of Actuator Anchorfitting Tensioner at Row Second Right | Activate anchor fitting tensioner at seat in second row, right position
    ActvtOfActrAnchrfitgTensnrAtRowThrdLe: interface=ActvnOfActrForOccptPedSfty1  # Activate of Actuator Anchorfitting Tensioner at Row Third Left | Activate anchor fitting tensioner at seat in third row, left position
    ActvtOfActrAnchrfitgTensnrAtRowThrdMid: interface=ActvnOfActrForOccptPedSfty1  # Activate of Actuator Anchorfitting Tensioner at Row Third Middle | Activate anchor fitting tensioner at seat in third row, middle position
    ActvtOfActrAnchrfitgTensnrAtRowThrdRi: interface=ActvnOfActrForOccptPedSfty1  # Activate of Actuator Anchorfitting Tensioner at Row Third Right | Activate anchor fitting tensioner at seat in third row, right position
    ActvtOfActrAntisubCushAtDrvr: interface=ActvnOfActrForOccptPedSfty1  # Activate of Actuator Antisubmarine Cushion at Driver | Activate Antisubmarine cushion at driver position
    ActvtOfActrAntisubCushAtPass: interface=ActvnOfActrForOccptPedSfty1  # Activate of Actuator Antisubmarine Cushion at Passenger | Activate Antisubmarine cushion at passenger position
    ActvtOfActrAntisubCushAtRowFirstMid: interface=ActvnOfActrForOccptPedSfty1  # Activate of Actuator Antisubmarine Cushion at Row First Middle | Activate Antisubmarine cushion at seat in first row, middle position
    ActvtOfActrAntisubCushAtRowSecLe: interface=ActvnOfActrForOccptPedSfty1  # Activate of Actuator Antisubmarine Cushion at Row Second Left | Activate Antisubmarine cushion at seat in second row, left position
    ActvtOfActrAntisubCushAtRowSecMid: interface=ActvnOfActrForOccptPedSfty1  # Activate of Actuator Antisubmarine Cushion at Row Second Middle | Activate Antisubmarine cushion at seat in second row, middle position
    ActvtOfActrAntisubCushAtRowSecRi: interface=ActvnOfActrForOccptPedSfty1  # Activate of Actuator Antisubmarine Cushion at Row Second Right | Activate Antisubmarine cushion at seat in second row, right position
    ActvtOfActrAntisubCushAtRowThrdLe: interface=ActvnOfActrForOccptPedSfty1  # Activate of Actuator Antisubmarine Cushion at Row Third Left | Activate Antisubmarine cushion at seat in third row, left position
    ActvtOfActrAntisubCushAtRowThrdMid: interface=ActvnOfActrForOccptPedSfty1  # Activate of Actuator Antisubmarine Cushion at Row Third Middle | Activate Antisubmarine cushion at seat in third row, middle position
    ActvtOfActrAntisubCushAtRowThrdRi: interface=ActvnOfActrForOccptPedSfty1  # Activate of Actuator Antisubmarine Cushion at Row Third Right | Activate Antisubmarine cushion at seat in third row, right position
    ActvtOfActrAtApilLeForPedProtn: interface=ActvnOfActrForOccptPedSfty1  # Activate of Actuator at Apillar Left for Pedestrian Protection | activate actuator at left A-pillar to protect pedestrian
    ActvtOfActrAtApilRiForPedProtn: interface=ActvnOfActrForOccptPedSfty1  # Activate of Actuator at Apillar Right for Pedestrian Protection | activate actuator at right A-pillar to protect pedestrian
    ActvtOfActrAtBmpForPedProtn: interface=ActvnOfActrForOccptPedSfty1  # Activate of Actuator at Bumper for Pedestrian Protection | activate bumper actuator to protect pedestrian
    ActvtOfActrAtHoodForPedProtn: interface=ActvnOfActrForOccptPedSfty1  # Activate of Actuator at Hood for Pedestrian Protection | activate hood actuator to protect pedestrian
    ActvtOfActrAtRoofForPedProtn: interface=ActvnOfActrForOccptPedSfty1  # Activate of Actuator at Roof for Pedestrian Protection | activate actuator at roof to protect pedestrian
    ActvtOfActrBattCutOff: interface=ActvnOfActrForOccptPedSfty1  # Activate of Actuator Battery Cut Off | Cut off of battery in case of crash
    ActvtOfActrBltLimrAtDrvr: interface=ActvnOfActrForOccptPedSfty1  # Activate of Actuator Belt Limiter at Driver | Activate belt limiter at driver position
    ActvtOfActrBltLimrAtPass: interface=ActvnOfActrForOccptPedSfty1  # Activate of Actuator Belt Limiter at Passenger | Activate belt limiter at passenger position
    ActvtOfActrBltLimrAtRowFirstMid: interface=ActvnOfActrForOccptPedSfty1  # Activate of Actuator Belt Limiter at Row First Middle | Activate belt limiter at seat in first row, middle position
    ActvtOfActrBltLimrAtRowSecLe: interface=ActvnOfActrForOccptPedSfty1  # Activate of Actuator Belt Limiter at Row Second Left | Activate belt limiter at seat in second row, left position
    ActvtOfActrBltLimrAtRowSecMid: interface=ActvnOfActrForOccptPedSfty1  # Activate of Actuator Belt Limiter at Row Second Middle | Activate belt limiter at seat in second row, middle position
    ActvtOfActrBltLimrAtRowSecRi: interface=ActvnOfActrForOccptPedSfty1  # Activate of Actuator Belt Limiter at Row Second Right | Activate belt limiter at seat in second row, right position
    ActvtOfActrBltLimrAtRowThrdLe: interface=ActvnOfActrForOccptPedSfty1  # Activate of Actuator Belt Limiter at Row Third Left | Activate belt limiter at seat in third row, left position
    ActvtOfActrBltLimrAtRowThrdMid: interface=ActvnOfActrForOccptPedSfty1  # Activate of Actuator Belt Limiter at Row Third Middle | Activate belt limiter at seat in third row, middle position
    ActvtOfActrBltLimrAtRowThrdRi: interface=ActvnOfActrForOccptPedSfty1  # Activate of Actuator Belt Limiter at Row Third Right | Activate belt limiter at seat in third row, right position
    ActvtOfActrBltTensnrAtDrvr: interface=ActvnOfActrForOccptPedSfty1  # Activate of Actuator Belt Tensioner at Driver | Activate belt tensioner at driver position
    ActvtOfActrBltTensnrAtPass: interface=ActvnOfActrForOccptPedSfty1  # Activate of Actuator Belt Tensioner at Passenger | Activate belt tensioner at passenger position
    ActvtOfActrBltTensnrAtRowFirstMid: interface=ActvnOfActrForOccptPedSfty1  # Activate of Actuator Belt Tensioner at Row First Middle | Activate belt tensioner at seat in first row, middle position
    ActvtOfActrBltTensnrAtRowSecLe: interface=ActvnOfActrForOccptPedSfty1  # Activate of Actuator Belt Tensioner at Row Second Left | Activate belt tensioner at seat in second row, left position
    ActvtOfActrBltTensnrAtRowSecMid: interface=ActvnOfActrForOccptPedSfty1  # Activate of Actuator Belt Tensioner at Row Second Middle | Activate belt tensioner at seat in second row, middle position
    ActvtOfActrBltTensnrAtRowSecRi: interface=ActvnOfActrForOccptPedSfty1  # Activate of Actuator Belt Tensioner at Row Second Right | Activate belt tensioner at seat in second row, right position
    ActvtOfActrBltTensnrAtRowThrdLe: interface=ActvnOfActrForOccptPedSfty1  # Activate of Actuator Belt Tensioner at Row Third Left | Activate belt tensioner at seat in third row, left position
    ActvtOfActrBltTensnrAtRowThrdMid: interface=ActvnOfActrForOccptPedSfty1  # Activate of Actuator Belt Tensioner at Row Third Middle | Activate belt tensioner at seat in third row, middle position
    ActvtOfActrBltTensnrAtRowThrdRi: interface=ActvnOfActrForOccptPedSfty1  # Activate of Actuator Belt Tensioner at Row Third Right | Activate belt tensioner at seat in third row, right position
    ActvtOfActrBucRtrctrAtDrvr: interface=ActvnOfActrForOccptPedSfty1  # Activate of Actuator Buckle Retractor at Driver | Activate buckle retractor at driver position
    ActvtOfActrBucRtrctrAtPass: interface=ActvnOfActrForOccptPedSfty1  # Activate of Actuator Buckle Retractor at Passenger | Activate buckle retractor at passenger position
    ActvtOfActrBucRtrctrAtRowFirstMid: interface=ActvnOfActrForOccptPedSfty1  # Activate of Actuator Buckle Retractor at Row First Middle | Activate buckle retractor at seat in first row, middle position
    ActvtOfActrBucRtrctrAtRowSecLe: interface=ActvnOfActrForOccptPedSfty1  # Activate of Actuator Buckle Retractor at Row Second Left | Activate buckle retractor at seat in second row, left position
    ActvtOfActrBucRtrctrAtRowSecMid: interface=ActvnOfActrForOccptPedSfty1  # Activate of Actuator Buckle Retractor at Row Second Middle | Activate buckle retractor at seat in second row, middle position
    ActvtOfActrBucRtrctrAtRowSecRi: interface=ActvnOfActrForOccptPedSfty1  # Activate of Actuator Buckle Retractor at Row Second Right | Activate buckle retractor at seat in second row, right position
    ActvtOfActrBucRtrctrAtRowThrdLe: interface=ActvnOfActrForOccptPedSfty1  # Activate of Actuator Buckle Retractor at Row Third Left | Activate buckle retractor at seat in third row, left position
    ActvtOfActrBucRtrctrAtRowThrdMid: interface=ActvnOfActrForOccptPedSfty1  # Activate of Actuator Buckle Retractor at Row Third Middle | Activate buckle retractor at seat in third row, middle position
    ActvtOfActrBucRtrctrAtRowThrdRi: interface=ActvnOfActrForOccptPedSfty1  # Activate of Actuator Buckle Retractor at Row Third Right | Activate buckle retractor at seat in third row, right position
    ActvtOfActrCurtAirbAtLe: interface=ActvnOfActrForOccptPedSfty1  # Activate of Actuator Curtain Airbag at Left | Activate left curtain airbag actuator to protect occupants at side impact
    ActvtOfActrCurtAirbAtRi: interface=ActvnOfActrForOccptPedSfty1  # Activate of Actuator Curtain Airbag at Right | Activate right curtain airbag actuator to protect occupants at side impact
    ActvtOfActrFuCutOff: interface=ActvnOfActrForOccptPedSfty1  # Activate of Actuator Fuel Cut Off | Cut off of fuel in case of crash
    ActvtOfActrHdrestAtDrvr: interface=ActvnOfActrForOccptPedSfty1  # Activate of Actuator Headrest at Driver | Activate headrest at driver seat position
    ActvtOfActrHdrestAtPass: interface=ActvnOfActrForOccptPedSfty1  # Activate of Actuator Headrest at Passenger | Activate headrest at passenger seat position
    ActvtOfActrHdrestAtRowFirstMid: interface=ActvnOfActrForOccptPedSfty1  # Activate of Actuator Headrest at Row First Middle | Activate headrest at middle seat position of first row
    ActvtOfActrHdrestAtRowSecLe: interface=ActvnOfActrForOccptPedSfty1  # Activate of Actuator Headrest at Row Second Left | Activate headrest at left seat position of second row
    ActvtOfActrHdrestAtRowSecMid: interface=ActvnOfActrForOccptPedSfty1  # Activate of Actuator Headrest at Row Second Middle | Activate headrest at middle seat position of second row
    ActvtOfActrHdrestAtRowSecRi: interface=ActvnOfActrForOccptPedSfty1  # Activate of Actuator Headrest at Row Second Right | Activate headrest at right seat position of second row
    ActvtOfActrHdrestAtRowThrdLe: interface=ActvnOfActrForOccptPedSfty1  # Activate of Actuator Headrest at Row Third Left | Activate headrest at left seat position of third row
    ActvtOfActrHdrestAtRowThrdMid: interface=ActvnOfActrForOccptPedSfty1  # Activate of Actuator Headrest at Row Third Middle | Activate headrest at middle seat position of third row
    ActvtOfActrHdrestAtRowThrdRi: interface=ActvnOfActrForOccptPedSfty1  # Activate of Actuator Headrest at Row Third Right | Activate headrest at right seat position of third row
    ActvtOfActrKneeProtnAtDrvr: interface=ActvnOfActrForOccptPedSfty1  # Activate of Actuator Knee Protection at Driver | Activate knee protection actuator to protect drivers knee
    ActvtOfActrKneeProtnAtPass: interface=ActvnOfActrForOccptPedSfty1  # Activate of Actuator Knee Protection at Passenger | Activate knee protection actuator to protect passenger knee
    ActvtOfActrKneeProtnAtRowFirstMid: interface=ActvnOfActrForOccptPedSfty1  # Activate of Actuator Knee Protection at Row First Middle | Activate knee protection actuator to protect occupant knee at first row middle seat
    ActvtOfActrPelvProtnAtDrvr: interface=ActvnOfActrForOccptPedSfty1  # Activate of Actuator Pelvis Protection at Driver | Activate pelvis protection actuator at driver position
    ActvtOfActrPelvProtnAtPass: interface=ActvnOfActrForOccptPedSfty1  # Activate of Actuator Pelvis Protection at Passenger | Activate pelvis protection actuator at passenger position
    ActvtOfActrPelvProtnAtRowSecLe: interface=ActvnOfActrForOccptPedSfty1  # Activate of Actuator Pelvis Protection at Row Second Left | Activate pelvis protection actuator at second row on left side
    ActvtOfActrPelvProtnAtRowSecRi: interface=ActvnOfActrForOccptPedSfty1  # Activate of Actuator Pelvis Protection at Row Second Right | Activate pelvis protection actuator at second row at right side
    ActvtOfActrPelvProtnAtRowThrdLe: interface=ActvnOfActrForOccptPedSfty1  # Activate of Actuator Pelvis Protection at Row Third Left | Activate pelvis protection actuator at third row at left side
    ActvtOfActrPelvProtnAtRowThrdRi: interface=ActvnOfActrForOccptPedSfty1  # Activate of Actuator Pelvis Protection at Row Third Right | Activate pelvis protection actuator at third row at right side
    ActvtOfActrRollbarAtLe: interface=ActvnOfActrForOccptPedSfty1  # Activate of Actuator Rollbar at Left | Activate safety rollbar on left side (usually on roll or pitch over situations) to protect occupants on convertibles
    ActvtOfActrRollbarAtRi: interface=ActvnOfActrForOccptPedSfty1  # Activate of Actuator Rollbar at Right | Activate safety rollbar on right side (usually on roll or pitch over situations) to protect occupants on convertibles
    ActvtOfActrThoraxAirbAtDrvr: interface=ActvnOfActrForOccptPedSfty1  # Activate of Actuator Thorax Airbag at Driver | Activate head/thorax airbag between driver and compartment
    ActvtOfActrThoraxAirbAtPass: interface=ActvnOfActrForOccptPedSfty1  # Activate of Actuator Thorax Airbag at Passenger | Activate head/thorax airbag between passenger and compartment
    ActvtOfActrThoraxAirbAtRowFirstMidToDrvr: interface=ActvnOfActrForOccptPedSfty1  # Activate of Actuator Thorax Airbag at Row First Middle to Driver | Activate head/thorax airbag in first row in between driver and middle seating position or driver and passenger
    ActvtOfActrThoraxAirbAtRowFirstMidToPass: interface=ActvnOfActrForOccptPedSfty1  # Activate of Actuator Thorax Airbag at Row First Middle to Passenger | Activate head/thorax airbag in first row in between passenger and middle seating position
    ActvtOfActrThoraxAirbAtRowSecLe: interface=ActvnOfActrForOccptPedSfty1  # Activate of Actuator Thorax Airbag at Row Second Left | Activate head/thorax airbag in second row at the left
    ActvtOfActrThoraxAirbAtRowSecMidLe: interface=ActvnOfActrForOccptPedSfty1  # Activate of Actuator Thorax Airbag at Row Second Middle Left | Activate head/thorax airbag at second row in between middle and left seating position
    ActvtOfActrThoraxAirbAtRowSecMidRi: interface=ActvnOfActrForOccptPedSfty1  # Activate of Actuator Thorax Airbag at Row Second Middle Right | Activate head/thorax airbag at second row in between middle and right seating position
    ActvtOfActrThoraxAirbAtRowSecRi: interface=ActvnOfActrForOccptPedSfty1  # Activate of Actuator Thorax Airbag at Row Second Right | Activate head/thorax airbag in second row at the right
    ActvtOfActrThoraxAirbAtRowThrdLe: interface=ActvnOfActrForOccptPedSfty1  # Activate of Actuator Thorax Airbag at Row Third Left | Activate head/thorax airbag in third row at the left
    ActvtOfActrThoraxAirbAtRowThrdMidLe: interface=ActvnOfActrForOccptPedSfty1  # Activate of Actuator Thorax Airbag at Row Third Middle Left | Activate head/thorax airbag at third row in between middle and left seating position
    ActvtOfActrThoraxAirbAtRowThrdMidRi: interface=ActvnOfActrForOccptPedSfty1  # Activate of Actuator Thorax Airbag at Row Third Middle Right | Activate head/thorax airbag in third row in between middle and right seating position
    ActvtOfActrThoraxAirbAtRowThrdRi: interface=ActvnOfActrForOccptPedSfty1  # Activate of Actuator Thorax Airbag at Row Third Right | Activate head/thorax airbag in third row at the right
    ActvtWipgAutFromHmi: interface=ActvtWipgAutReq1  # Activate Wiping Automatic from HMI | Represents user's demand to activate / deactivate automatic front wiping. This demand is given by the Human Machine Interface (HMI) of the vehicle.
    AlrmSt: interface=AlrmSt1  # Alarm State | State of the alarm
    AlrmVis: interface=AlrmVisCmd1  # Visual Alarm | Command the visual alarm
    AltTq: interface=AltTq1  # Alternator Mechanical Torque (Load) | Consolidated Alternator Load | This value must take into account all relevant dynamic effects. It is converted to engine crankshaft torque by the provider.Default value after reset is zero.
    AltTqReq: interface=AltTqReq1  # Requested Mechanical Torque for Alternator (Generator) at Engine Crank Shaft | Requested mechanical load for alternator (generator) at engine crank shaft.
    AxleFrntCoorrSt: interface=DftlCoorrSts1  # Status of the Front Axle Coordinator
    AxleReCoorrSt: interface=DftlCoorrSts1  # Status of the Rear Axle Coordinator
    BackliteWinDiagcLock: interface=DiagcLock1  # Backlite Window Diagnostic Lock | Diagnostic request to manipulate an actuator component of the backlite window to unconditionally unlock, lock or safe at the latch
    BackliteWinHmi: interface=LtchRelsReq1  # Backlite Window HMI | User request to release/unlock the Backlite of the vehicle.
    BackliteWinLockSt: interface=LockSt1  # Backlite Window Lock State | information about the current locking state of the backlite window
    BackliteWinLockgCmd: interface=LockCmd1  # Backlite Window Locking Command | Locking command related to backlite window. This command locks or unlock the backlite window
    BackliteWinLtchRels: interface=DiagcLtchRels1  # Backlite Window Latch Release | Diagnostic request to the sensor component to release/unlock the latch of backlite window
    BackliteWinPullAid: interface=PullAidCmd1  # Backlite Window Pull Aid | This port provide the Pull Aid Command to assist the movement of the backlite window.
    BackliteWinSt: interface=DoorSt1  # Backlite Window Status | Information of the backlite window, indicates whether this window is opened or closed
    BackliteWinSts: interface=DoorSts1  # Backlite Window Status | Information of the backlite window, indicates whether this window is opened or closed
    BattU: interface=BattU1  # Battery Voltage | Information related to the voltage delivered by the battery of the vehicle
    BeamHi: interface=LiExtCmd1  # High Beam | This port provides command to turn on/off high beams
    BeamHiIndcn: interface=ExtrLiDisp1  # High Beam Indication | This port provides Indication to the instrument cluster about the High beam on/off status
    BeamHiOut: interface=LiExtCmd1  # High Beam Output | This port provides command to turn on/off high beams
    BeamLo: interface=LiExtCmd1  # Low Beam | This port provides command to turn on/off low beams
    BeamLoIndcn: interface=ExtrLiDisp1  # Low Beam Indication | This port provides Indication to the instrument cluster about the Low beam on/off status
    BeamLoOut: interface=LiExtCmd1  # Low Beam Output | This port provides command to turn on/off low beams
    BltLockStAtDrvr: interface=BltLockSt1  # Belt Lock State at Driver | State of belt lock at driver seating position
    BltLockStAtPass: interface=BltLockSt1  # Belt Lock State at Passenger | State of belt lock at passenger seating position
    BltLockStAtRowFirstMid: interface=BltLockSt1  # Belt Lock State at Row First Middle | State of belt lock at seating position at middle of first row
    BltLockStAtRowSecLe: interface=BltLockSt1  # Belt Lock State at Row Second Left | State of belt lock at seating position at left of second row
    BltLockStAtRowSecMid: interface=BltLockSt1  # Belt Lock State at Row Second Middle | State of belt lock at seating position at middle of second row
    BltLockStAtRowSecRi: interface=BltLockSt1  # Belt Lock State at Row Second Right | State of belt lock at seating position at right of second row
    BltLockStAtRowThrdLe: interface=BltLockSt1  # Belt Lock State at Row Third Left | State of belt lock at seating position at left of third row
    BltLockStAtRowThrdMid: interface=BltLockSt1  # Belt Lock State at Row Third Middle | State of belt lock at seating position at middle of third row
    BltLockStAtRowThrdRi: interface=BltLockSt1  # Belt Lock State at Row Third Right | State of belt lock at seating position at right of third row
    BodyLvlCtrl: interface=BodyLvlCtrl1  # Body Level Control | Status of the body level control indicating the direction of the body movement.
    BodyLvlMod: interface=BodyLvlMod1  # Body Level Mode | Current body level mode for display to the driver and provided to other systems. | Stepped body level value
    BodyLvlModReq: interface=BodyLvlModReq1  # Body Level Mode Request | Height level request to suspension system(s) by the driver.
    BodyPitchAgAbsltEstimd: interface=BodyPitchAg1  # Body Pitch Angle Absolute Estimated | Estimation of the absolute pitch angle of the vehicle body.
    BodyPitchAgAbsltMeasd: interface=BodyPitchAg1  # Body Pitch Angle Absolute Measured | Measured absolute vehicle body pitch angle. (Filtered and offset compensated)
    BodyPitchAgAbsltMeasdBas: interface=BodyPitchAg1  # Body Pitch Angle Absolute Measured Base | Measured absolute vehicle body pitch angle.
    BodyPitchAgAbsltMeasdRaw: interface=BodyPitchAg1  # Body Pitch Angle Absolute Measured Raw | Measured absolute vehicle body pitch angle.
    BodyPitchAgAbsltMeasdStd: interface=BodyPitchAg1  # Body Pitch Angle Absolute Measured Standard | Measured absolute vehicle body pitch angle. (Filtered and offset compensated)
    BodyPitchAgRelEstimd: interface=BodyPitchAg1  # Body Pitch Angle Relative Estimated | Estimation of the relative pitch angle of the vehicle body.
    BodyRollAgAbsltEstimd: interface=BodyRollAg1  # Body Roll Angle Absolute Estimated | Estimation of the absolute roll angle of the vehicle body.
    BodyRollAgAbsltMeasd: interface=BodyRollAg2  # Body Roll Angle Absolute Measured | Measured absolute vehicle body roll angle. Filtered and offset compensated.
    BodyRollAgAbsltMeasdBas: interface=BodyRollAg2  # Body Roll Angle Absolute Measured Base | Measured absolute vehicle body roll angle.
    BodyRollAgAbsltMeasdRaw: interface=BodyRollAg2  # Body Roll Angle Absolute Measured Raw | Measured absolute vehicle body roll angle.
    BodyRollAgAbsltMeasdStd: interface=BodyRollAg2  # Body Roll Angle Absolute Measured Standard | Measured absolute vehicle body roll angle. Filtered and offset compensated.
    BodyRollAgRelEstimd: interface=BodyRollAg1  # Body Roll Angle Relative Estimated | Estimation of the relative roll angle of the vehicle body.
    BodyRollAgRelMeasd: interface=BodyRollAg1  # Body Roll Angle Relative Measured | Measured relative vehicle body roll angle.
    BrkActrIntvg: interface=BrkActrIntvg1  # Brake Actuator Intervening | Brake actuator is used to apply a pressure at at least one wheel.
    BrkActrMod: interface=BrkActrMod1  # Brake Actuator Mode | Brake actuator action or status, with regards to parking brake functionality.
    BrkActrOvrheatd: interface=BrkActrOvrheatd1  # Brake Actuator Overheated | One flag indicating that temperature of at least one actuator component is high, e.g. valves overheated. If this flag is set the actuator is in a critical condition. The external function, e.g. Roll Stability Controller can decide whether to use the brake or not.
    BrkActrSatn: interface=BrkActrSatn1  # Brake Actuator Saturation | Brake actuator saturation status. This is a not wheel individual but global information.
    BrkActrTqDbnd: interface=ActrTqDbnd1  # Brake Actuator Torque Deadband | Minimum and maximum decrease of the requested brake torque
    BrkActrVehSpdMax: interface=VehSpd1  # Brake Actuator Vehicle Speed Maximum | Maximum vehicle speed requested by chassis for safety vehicle speed limitation. Arbitrated with a minimum function in powertrain domain, together with similar requests from other domains. Limit vehicle speed in case of brake system deterioration
    BrkAssiReq: interface=BrkAssiReq1  # Brake Assist Request | Request from Vehicle Longitudinal Control (VLC) that the brake system should modify its brake assist mode for hazard situations.
    BrkInten: interface=BrkLiInten1  # Brake Light Intensity | This port provides Brake lights intensity command for lights adapters
    BrkLi: interface=LiExtCmd1  # Brake Light | This port provides Brake lights activation command for lights adapters.
    BrkLiIntenReq: interface=BrkLiInten1  # Brake Light Intensity Request | Requested intensity of brake lights.
    BrkLiOnReqFromChassis: interface=BrkLiOnReq1  # Brake Light on Request from Chassis | Request to illuminate brake lights. | Esc intervention does not illuminate brake lights (e.g. active booster).
    BrkModReq: interface=BrkModReq1  # Brake Mode Request | Indication whether the brake request is comfort or safety related.
    BrkPedlFlgPsd: interface=BrkPedlPsd1  # Brake Pedal Pressed | Information that the brake pedal is pressed. | When other brake system elements (an active booster for example) are in use, a combination of the state of the brake light switch (on) and the brake hydraulic pressure (above a threshold) do not necessarily indicate that the brake pedal is pressed.
    BrkPedlOvrd: interface=BrkPedlOvrd1  # Brake Pedal Override | Information that any existing cruise control request is overridden by application of the brake pedal. | Result of brake torque arbitration.
    BrkPedlPsd: interface=BrkPedlPsd1  # Brake Pedal Pressed | Information that the brake pedal is pressed. | When other brake system elements (an active booster for example) are in use, a combination of the state of the brake light switch (on) and the brake hydraulic pressure (above a threshold) do not necessarily indicate that the brake pedal is pressed.
    BrkPedlRat: interface=BrkPedlVal1  # Actual Brake Pedal Position | Position of the brake pedal | physical Lower Limit: no pedal activation physical Upper Limit: full pedal stroke
    BrkPedlVal: interface=BrkPedlVal1  # Brake Pedal Value | Position of the brake pedal | physical Lower Limit: no pedal activation physical Upper Limit: full pedal stroke
    BrkPrevnCmftReqByAcc: interface=BrkPrevn1  # Brake Prevention Comfort Request by ACC | Avoid brake interventions for comfort reasons requested by Adaptive Cruise Control (ACC) to be arbitrated by Vehicle Longitudinal Control (VLC).
    BrkPrevnCmftReqByVlc: interface=BrkPrevn1  # Brake Prevention Comfort Request by Vehicle Longitudinal Control (VLC) | Request to avoid braking, e.g. for Adaptive Cruise Control and Vehicle Longitudinal Control. Request includes aspects from traffic point of view.
    BrkRdyReq: interface=BrkRdyReq1  # Brake Ready Request | Request from Vehicle Longitudinal Control (VLC) that the brake system is to be prepared for braking (e.g. air gap elimination).
    BrkTracCtrlIntvg: interface=BrkTracCtrlIntvg1  # Brake Traction Control Intervening | Brake traction control intervention status. True if intervening at at least one wheel.
    BrkYawCtrlIntvgPerWhl: interface=BrkYawCtrlIntvgPerWhl1  # Brake Yaw Control Intervening per Wheel | Wheel with yaw stability brake control intervention (Vector of 4). Information for Roll Stability Control (RSC) and Suspension only. Wheel individual.
    BrkYawTq: interface=YawTq1  # Brake Yaw Torque | Component of the total yaw torque currently realized by brake actuator. Brake Yaw Torque is defined as the difference of brake forces from left and right wheels multiplied by track width.
    BtnMplSt256: interface=BtnMplSt256  # Multiple Button 256 States | Information which of the 256 states the user interface device (button, switch, knob, ...) is selected
    BtnMplSt4: interface=BtnMplSt4  # Multiple Button 4 States | Information which of the four states the user interface device (button, switch, knob, ...) is selected
    BtnMplSt8: interface=BtnMplSt8  # Multiple Button 8 States | Information which of the eight states the user interface device (button, switch, knob, ...) is selected
    BtnReLeForSeatClima: interface=HmiBtn1  # Rear Left Button from HMI for Seat Climatisation | Rear Left Passenger Button Activation From Hmi (on, off) for Seat Climatisation
    BtnReRiForSeatClima: interface=HmiBtn1  # Rear Right Button from HMI for Seat Climatisation | Rear Right Passenger Button Activation From Hmi (on, off) for Seat Climatisation
    BtnSimple: interface=BtnSimple1  # Simple Button | Information if the button was pressed or not pressed.
    BypSlipCtrlReqByRsc: interface=BypSlipCtrlReq1  # Bypass Slip Control Request by RSC | Request from Roll Stability Control (RSC) only to inhibit internal Electronic Stability Control (ESC) slip control.
    CarFindr: interface=CarFindrReq1  # Car Finder | This information is related to the activation or deactivation of the car finder. This function is able to generate sounds or light to help the customer to find his vehicle
    CarIncln: interface=InclnSt1  # Car Inclination | Information about longitudinal Inclination
    ChdProtn: interface=DiagcChdProtn1  # Door Child Protection | Diagnostic request to the actuator component for unconditional activation or deactivation of child lock of a door (disable opening of the door from inside)
    ChgInfoOfBltLockSt: interface=BltLockChgInfo1  # Change Information of Belt Lock State | Summery information: at least one state of the belt locks has changed
    ChimerFb: interface=ChimerCmd1  # Chimer Feedback | Information feedback related to the command to turn On/Off the chimer in the cluster. The type of the chimer sequence is up to the driver implementation in the cluster.
    CluPedlRat: interface=CluPedlRat1  # Clutch Pedal Ratio | Position of the clutch pedal | Evaluated signal jitter free without time filtering, plausibility check, monitored, including replacement value. 0% is driver off the pedal, offsets are removed. 100% must be ensured at end point of the pedal. Shall cover the 100% as well;signal is sent with initialisation
    CogPosnEstimd: interface=CogPosnEstimd1  # Cog Position Estimated | Estimation of the center of gravity relative to the center of front axle referring to ISO 8855 standard.
    CogPosnEstimd1: interface=CogPosn1  # Cog Position Estimated | Estimation of the center of gravity relative to the center of front axle referring to ISO 8855 standard.
    CoolFltOfDrvrSeat: interface=FltStOfSeatClima1  # Cooling Fault from Actuator | Seat Cooling Fault From Actuator
    CoolFltOfPassSeat: interface=FltStOfSeatClima1  # Cooling Fault from Actuator | Seat Cooling Fault From Actuator
    CoolFltOfSeatReLe: interface=FltStOfSeatClima1  # Cooling Fault from Actuator | Seat Cooling Fault From Actuator
    CoolFltOfSeatReRi: interface=FltStOfSeatClima1  # Cooling Fault from Actuator | Seat Cooling Fault From Actuator
    CoolSeatFlt: interface=FltStOfSeatClima1  # Cooling Seat Fault from Actuator | Seat Cooling Fault From Actuator
    CoolgCmdToActrOfSeatCoolg: interface=SeatClimaCmd1  # Cooling Command to Actuator of Seat Cooling | Cooling command To Actuator Of a Seat
    CoorrStActAtAxleFrnt: interface=DftlCoorrSt1  # Coordinator Status Actual at Axle Front | Status of the Front Axle Coordinator.
    CoorrStActAtAxleRe: interface=DftlCoorrSt1  # Coordinator Status Actual at Axle Rear | Status of the Rear Axle Coordinator.
    CoorrStActAtDftlForTqTrf: interface=DftlCoorrSt1  # Coordinator Status Actual at Differential for Torque Transfer | Status of the Transfer Case Coordinator.
    CoorrStConsoldAtAxleFrnt: interface=DftlCoorrSt1  # Coordinator Status Consolidated at Axle Front | Status of the Front Axle Coordinator.
    CoorrStConsoldAtAxleRe: interface=DftlCoorrSt1  # Coordinator Status Consolidated at Axle Rear | Status of the Rear Axle Coordinator.
    CoorrStConsoldAtDftlForTqTrf: interface=DftlCoorrSt1  # Coordinator Status Consolidated at Differential for Torque Transfer | Status of the Transfer Case Coordinator.
    CoorrStsActAtAxleFrnt: interface=DftlCoorrSts1  # Coordinator Status Actual at Axle Front | Status of the Front Axle Coordinator.
    CoorrStsActAtAxleRe: interface=DftlCoorrSts1  # Coordinator Status Actual at Axle Rear | Status of the Rear Axle Coordinator.
    CoorrStsActAtDftlForTqTrf: interface=DftlCoorrSts1  # Coordinator Status Actual at Differential for Torque Transfer | Status of the Transfer Case Coordinator.
    CornrMkr: interface=LiExtCmd1  # Corner Marker | This port provides command to turn on the corner marker light
    CornrMkrLeOut: interface=LiExtCmd1  # Corner Marker Left Output | This port provides command to turn on left corner marker light
    CornrMkrReq: interface=CornrMkrReq1  # Corner Marker Request | Request to activate corner markers
    CornrMkrRiOut: interface=LiExtCmd1  # Corner Marker Right Output | This port provides command to turn on right corner marker light
    Crash: interface=CrashSt1  # Crash Status | This port provides the actual crash status pre-crash and post-crash
    CrsCtrlActv: interface=CrsCtrlActv1  # Cruise Control Active | Switch operated by driver to set Cruise Control stand-by mode to on.
    CrsCtrlAndAccDrvrOvrd: interface=CrsCtrlAndAccDrvrOvrd1  # Cruise Control and Adaptive Cruise Control Driver Override | Adaptive Cruise Control or Cruise Control is overridden by driver.
    CrsCtrlAndAccSetTiGap: interface=SetTiGap1  # Cruise Control and Adaptive Cruise Control Set Time Gap | Time gap, set by the driver. This time gap is used to control the distance in case of detected vehicle ahead.
    CrsCtrlAndAccSetTiGapDec: interface=TiGapDec1  # Cruise Control and Adaptive Cruise Control Set Time Gap Decrease | Status of decrease time gap switch of Adaptive Cruise Control (ACC). This switch is used to decrease the ACC time gap.
    CrsCtrlAndAccSetTiGapInc: interface=TiGapInc1  # Cruise Control and Adaptive Cruise Control Set Time Gap Increase | Status of increase time gap switch of Adaptive Cruise Control (ACC). This switch is used to increase the ACC time gap.
    CrsCtrlAndAccSwtStEngd: interface=CrsCtrlAndAccSwtStEngd1  # Cruise Control and Adaptive Cruise Control Switch Status Engaged | Status of the switch to engage, disengage or resume Adaptive Cruise Control or Cruise Control.
    CrsCtrlAndAccSwtStsEngd: interface=CrsCtrlAndAccSwtStsEngd1  # Cruise Control and Adaptive Cruise Control Switch Status Engaged | Status of the switch to engage, disengage or resume Adaptive Cruise Control or Cruise Control.
    CrsCtrlAndAccVehSpdLgt: interface=CrsCtrlAndAccVehSpdLgt1  # Cruise Control and Adaptive Cruise Control Vehicle Speed Longitudinal | Based on Vehicle Longitudinal Speed. Filtered for Cruise Control or Adaptive Cruise Control specific purpose.
    CrsCtrlCtrlActv: interface=CrsCtrlCtrlActv1  # Cruise Control Control Active | Cruise Control is engaged and active. This information is used for display feedback for driver as well.
    CtrlOfActrAirbFrntAtDrvr: interface=CtrlOfActrForOccptPedSfty1  # Control of Actuator Airbag Front at Driver | Control of actuator front airbag to protect driver
    CtrlOfActrAirbFrntAtPass: interface=CtrlOfActrForOccptPedSfty1  # Control of Actuator Airbag Front at Passenger | Control of actuator front airbag to protect passenger
    CtrlOfActrAirbFrntAtRowFirstMid: interface=CtrlOfActrForOccptPedSfty1  # Control of Actuator Airbag Front at Row First Middle | Control of actuator front airbag to protect occupant at first row middle seat
    CtrlOfActrAirbSideAtDrvr: interface=CtrlOfActrForOccptPedSfty1  # Control of Actuator Airbag Side at Driver | Control of actuator side airbag at driver position to protect driver at side impact situations
    CtrlOfActrAirbSideAtPass: interface=CtrlOfActrForOccptPedSfty1  # Control of Actuator Airbag Side at Passenger | Control of actuator side airbag at passenger position to protect passenger at side impact situations
    CtrlOfActrAirbSideAtRowSecLe: interface=CtrlOfActrForOccptPedSfty1  # Control of Actuator Airbag Side at Row Second Left | Control of actuator side airbag at second row, left side to protect occupant at side impact situations
    CtrlOfActrAirbSideAtRowSecRi: interface=CtrlOfActrForOccptPedSfty1  # Control of Actuator Airbag Side at Row Second Right | Control of actuator side airbag at second row, right side to protect occupant at side impact situations
    CtrlOfActrAirbSideAtRowThrdLe: interface=CtrlOfActrForOccptPedSfty1  # Control of Actuator Airbag Side at Row Third Left | Control of actuator side airbag at third row, left side to protect occupant at side impact situations
    CtrlOfActrAirbSideAtRowThrdRi: interface=CtrlOfActrForOccptPedSfty1  # Control of Actuator Airbag Side at Row Third Right | Control of actuator side airbag at third row, right side to protect occupant at side impact situations
    CtrlOfActrAnchrfitgTensnrAtDrvr: interface=CtrlOfActrForOccptPedSfty1  # Control of Actuator Anchorfitting Tensioner at Driver | Control of actuator anchor fitting tensioner at driver position
    CtrlOfActrAnchrfitgTensnrAtPass: interface=CtrlOfActrForOccptPedSfty1  # Control of Actuator Anchorfitting Tensioner at Passenger | Control of actuator anchor fitting tensioner at passenger position
    CtrlOfActrAnchrfitgTensnrAtRowFirstMid: interface=CtrlOfActrForOccptPedSfty1  # Control of Actuator Anchorfitting Tensioner at Row First Middle | Control of actuator anchor fitting tensioner at seat in first row, middle position
    CtrlOfActrAnchrfitgTensnrAtRowSecLe: interface=CtrlOfActrForOccptPedSfty1  # Control of Actuator Anchorfitting Tensioner at Row Second Left | Control of actuator anchor fitting tensioner at seat in second row, left position
    CtrlOfActrAnchrfitgTensnrAtRowSecMid: interface=CtrlOfActrForOccptPedSfty1  # Control of Actuator Anchorfitting Tensioner at Row Second Middle | Control of actuator anchor fitting tensioner at seat in second row, middle position
    CtrlOfActrAnchrfitgTensnrAtRowSecRi: interface=CtrlOfActrForOccptPedSfty1  # Control of Actuator Anchorfitting Tensioner at Row Second Right | Control of actuator anchor fitting tensioner at seat in second row, right position
    CtrlOfActrAnchrfitgTensnrAtRowThrdLe: interface=CtrlOfActrForOccptPedSfty1  # Control of Actuator Anchorfitting Tensioner at Row Third Left | Control of actuator anchor fitting tensioner at seat in third row, left position
    CtrlOfActrAnchrfitgTensnrAtRowThrdMid: interface=CtrlOfActrForOccptPedSfty1  # Control of Actuator Anchorfitting Tensioner at Row Third Middle | Control of actuator anchor fitting tensioner at seat in third row, middle position
    CtrlOfActrAnchrfitgTensnrAtRowThrdRi: interface=CtrlOfActrForOccptPedSfty1  # Control of Actuator Anchorfitting Tensioner at Row Third Right | Control of actuator anchor fitting tensioner at seat in third row, right position
    CtrlOfActrAntisubCushAtDrvr: interface=CtrlOfActrForOccptPedSfty1  # Control of Actuator Antisubmarine Cushion at Driver | Control of actuator Antisubmarine cushion at driver position
    CtrlOfActrAntisubCushAtPass: interface=CtrlOfActrForOccptPedSfty1  # Control of Actuator Antisubmarine Cushion at Passenger | Control of actuator Antisubmarine cushion at passenger position
    CtrlOfActrAntisubCushAtRowFirstMid: interface=CtrlOfActrForOccptPedSfty1  # Control of Actuator Antisubmarine Cushion at Row First Middle | Control of actuator Antisubmarine cushion at seat in first row, middle position
    CtrlOfActrAntisubCushAtRowSecLe: interface=CtrlOfActrForOccptPedSfty1  # Control of Actuator Antisubmarine Cushion at Row Second Left | Control of actuator Antisubmarine cushion at seat in second row, left position
    CtrlOfActrAntisubCushAtRowSecMid: interface=CtrlOfActrForOccptPedSfty1  # Control of Actuator Antisubmarine Cushion at Row Second Middle | Control of actuator Antisubmarine cushion at seat in second row, middle position
    CtrlOfActrAntisubCushAtRowSecRi: interface=CtrlOfActrForOccptPedSfty1  # Control of Actuator Antisubmarine Cushion at Row Second Right | Control of actuator Antisubmarine cushion at seat in second row, right position
    CtrlOfActrAntisubCushAtRowThrdLe: interface=CtrlOfActrForOccptPedSfty1  # Control of Actuator Antisubmarine Cushion at Row Third Left | Control of actuator Antisubmarine cushion at seat in third row, left position
    CtrlOfActrAntisubCushAtRowThrdMid: interface=CtrlOfActrForOccptPedSfty1  # Control of Actuator Antisubmarine Cushion at Row Third Middle | Control of actuator Antisubmarine cushion at seat in third row, middle position
    CtrlOfActrAntisubCushAtRowThrdRi: interface=CtrlOfActrForOccptPedSfty1  # Control of Actuator Antisubmarine Cushion at Row Third Right | Control of actuator Antisubmarine cushion at seat in third row, right position
    CtrlOfActrAtApilLeForPedProtn: interface=CtrlOfActrForOccptPedSfty1  # Control of Actuator at Apillar Left for Pedestrian Protection | Control of actuator at left A-pillar to protect pedestrian
    CtrlOfActrAtApilRiForPedProtn: interface=CtrlOfActrForOccptPedSfty1  # Control of Actuator at Apillar Right for Pedestrian Protection | Control of actuator at right A-pillar to protect pedestrian
    CtrlOfActrAtBmpForPedProtn: interface=CtrlOfActrForOccptPedSfty1  # Control of Actuator at Bumper for Pedestrian Protection | Control of bumper actuator to protect pedestrian
    CtrlOfActrAtHoodForPedProtn: interface=CtrlOfActrForOccptPedSfty1  # Control of Actuator at Hood for Pedestrian Protection | Control of hood actuator to protect pedestrian
    CtrlOfActrAtRoofForPedProtn: interface=CtrlOfActrForOccptPedSfty1  # Control of Actuator at Roof for Pedestrian Protection | Control of actuator at roof to protect pedestrian
    CtrlOfActrBltLimrAtDrvr: interface=CtrlOfActrForOccptPedSfty1  # Control of Actuator Belt Limiter at Driver | Control of actuator belt limiter at driver position
    CtrlOfActrBltLimrAtPass: interface=CtrlOfActrForOccptPedSfty1  # Control of Actuator Belt Limiter at Passenger | Control of actuator belt limiter at passenger position
    CtrlOfActrBltLimrAtRowFirstMid: interface=CtrlOfActrForOccptPedSfty1  # Control of Actuator Belt Limiter at Row First Middle | Control of actuator belt limiter at seat in first row, middle position
    CtrlOfActrBltLimrAtRowSecLe: interface=CtrlOfActrForOccptPedSfty1  # Control of Actuator Belt Limiter at Row Second Left | Control of actuator belt limiter at seat in second row, left position
    CtrlOfActrBltLimrAtRowSecMid: interface=CtrlOfActrForOccptPedSfty1  # Control of Actuator Belt Limiter at Row Second Middle | Control of actuator belt limiter at seat in second row, middle position
    CtrlOfActrBltLimrAtRowSecRi: interface=CtrlOfActrForOccptPedSfty1  # Control of Actuator Belt Limiter at Row Second Right | Control of actuator belt limiter at seat in second row, right position
    CtrlOfActrBltLimrAtRowThrdLe: interface=CtrlOfActrForOccptPedSfty1  # Control of Actuator Belt Limiter at Row Third Left | Control of actuator belt limiter at seat in third row, left position
    CtrlOfActrBltLimrAtRowThrdMid: interface=CtrlOfActrForOccptPedSfty1  # Control of Actuator Belt Limiter at Row Third Middle | Control of actuator belt limiter at seat in third row, middle position
    CtrlOfActrBltLimrAtRowThrdRi: interface=CtrlOfActrForOccptPedSfty1  # Control of Actuator Belt Limiter at Row Third Right | Control of actuator belt limiter at seat in third row, right position
    CtrlOfActrBltTensnrAtDrvr: interface=CtrlOfActrForOccptPedSfty1  # Control of Actuator Belt Tensioner at Driver | Control of actuator belt tensioner at driver position
    CtrlOfActrBltTensnrAtPass: interface=CtrlOfActrForOccptPedSfty1  # Control of Actuator Belt Tensioner at Passenger | Control of actuator belt tensioner at passenger position
    CtrlOfActrBltTensnrAtRowFirstMid: interface=CtrlOfActrForOccptPedSfty1  # Control of Actuator Belt Tensioner at Row First Middle | Control of actuator belt tensioner at seat in first row, middle position
    CtrlOfActrBltTensnrAtRowSecLe: interface=CtrlOfActrForOccptPedSfty1  # Control of Actuator Belt Tensioner at Row Second Left | Control of actuator belt tensioner at seat in second row, left position
    CtrlOfActrBltTensnrAtRowSecMid: interface=CtrlOfActrForOccptPedSfty1  # Control of Actuator Belt Tensioner at Row Second Middle | Control of actuator belt tensioner at seat in second row, middle position
    CtrlOfActrBltTensnrAtRowSecRi: interface=CtrlOfActrForOccptPedSfty1  # Control of Actuator Belt Tensioner at Row Second Right | Control of actuator belt tensioner at seat in second row, right position
    CtrlOfActrBltTensnrAtRowThrdLe: interface=CtrlOfActrForOccptPedSfty1  # Control of Actuator Belt Tensioner at Row Third Left | Control of actuator belt tensioner at seat in third row, left position
    CtrlOfActrBltTensnrAtRowThrdMid: interface=CtrlOfActrForOccptPedSfty1  # Control of Actuator Belt Tensioner at Row Third Middle | Control of actuator belt tensioner at seat in third row, middle position
    CtrlOfActrBltTensnrAtRowThrdRi: interface=CtrlOfActrForOccptPedSfty1  # Control of Actuator Belt Tensioner at Row Third Right | Control of actuator belt tensioner at seat in third row, right position
    CtrlOfActrBucRtrctrAtDrvr: interface=CtrlOfActrForOccptPedSfty1  # Control of Actuator Buckle Retractor at Driver | Control of actuator buckle retractor at driver position
    CtrlOfActrBucRtrctrAtPass: interface=CtrlOfActrForOccptPedSfty1  # Control of Actuator Buckle Retractor at Passenger | Control of actuator buckle retractor at passenger position
    CtrlOfActrBucRtrctrAtRowFirstMid: interface=CtrlOfActrForOccptPedSfty1  # Control of Actuator Buckle Retractor at Row First Middle | Control of actuator buckle retractor at seat in first row, middle position
    CtrlOfActrBucRtrctrAtRowSecLe: interface=CtrlOfActrForOccptPedSfty1  # Control of Actuator Buckle Retractor at Row Second Left | Control of actuator buckle retractor at seat in second row, left position
    CtrlOfActrBucRtrctrAtRowSecMid: interface=CtrlOfActrForOccptPedSfty1  # Control of Actuator Buckle Retractor at Row Second Middle | Control of actuator buckle retractor at seat in second row, middle position
    CtrlOfActrBucRtrctrAtRowSecRi: interface=CtrlOfActrForOccptPedSfty1  # Control of Actuator Buckle Retractor at Row Second Right | Control of actuator buckle retractor at seat in second row, right position
    CtrlOfActrBucRtrctrAtRowThrdLe: interface=CtrlOfActrForOccptPedSfty1  # Control of Actuator Buckle Retractor at Row Third Left | Control of actuator buckle retractor at seat in third row, left position
    CtrlOfActrBucRtrctrAtRowThrdMid: interface=CtrlOfActrForOccptPedSfty1  # Control of Actuator Buckle Retractor at Row Third Middle | Control of actuator buckle retractor at seat in third row, middle position
    CtrlOfActrBucRtrctrAtRowThrdRi: interface=CtrlOfActrForOccptPedSfty1  # Control of Actuator Buckle Retractor at Row Third Right | Control of actuator buckle retractor at seat in third row, right position
    CtrlOfActrCurtAirbAtLe: interface=CtrlOfActrForOccptPedSfty1  # Control of Actuator Curtain Airbag at Left | Control of left curtain airbag actuator to protect occupants at side impact
    CtrlOfActrCurtAirbAtRi: interface=CtrlOfActrForOccptPedSfty1  # Control of Actuator Curtain Airbag at Right | Control of right curtain airbag actuator to protect occupants at side impact
    CtrlOfActrHdrestAtDrvr: interface=CtrlOfActrForOccptPedSfty1  # Control of Actuator Headrest at Driver | Control of actuator headrest at driver seat position
    CtrlOfActrHdrestAtPass: interface=CtrlOfActrForOccptPedSfty1  # Control of Actuator Headrest at Passenger | Control of actuator headrest at passenger seat position
    CtrlOfActrHdrestAtRowFirstMid: interface=CtrlOfActrForOccptPedSfty1  # Control of Actuator Headrest at Row First Middle | Control of actuator headrest at middle seat position of first row
    CtrlOfActrHdrestAtRowSecLe: interface=CtrlOfActrForOccptPedSfty1  # Control of Actuator Headrest at Row Second Left | Control of actuator headrest at left seat position of second row
    CtrlOfActrHdrestAtRowSecMid: interface=CtrlOfActrForOccptPedSfty1  # Control of Actuator Headrest at Row Second Middle | Control of actuator headrest at middle seat position of second row
    CtrlOfActrHdrestAtRowSecRi: interface=CtrlOfActrForOccptPedSfty1  # Control of Actuator Headrest at Row Second Right | Control of actuator headrest at right seat position of second row
    CtrlOfActrHdrestAtRowThrdLe: interface=CtrlOfActrForOccptPedSfty1  # Control of Actuator Headrest at Row Third Left | Control of actuator headrest at left seat position of third row
    CtrlOfActrHdrestAtRowThrdMid: interface=CtrlOfActrForOccptPedSfty1  # Control of Actuator Headrest at Row Third Middle | Control of actuator headrest at middle seat position of third row
    CtrlOfActrHdrestAtRowThrdRi: interface=CtrlOfActrForOccptPedSfty1  # Control of Actuator Headrest at Row Third Right | Control of actuator headrest at right seat position of third row
    CtrlOfActrKneeProtnAtDrvr: interface=CtrlOfActrForOccptPedSfty1  # Control of Actuator Knee Protection at Driver | Control of knee protection actuator to protect drivers knee
    CtrlOfActrKneeProtnAtPass: interface=CtrlOfActrForOccptPedSfty1  # Control of Actuator Knee Protection at Passenger | Control of knee protection actuator to protect passenger knee
    CtrlOfActrKneeProtnAtRowFirstMid: interface=CtrlOfActrForOccptPedSfty1  # Control of Actuator Knee Protection at Row First Middle | Control of knee protection actuator to protect occupant knee at first row middle seat
    CtrlOfActrPelvProtnAtDrvr: interface=CtrlOfActrForOccptPedSfty1  # Control of Actuator Pelvis Protection at Driver | Control of pelvis protection actuator at driver position
    CtrlOfActrPelvProtnAtPass: interface=CtrlOfActrForOccptPedSfty1  # Control of Actuator Pelvis Protection at Passenger | Control of pelvis protection actuator at passenger position
    CtrlOfActrPelvProtnAtRowSecLe: interface=CtrlOfActrForOccptPedSfty1  # Control of Actuator Pelvis Protection at Row Second Left | Control of pelvis protection actuator at second row on left side
    CtrlOfActrPelvProtnAtRowSecRi: interface=CtrlOfActrForOccptPedSfty1  # Control of Actuator Pelvis Protection at Row Second Right | Control of pelvis protection actuator at second row at right side
    CtrlOfActrPelvProtnAtRowThrdLe: interface=CtrlOfActrForOccptPedSfty1  # Control of Actuator Pelvis Protection at Row Third Left | Control of pelvis protection actuator at third row at left side
    CtrlOfActrPelvProtnAtRowThrdRi: interface=CtrlOfActrForOccptPedSfty1  # Control of Actuator Pelvis Protection at Row Third Right | Control of pelvis protection actuator at third row at right side
    CtrlOfActrThoraxAirbAtDrvr: interface=CtrlOfActrForOccptPedSfty1  # Control of Actuator Thorax Airbag at Driver | Control of actuator head/thorax airbag between driver and compartment
    CtrlOfActrThoraxAirbAtPass: interface=CtrlOfActrForOccptPedSfty1  # Control of Actuator Thorax Airbag at Passenger | Control of actuator head/thorax airbag between passenger and compartment
    CtrlOfActrThoraxAirbAtRowFirstMidToDrvr: interface=CtrlOfActrForOccptPedSfty1  # Control of Actuator Thorax Airbag at Row First Middle to Driver | Control of actuator head/thorax airbag in first row in between driver and middle seating position or driver and passenger
    CtrlOfActrThoraxAirbAtRowFirstMidToPass: interface=CtrlOfActrForOccptPedSfty1  # Control of Actuator Thorax Airbag at Row First Middle to Passenger | Control of actuator head/thorax airbag in first row in between passenger and middle seating position
    CtrlOfActrThoraxAirbAtRowSecLe: interface=CtrlOfActrForOccptPedSfty1  # Control of Actuator Thorax Airbag at Row Second Left | Control of actuator head/thorax airbag in second row at the left
    CtrlOfActrThoraxAirbAtRowSecMidLe: interface=CtrlOfActrForOccptPedSfty1  # Control of Actuator Thorax Airbag at Row Second Middle Left | Control of actuator head/thorax airbag at second row in between middle and left seating position
    CtrlOfActrThoraxAirbAtRowSecMidRi: interface=CtrlOfActrForOccptPedSfty1  # Control of Actuator Thorax Airbag at Row Second Middle Right | Control of actuator head/thorax airbag at second row in between middle and right seating position
    CtrlOfActrThoraxAirbAtRowSecRi: interface=CtrlOfActrForOccptPedSfty1  # Control of Actuator Thorax Airbag at Row Second Right | Control of actuator head/thorax airbag in second row at the right
    CtrlOfActrThoraxAirbAtRowThrdLe: interface=CtrlOfActrForOccptPedSfty1  # Control of Actuator Thorax Airbag at Row Third Left | Control of actuator head/thorax airbag in third row at the left
    CtrlOfActrThoraxAirbAtRowThrdMidLe: interface=CtrlOfActrForOccptPedSfty1  # Control of Actuator Thorax Airbag at Row Third Middle Left | Control of actuator head/thorax airbag at third row in between middle and left seating position
    CtrlOfActrThoraxAirbAtRowThrdMidRi: interface=CtrlOfActrForOccptPedSfty1  # Control of Actuator Thorax Airbag at Row Third Middle Right | Control of actuator head/thorax airbag in third row in between middle and right seating position
    CtrlOfActrThoraxAirbAtRowThrdRi: interface=CtrlOfActrForOccptPedSfty1  # Control of Actuator Thorax Airbag at Row Third Right | Control of actuator head/thorax airbag in third row at the right
    DamprCoeffEstimd: interface=DamprCoeffEstimd1  # Damper Coefficient Estimated | Estimation of the actual damper coefficient provided by the damper system
    DamprCoeffEstimd1: interface=DamprCoeff1  # Damper Coefficient Estimated | Estimation of the actual damper coefficient provided by the damper system
    DamprCtrlMod: interface=DamprCtrlMod1  # Damper Control Mode | Damper tuning mode for display to the driver
    DamprCtrlTunReq: interface=DamprCtrlTunReq1  # Damper Control Tuning Request | Damper control tuning mode request by the driver.
    DamprFEstimd: interface=DamprFEstimd1  # Damper Force Estimated | Estimation of the actual damper forces provided by the damper system.
    DamprFEstimd1: interface=DamprF1  # Damper Force Estimated | Estimation of the actual damper forces provided by the damper system.
    DamprHndlgBalCoeff: interface=HndlgBalCoeff1  # Damper Handling Balance Coefficient | Estimated damper handling balance coefficient defined as deviation from defined understeering characteristics. Ranging from maximum applicable understeering to maximum applicable oversteering.
    DamprRateCmpn: interface=DamprRate1  # Damper Rate Compression | Current damper rate (compression) of active dampers.
    DamprRateRbd: interface=DamprRate1  # Damper Rate Rebound | Current damper rate (rebound) of active dampers.
    DamprRateReqCmpn: interface=DamprRate1  # Damper Rate Request Compression | Requested damper rate (compression) to be set by active damper system.
    DamprRateReqRbd: interface=DamprRate1  # Damper Rate Request Rebound | Requested damper rate (rebound) to be set by active damper system.
    DamprSt: interface=DamprSt1  # Damper Status | Status of the semi-active or switchable damper
    DamprSts: interface=DamprSts1  # Damper Status | Status of the semi-active or switchable damper
    DateTi: interface=DateTiStamp1  # Date Time | Represents the current date and the current time. | Example for realization: Transmitted cyclically with a cycle time of one second.
    DefrstReqFrntFromHmi: interface=DefrstReq1  # Front Defrost Request from HMI | Port for Front Defrost Request From Hmi
    DefrstReqReFromHmi: interface=DefrstReq1  # Rear Defrost Request from HMI | Port for Rear Defrost Request From Hmi
    DftlTqActAtAxleFrnt: interface=TrsmTqDftlAxleFrntAct1  # Differential Torque Actual at Axle Front | Actual theoretical maximum transfer torque at the differential on the front axle as realised by the actuator. | Sign convention: Positive to the right or front.
    DftlTqAtAxleRe: interface=TrsmTqDftlAxleReAct1  # Differential Torque at Axle Rear | Actual theoretical torque at the differential on the rear axle as requested by Drivetrain Torque Distribution. | Sign convention: Positive to the right or front or from faster to slower shaft depending on the available device.
    DftlTqAtDftlForTqTrf: interface=TrsmTqDftlTrfAct1  # Differential Torque at Differential for Torque Transfer | Actual theoretical torque at the Transfer Case Differential as requested by Drivetrain Torque Distribution. | Sign convention: Positive to the right or front or from faster to slower shaft depending on the available device.
    DftlTqConsoldAtAxleFrnt: interface=TrsmTqDftlAxleFrntAct1  # Differential Torque Consolidated at Axle Front | Consolidated theoretical maximum transfer torque at the differential on the front axle as realised by the actuator. | Sign convention: Positive to the right or front.
    DftlTqMaxAtAxleFrnt: interface=TrsmTqDftlAxleFrntMax1  # Differential Torque Maximum at Axle Front | Maximum torque available at the differential on the front axle as requested by Drivetrain Torque Distribution. | Sign convention: Positive to the right or front or from faster to slower shaft depending on the available device.
    DftlTqMaxAtAxleRe: interface=TrsmTqDftlAxleReMax1  # Differential Torque Maximum at Axle Rear | Maximum torque available at the differential on the rear axle as requested by Drivetrain Torque Distribution. | Sign convention: Positive to the right or front or from faster to slower shaft depending on the available device.
    DftlTqMaxAtDftlForTqTrf: interface=TrsmTqDftlTrfMax1  # Differential Torque Maximum at Differential for Torque Transfer | Maximum torque available at the Transfer Case Differential as requested by Drivetrain Torque Distribution. | Sign convention: Positive to the right or front or from faster to slower shaft depending on the available device.
    DftlTqReqAtAxleFrnt: interface=DftlTqReq1  # Differential Torque Request at Axle Front | Requested torque at the differential on the front axle as requested by Drivetrain Torque Distribution. | Sign convention: Positive to the right or front or from faster to slower shaft depending on the available device.
    DftlTqReqAtAxleRe: interface=DftlTqReq1  # Differential Torque Request at Axle Rear | Requested torque at the differential on the rear axle as requested by Drivetrain Torque Distribution. | Sign convention: Positive to the right or front or from faster to slower shaft depending on the available device.
    DftlTqReqAtDftlForTqTrf: interface=DftlTqReq1  # Differential Torque Request at Differential for Torque Transfer | Requested torque at the Transfer Case Differential as requested by Drivetrain Torque Distribution. | Sign convention: Positive to the right or front or from faster to slower shaft depending on the available device.
    DftlYawStabyCtrlIntvg: interface=YawStabyCtrlIntvg1  # Differential Yaw Stability Control Intervening | Indication whether the yaw stability control by drivetrain torque distribution is intervening or not.
    DiagcChdProtnOfDoorLockReLe: interface=DiagcChdProtn1  # Rear Door Diagnostic Child Protection | Diagnostic request to the actuator component for unconditional activation or deactivation of child lock of a rear door (disable opening of the rear door from inside)
    DiagcChdProtnOfDoorLockReRi: interface=DiagcChdProtn1  # Rear Door Diagnostic Child Protection | Diagnostic request to the actuator component for unconditional activation or deactivation of child lock of a rear door (disable opening of the rear door from inside)
    DiagcHtlMod: interface=DiagcHtlMod1  # Diagnostic Hotel Mode | Diagnostic request to manipulate an actuator component of the hotel mode to unconditionally activate or deactivate this mode
    DiagcLock: interface=DiagcLock1  # Door Diagnostic Lock | Diagnostic request to manipulate an actuator component of the door to unconditionally unlock, lock or safe at the latch
    DiagcLockOfDoorLockReLe: interface=DiagcLock1  # Rear Door Diagnostic Lock | Diagnostic request to manipulate an actuator component of a rear door to unconditionally unlock, lock or safe at the latch
    DiagcLockOfDoorLockReRi: interface=DiagcLock1  # Rear Door Diagnostic Lock | Diagnostic request to manipulate an actuator component of a rear door to unconditionally unlock, lock or safe at the latch
    DiagcLockOfDrvrDoorLock: interface=DiagcLock1  # Front Door Diagnostic Lock | Diagnostic request to manipulate an actuator component of a front door to unconditionally unlock, lock or safe at the latch
    DiagcLockOfLidRe: interface=DiagcLock1  # Diagnostic Lock of Lid Rear | Diagnostic request to manipulate an actuator component of the rear lid to unconditionally unlock, lock or safe at the latch
    DiagcLockOfPassDoorLock: interface=DiagcLock1  # Front Door Diagnostic Lock | Diagnostic request to manipulate an actuator component of a front door to unconditionally unlock, lock or safe at the latch
    DiagcPullAid: interface=DiagcPullAid1  # Door Diagnostic Pull Aid | Diagnostic request to manipulate an actuator component of the door to unconditionally activate or deactivate the pull aid of the door
    DiagcPullAidOfDoorLockReLe: interface=DiagcPullAid1  # Rear Door Diagnostic Pull Aid | Diagnostic request to manipulate an actuator component of a rear door to unconditionally activate or deactivate the pull aid of the door
    DiagcPullAidOfDoorLockReRi: interface=DiagcPullAid1  # Rear Door Diagnostic Pull Aid | Diagnostic request to manipulate an actuator component of a rear door to unconditionally activate or deactivate the pull aid of the door
    DiagcPullAidOfDrvrDoorLock: interface=DiagcPullAid1  # Front Door Diagnostic Pull Aid | Diagnostic request to manipulate an actuator component of a front door to unconditionally activate or deactivate the pull aid of the door
    DiagcPullAidOfPassDoorLock: interface=DiagcPullAid1  # Front Door Diagnostic Pull Aid | Diagnostic request to manipulate an actuator component of a front door to unconditionally activate or deactivate the pull aid of the door
    DiagcReq: interface=DiagcBri1  # Diagnostic Request For A Light Source | Diagnostic request to manipulate a light actuator accordingly in order to unconditionally activate a light actuator with a certain brightness or release the light actuator. Initial value {0, Off}
    DiagcReqOfAshtrayLiFrntCen: interface=DiagcBri1  # Diagnostic Request for Interior Light Source | Diagnostic request to manipulate a light actuator accordingly in order to unconditionally activate a light actuator with a certain brightness or release the light actuator. Initial value {0, Off}
    DiagcReqOfAshtrayLiFrntLe: interface=DiagcBri1  # Diagnostic Request for Interior Light Source | Diagnostic request to manipulate a light actuator accordingly in order to unconditionally activate a light actuator with a certain brightness or release the light actuator. Initial value {0, Off}
    DiagcReqOfAshtrayLiFrntRi: interface=DiagcBri1  # Diagnostic Request for Interior Light Source | Diagnostic request to manipulate a light actuator accordingly in order to unconditionally activate a light actuator with a certain brightness or release the light actuator. Initial value {0, Off}
    DiagcReqOfAshtrayLiGroup: interface=DiagcBri1  # Diagnostic Request for Interior Light Source | Diagnostic request to manipulate a light actuator accordingly in order to unconditionally activate a light actuator with a certain brightness or release the light actuator. Initial value {0, Off}
    DiagcReqOfAshtrayLiMidCen: interface=DiagcBri1  # Diagnostic Request for Interior Light Source | Diagnostic request to manipulate a light actuator accordingly in order to unconditionally activate a light actuator with a certain brightness or release the light actuator. Initial value {0, Off}
    DiagcReqOfAshtrayLiMidLe: interface=DiagcBri1  # Diagnostic Request for Interior Light Source | Diagnostic request to manipulate a light actuator accordingly in order to unconditionally activate a light actuator with a certain brightness or release the light actuator. Initial value {0, Off}
    DiagcReqOfAshtrayLiMidRi: interface=DiagcBri1  # Diagnostic Request for Interior Light Source | Diagnostic request to manipulate a light actuator accordingly in order to unconditionally activate a light actuator with a certain brightness or release the light actuator. Initial value {0, Off}
    DiagcReqOfAshtrayLiReCen: interface=DiagcBri1  # Diagnostic Request for Interior Light Source | Diagnostic request to manipulate a light actuator accordingly in order to unconditionally activate a light actuator with a certain brightness or release the light actuator. Initial value {0, Off}
    DiagcReqOfAshtrayLiReLe: interface=DiagcBri1  # Diagnostic Request for Interior Light Source | Diagnostic request to manipulate a light actuator accordingly in order to unconditionally activate a light actuator with a certain brightness or release the light actuator. Initial value {0, Off}
    DiagcReqOfAshtrayLiReRi: interface=DiagcBri1  # Diagnostic Request for Interior Light Source | Diagnostic request to manipulate a light actuator accordingly in order to unconditionally activate a light actuator with a certain brightness or release the light actuator. Initial value {0, Off}
    DiagcReqOfCbnLiFrntCen: interface=DiagcBri1  # Diagnostic Request for Interior Light Source | Diagnostic request to manipulate a light actuator accordingly in order to unconditionally activate a light actuator with a certain brightness or release the light actuator. Initial value {0, Off}
    DiagcReqOfCbnLiFrntLe: interface=DiagcBri1  # Diagnostic Request for Interior Light Source | Diagnostic request to manipulate a light actuator accordingly in order to unconditionally activate a light actuator with a certain brightness or release the light actuator. Initial value {0, Off}
    DiagcReqOfCbnLiFrntRi: interface=DiagcBri1  # Diagnostic Request for Interior Light Source | Diagnostic request to manipulate a light actuator accordingly in order to unconditionally activate a light actuator with a certain brightness or release the light actuator. Initial value {0, Off}
    DiagcReqOfCbnLiGroup: interface=DiagcBri1  # Diagnostic Request for Interior Light Source | Diagnostic request to manipulate a light actuator accordingly in order to unconditionally activate a light actuator with a certain brightness or release the light actuator. Initial value {0, Off}
    DiagcReqOfCbnLiMidCen: interface=DiagcBri1  # Diagnostic Request for Interior Light Source | Diagnostic request to manipulate a light actuator accordingly in order to unconditionally activate a light actuator with a certain brightness or release the light actuator. Initial value {0, Off}
    DiagcReqOfCbnLiMidLe: interface=DiagcBri1  # Diagnostic Request for Interior Light Source | Diagnostic request to manipulate a light actuator accordingly in order to unconditionally activate a light actuator with a certain brightness or release the light actuator. Initial value {0, Off}
    DiagcReqOfCbnLiMidRi: interface=DiagcBri1  # Diagnostic Request for Interior Light Source | Diagnostic request to manipulate a light actuator accordingly in order to unconditionally activate a light actuator with a certain brightness or release the light actuator. Initial value {0, Off}
    DiagcReqOfCbnLiReCen: interface=DiagcBri1  # Diagnostic Request for Interior Light Source | Diagnostic request to manipulate a light actuator accordingly in order to unconditionally activate a light actuator with a certain brightness or release the light actuator. Initial value {0, Off}
    DiagcReqOfCbnLiReLe: interface=DiagcBri1  # Diagnostic Request for Interior Light Source | Diagnostic request to manipulate a light actuator accordingly in order to unconditionally activate a light actuator with a certain brightness or release the light actuator. Initial value {0, Off}
    DiagcReqOfCbnLiReRi: interface=DiagcBri1  # Diagnostic Request for Interior Light Source | Diagnostic request to manipulate a light actuator accordingly in order to unconditionally activate a light actuator with a certain brightness or release the light actuator. Initial value {0, Off}
    DiagcReqOfCurbLiFrntLe: interface=DiagcBri1  # Diagnostic Request for Interior Light Source | Diagnostic request to manipulate a light actuator accordingly in order to unconditionally activate a light actuator with a certain brightness or release the light actuator. Initial value {0, Off}
    DiagcReqOfCurbLiFrntRi: interface=DiagcBri1  # Diagnostic Request for Interior Light Source | Diagnostic request to manipulate a light actuator accordingly in order to unconditionally activate a light actuator with a certain brightness or release the light actuator. Initial value {0, Off}
    DiagcReqOfCurbLiGroup: interface=DiagcBri1  # Diagnostic Request for Interior Light Source | Diagnostic request to manipulate a light actuator accordingly in order to unconditionally activate a light actuator with a certain brightness or release the light actuator. Initial value {0, Off}
    DiagcReqOfCurbLiMidLe: interface=DiagcBri1  # Diagnostic Request for Interior Light Source | Diagnostic request to manipulate a light actuator accordingly in order to unconditionally activate a light actuator with a certain brightness or release the light actuator. Initial value {0, Off}
    DiagcReqOfCurbLiMidRi: interface=DiagcBri1  # Diagnostic Request for Interior Light Source | Diagnostic request to manipulate a light actuator accordingly in order to unconditionally activate a light actuator with a certain brightness or release the light actuator. Initial value {0, Off}
    DiagcReqOfCurbLiReLe: interface=DiagcBri1  # Diagnostic Request for Interior Light Source | Diagnostic request to manipulate a light actuator accordingly in order to unconditionally activate a light actuator with a certain brightness or release the light actuator. Initial value {0, Off}
    DiagcReqOfCurbLiReRi: interface=DiagcBri1  # Diagnostic Request for Interior Light Source | Diagnostic request to manipulate a light actuator accordingly in order to unconditionally activate a light actuator with a certain brightness or release the light actuator. Initial value {0, Off}
    DiagcReqOfEngCmptmtLi: interface=DiagcBri1  # Diagnostic Request for Interior Light Source | Diagnostic request to manipulate a light actuator accordingly in order to unconditionally activate a light actuator with a certain brightness or release the light actuator. Initial value {0, Off}
    DiagcReqOfExtrLiSwtIllmn: interface=DiagcBri1  # Diagnostic Request for Interior Light Source | Diagnostic request to manipulate a light actuator accordingly in order to unconditionally activate a light actuator with a certain brightness or release the light actuator. Initial value {0, Off}
    DiagcReqOfFootwellGroup: interface=DiagcBri1  # Diagnostic Request for Interior Light Source | Diagnostic request to manipulate a light actuator accordingly in order to unconditionally activate a light actuator with a certain brightness or release the light actuator. Initial value {0, Off}
    DiagcReqOfFootwellLiFrntCen: interface=DiagcBri1  # Diagnostic Request for Interior Light Source | Diagnostic request to manipulate a light actuator accordingly in order to unconditionally activate a light actuator with a certain brightness or release the light actuator. Initial value {0, Off}
    DiagcReqOfFootwellLiFrntLe: interface=DiagcBri1  # Diagnostic Request for Interior Light Source | Diagnostic request to manipulate a light actuator accordingly in order to unconditionally activate a light actuator with a certain brightness or release the light actuator. Initial value {0, Off}
    DiagcReqOfFootwellLiFrntRi: interface=DiagcBri1  # Diagnostic Request for Interior Light Source | Diagnostic request to manipulate a light actuator accordingly in order to unconditionally activate a light actuator with a certain brightness or release the light actuator. Initial value {0, Off}
    DiagcReqOfFootwellLiMidCen: interface=DiagcBri1  # Diagnostic Request for Interior Light Source | Diagnostic request to manipulate a light actuator accordingly in order to unconditionally activate a light actuator with a certain brightness or release the light actuator. Initial value {0, Off}
    DiagcReqOfFootwellLiMidLe: interface=DiagcBri1  # Diagnostic Request for Interior Light Source | Diagnostic request to manipulate a light actuator accordingly in order to unconditionally activate a light actuator with a certain brightness or release the light actuator. Initial value {0, Off}
    DiagcReqOfFootwellLiMidRi: interface=DiagcBri1  # Diagnostic Request for Interior Light Source | Diagnostic request to manipulate a light actuator accordingly in order to unconditionally activate a light actuator with a certain brightness or release the light actuator. Initial value {0, Off}
    DiagcReqOfFootwellLiReCen: interface=DiagcBri1  # Diagnostic Request for Interior Light Source | Diagnostic request to manipulate a light actuator accordingly in order to unconditionally activate a light actuator with a certain brightness or release the light actuator. Initial value {0, Off}
    DiagcReqOfFootwellLiReLe: interface=DiagcBri1  # Diagnostic Request for Interior Light Source | Diagnostic request to manipulate a light actuator accordingly in order to unconditionally activate a light actuator with a certain brightness or release the light actuator. Initial value {0, Off}
    DiagcReqOfFootwellLiReRi: interface=DiagcBri1  # Diagnostic Request for Interior Light Source | Diagnostic request to manipulate a light actuator accordingly in order to unconditionally activate a light actuator with a certain brightness or release the light actuator. Initial value {0, Off}
    DiagcReqOfGlvCmptmtLi: interface=DiagcBri1  # Diagnostic Request for Interior Light Source | Diagnostic request to manipulate a light actuator accordingly in order to unconditionally activate a light actuator with a certain brightness or release the light actuator. Initial value {0, Off}
    DiagcReqOfIgnSwtIllmn: interface=DiagcBri1  # Diagnostic Request for Interior Light Source | Diagnostic request to manipulate a light actuator accordingly in order to unconditionally activate a light actuator with a certain brightness or release the light actuator. Initial value {0, Off}
    DiagcReqOfIntrLiGroup0: interface=DiagcBri1  # Diagnostic Request for Interior Light Source | Diagnostic request to manipulate a light actuator accordingly in order to unconditionally activate a light actuator with a certain brightness or release the light actuator. Initial value {0, Off}
    DiagcReqOfIntrLiGroup1: interface=DiagcBri1  # Diagnostic Request for Interior Light Source | Diagnostic request to manipulate a light actuator accordingly in order to unconditionally activate a light actuator with a certain brightness or release the light actuator. Initial value {0, Off}
    DiagcReqOfIntrLiGroup{10..15}: interface=DiagcBri1  # Diagnostic Request for Interior Light Source | Diagnostic request to manipulate a light actuator accordingly in order to unconditionally activate a light actuator with a certain brightness or release the light actuator. Initial value {0, Off}
    DiagcReqOfIntrLiGroup{2..9}: interface=DiagcBri1  # Diagnostic Request for Interior Light Source | Diagnostic request to manipulate a light actuator accordingly in order to unconditionally activate a light actuator with a certain brightness or release the light actuator. Initial value {0, Off}
    DiagcReqOfLiForCigaretteLighterIllmnAtTrLe: interface=DiagcBri1  # Diagnostic Request for Interior Light Source | Diagnostic request to manipulate a light actuator accordingly in order to unconditionally activate a light actuator with a certain brightness or release the light actuator. Initial value {0, Off}
    DiagcReqOfLiForCigaretteLighterIllmnAtTrRi: interface=DiagcBri1  # Diagnostic Request for Interior Light Source | Diagnostic request to manipulate a light actuator accordingly in order to unconditionally activate a light actuator with a certain brightness or release the light actuator. Initial value {0, Off}
    DiagcReqOfLiForCigaretteLighterIllmnFrntCen: interface=DiagcBri1  # Diagnostic Request for Interior Light Source | Diagnostic request to manipulate a light actuator accordingly in order to unconditionally activate a light actuator with a certain brightness or release the light actuator. Initial value {0, Off}
    DiagcReqOfLiForCigaretteLighterIllmnFrntLe: interface=DiagcBri1  # Diagnostic Request for Interior Light Source | Diagnostic request to manipulate a light actuator accordingly in order to unconditionally activate a light actuator with a certain brightness or release the light actuator. Initial value {0, Off}
    DiagcReqOfLiForCigaretteLighterIllmnFrntRi: interface=DiagcBri1  # Diagnostic Request for Interior Light Source | Diagnostic request to manipulate a light actuator accordingly in order to unconditionally activate a light actuator with a certain brightness or release the light actuator. Initial value {0, Off}
    DiagcReqOfLiForCigaretteLighterIllmnGroup: interface=DiagcBri1  # Diagnostic Request for Interior Light Source | Diagnostic request to manipulate a light actuator accordingly in order to unconditionally activate a light actuator with a certain brightness or release the light actuator. Initial value {0, Off}
    DiagcReqOfLiForCigaretteLighterIllmnMidCen: interface=DiagcBri1  # Diagnostic Request for Interior Light Source | Diagnostic request to manipulate a light actuator accordingly in order to unconditionally activate a light actuator with a certain brightness or release the light actuator. Initial value {0, Off}
    DiagcReqOfLiForCigaretteLighterIllmnMidLe: interface=DiagcBri1  # Diagnostic Request for Interior Light Source | Diagnostic request to manipulate a light actuator accordingly in order to unconditionally activate a light actuator with a certain brightness or release the light actuator. Initial value {0, Off}
    DiagcReqOfLiForCigaretteLighterIllmnMidRi: interface=DiagcBri1  # Diagnostic Request for Interior Light Source | Diagnostic request to manipulate a light actuator accordingly in order to unconditionally activate a light actuator with a certain brightness or release the light actuator. Initial value {0, Off}
    DiagcReqOfLiForCigaretteLighterIllmnReCen: interface=DiagcBri1  # Diagnostic Request for Interior Light Source | Diagnostic request to manipulate a light actuator accordingly in order to unconditionally activate a light actuator with a certain brightness or release the light actuator. Initial value {0, Off}
    DiagcReqOfLiForCigaretteLighterIllmnReLe: interface=DiagcBri1  # Diagnostic Request for Interior Light Source | Diagnostic request to manipulate a light actuator accordingly in order to unconditionally activate a light actuator with a certain brightness or release the light actuator. Initial value {0, Off}
    DiagcReqOfLiForCigaretteLighterIllmnReRi: interface=DiagcBri1  # Diagnostic Request for Interior Light Source | Diagnostic request to manipulate a light actuator accordingly in order to unconditionally activate a light actuator with a certain brightness or release the light actuator. Initial value {0, Off}
    DiagcReqOfLiForDoorOpenerIllmnFrntLe: interface=DiagcBri1  # Diagnostic Request for Interior Light Source | Diagnostic request to manipulate a light actuator accordingly in order to unconditionally activate a light actuator with a certain brightness or release the light actuator. Initial value {0, Off}
    DiagcReqOfLiForDoorOpenerIllmnFrntRi: interface=DiagcBri1  # Diagnostic Request for Interior Light Source | Diagnostic request to manipulate a light actuator accordingly in order to unconditionally activate a light actuator with a certain brightness or release the light actuator. Initial value {0, Off}
    DiagcReqOfLiForDoorOpenerIllmnGroup: interface=DiagcBri1  # Diagnostic Request for Interior Light Source | Diagnostic request to manipulate a light actuator accordingly in order to unconditionally activate a light actuator with a certain brightness or release the light actuator. Initial value {0, Off}
    DiagcReqOfLiForDoorOpenerIllmnMidLe: interface=DiagcBri1  # Diagnostic Request for Interior Light Source | Diagnostic request to manipulate a light actuator accordingly in order to unconditionally activate a light actuator with a certain brightness or release the light actuator. Initial value {0, Off}
    DiagcReqOfLiForDoorOpenerIllmnMidRi: interface=DiagcBri1  # Diagnostic Request for Interior Light Source | Diagnostic request to manipulate a light actuator accordingly in order to unconditionally activate a light actuator with a certain brightness or release the light actuator. Initial value {0, Off}
    DiagcReqOfLiForDoorOpenerIllmnReLe: interface=DiagcBri1  # Diagnostic Request for Interior Light Source | Diagnostic request to manipulate a light actuator accordingly in order to unconditionally activate a light actuator with a certain brightness or release the light actuator. Initial value {0, Off}
    DiagcReqOfLiForDoorOpenerIllmnReRi: interface=DiagcBri1  # Diagnostic Request for Interior Light Source | Diagnostic request to manipulate a light actuator accordingly in order to unconditionally activate a light actuator with a certain brightness or release the light actuator. Initial value {0, Off}
    DiagcReqOfLiForDoorSillIllmnFrntLe: interface=DiagcBri1  # Diagnostic Request for Interior Light Source | Diagnostic request to manipulate a light actuator accordingly in order to unconditionally activate a light actuator with a certain brightness or release the light actuator. Initial value {0, Off}
    DiagcReqOfLiForDoorSillIllmnFrntRi: interface=DiagcBri1  # Diagnostic Request for Interior Light Source | Diagnostic request to manipulate a light actuator accordingly in order to unconditionally activate a light actuator with a certain brightness or release the light actuator. Initial value {0, Off}
    DiagcReqOfLiForDoorSillIllmnGroup: interface=DiagcBri1  # Diagnostic Request for Interior Light Source | Diagnostic request to manipulate a light actuator accordingly in order to unconditionally activate a light actuator with a certain brightness or release the light actuator. Initial value {0, Off}
    DiagcReqOfLiForDoorSillIllmnMidLe: interface=DiagcBri1  # Diagnostic Request for Interior Light Source | Diagnostic request to manipulate a light actuator accordingly in order to unconditionally activate a light actuator with a certain brightness or release the light actuator. Initial value {0, Off}
    DiagcReqOfLiForDoorSillIllmnMidRi: interface=DiagcBri1  # Diagnostic Request for Interior Light Source | Diagnostic request to manipulate a light actuator accordingly in order to unconditionally activate a light actuator with a certain brightness or release the light actuator. Initial value {0, Off}
    DiagcReqOfLiForDoorSillIllmnReLe: interface=DiagcBri1  # Diagnostic Request for Interior Light Source | Diagnostic request to manipulate a light actuator accordingly in order to unconditionally activate a light actuator with a certain brightness or release the light actuator. Initial value {0, Off}
    DiagcReqOfLiForDoorSillIllmnReRi: interface=DiagcBri1  # Diagnostic Request for Interior Light Source | Diagnostic request to manipulate a light actuator accordingly in order to unconditionally activate a light actuator with a certain brightness or release the light actuator. Initial value {0, Off}
    DiagcReqOfLiForReadingAtRowThrdCen: interface=DiagcBri1  # Diagnostic Request for Interior Light Source | Diagnostic request to manipulate a light actuator accordingly in order to unconditionally activate a light actuator with a certain brightness or release the light actuator. Initial value {0, Off}
    DiagcReqOfLiForReadingAtRowThrdLe: interface=DiagcBri1  # Diagnostic Request for Interior Light Source | Diagnostic request to manipulate a light actuator accordingly in order to unconditionally activate a light actuator with a certain brightness or release the light actuator. Initial value {0, Off}
    DiagcReqOfLiForReadingAtRowThrdRi: interface=DiagcBri1  # Diagnostic Request for Interior Light Source | Diagnostic request to manipulate a light actuator accordingly in order to unconditionally activate a light actuator with a certain brightness or release the light actuator. Initial value {0, Off}
    DiagcReqOfLiForReadingFrntCen: interface=DiagcBri1  # Diagnostic Request for Interior Light Source | Diagnostic request to manipulate a light actuator accordingly in order to unconditionally activate a light actuator with a certain brightness or release the light actuator. Initial value {0, Off}
    DiagcReqOfLiForReadingFrntLe: interface=DiagcBri1  # Diagnostic Request for Interior Light Source | Diagnostic request to manipulate a light actuator accordingly in order to unconditionally activate a light actuator with a certain brightness or release the light actuator. Initial value {0, Off}
    DiagcReqOfLiForReadingFrntRi: interface=DiagcBri1  # Diagnostic Request for Interior Light Source | Diagnostic request to manipulate a light actuator accordingly in order to unconditionally activate a light actuator with a certain brightness or release the light actuator. Initial value {0, Off}
    DiagcReqOfLiForReadingGroup: interface=DiagcBri1  # Diagnostic Request for Interior Light Source | Diagnostic request to manipulate a light actuator accordingly in order to unconditionally activate a light actuator with a certain brightness or release the light actuator. Initial value {0, Off}
    DiagcReqOfLiForReadingReCen: interface=DiagcBri1  # Diagnostic Request for Interior Light Source | Diagnostic request to manipulate a light actuator accordingly in order to unconditionally activate a light actuator with a certain brightness or release the light actuator. Initial value {0, Off}
    DiagcReqOfLiForReadingReLe: interface=DiagcBri1  # Diagnostic Request for Interior Light Source | Diagnostic request to manipulate a light actuator accordingly in order to unconditionally activate a light actuator with a certain brightness or release the light actuator. Initial value {0, Off}
    DiagcReqOfLiForReadingReRi: interface=DiagcBri1  # Diagnostic Request for Interior Light Source | Diagnostic request to manipulate a light actuator accordingly in order to unconditionally activate a light actuator with a certain brightness or release the light actuator. Initial value {0, Off}
    DiagcReqOfLiForSftyBltLockIllmnFrntCen: interface=DiagcBri1  # Diagnostic Request for Interior Light Source | Diagnostic request to manipulate a light actuator accordingly in order to unconditionally activate a light actuator with a certain brightness or release the light actuator. Initial value {0, Off}
    DiagcReqOfLiForSftyBltLockIllmnFrntLe: interface=DiagcBri1  # Diagnostic Request for Interior Light Source | Diagnostic request to manipulate a light actuator accordingly in order to unconditionally activate a light actuator with a certain brightness or release the light actuator. Initial value {0, Off}
    DiagcReqOfLiForSftyBltLockIllmnFrntRi: interface=DiagcBri1  # Diagnostic Request for Interior Light Source | Diagnostic request to manipulate a light actuator accordingly in order to unconditionally activate a light actuator with a certain brightness or release the light actuator. Initial value {0, Off}
    DiagcReqOfLiForSftyBltLockIllmnGroup: interface=DiagcBri1  # Diagnostic Request for Interior Light Source | Diagnostic request to manipulate a light actuator accordingly in order to unconditionally activate a light actuator with a certain brightness or release the light actuator. Initial value {0, Off}
    DiagcReqOfLiForSftyBltLockIllmnMidCen: interface=DiagcBri1  # Diagnostic Request for Interior Light Source | Diagnostic request to manipulate a light actuator accordingly in order to unconditionally activate a light actuator with a certain brightness or release the light actuator. Initial value {0, Off}
    DiagcReqOfLiForSftyBltLockIllmnMidLe: interface=DiagcBri1  # Diagnostic Request for Interior Light Source | Diagnostic request to manipulate a light actuator accordingly in order to unconditionally activate a light actuator with a certain brightness or release the light actuator. Initial value {0, Off}
    DiagcReqOfLiForSftyBltLockIllmnMidRi: interface=DiagcBri1  # Diagnostic Request for Interior Light Source | Diagnostic request to manipulate a light actuator accordingly in order to unconditionally activate a light actuator with a certain brightness or release the light actuator. Initial value {0, Off}
    DiagcReqOfLiForSftyBltLockIllmnReCen: interface=DiagcBri1  # Diagnostic Request for Interior Light Source | Diagnostic request to manipulate a light actuator accordingly in order to unconditionally activate a light actuator with a certain brightness or release the light actuator. Initial value {0, Off}
    DiagcReqOfLiForSftyBltLockIllmnReLe: interface=DiagcBri1  # Diagnostic Request for Interior Light Source | Diagnostic request to manipulate a light actuator accordingly in order to unconditionally activate a light actuator with a certain brightness or release the light actuator. Initial value {0, Off}
    DiagcReqOfLiForSftyBltLockIllmnReRi: interface=DiagcBri1  # Diagnostic Request for Interior Light Source | Diagnostic request to manipulate a light actuator accordingly in order to unconditionally activate a light actuator with a certain brightness or release the light actuator. Initial value {0, Off}
    DiagcReqOfSwtIllmnForHzrdWarn: interface=DiagcBri1  # Diagnostic Request of Hazard Warning Switch Illumination | Diagnostic Request for Hazard Warning Switch Illumination
    DiagcReqOfTrCmptmtGroup: interface=DiagcBri1  # Diagnostic Request for Interior Light Source | Diagnostic request to manipulate a light actuator accordingly in order to unconditionally activate a light actuator with a certain brightness or release the light actuator. Initial value {0, Off}
    DiagcReqOfTrCmptmtLiCen: interface=DiagcBri1  # Diagnostic Request for Interior Light Source | Diagnostic request to manipulate a light actuator accordingly in order to unconditionally activate a light actuator with a certain brightness or release the light actuator. Initial value {0, Off}
    DiagcReqOfTrCmptmtLiLoLe: interface=DiagcBri1  # Diagnostic Request for Interior Light Source | Diagnostic request to manipulate a light actuator accordingly in order to unconditionally activate a light actuator with a certain brightness or release the light actuator. Initial value {0, Off}
    DiagcReqOfTrCmptmtLiLoRi: interface=DiagcBri1  # Diagnostic Request for Interior Light Source | Diagnostic request to manipulate a light actuator accordingly in order to unconditionally activate a light actuator with a certain brightness or release the light actuator. Initial value {0, Off}
    DiagcReqOfTrCmptmtLiUpLe: interface=DiagcBri1  # Diagnostic Request for Interior Light Source | Diagnostic request to manipulate a light actuator accordingly in order to unconditionally activate a light actuator with a certain brightness or release the light actuator. Initial value {0, Off}
    DiagcReqOfTrCmptmtLiUpRi: interface=DiagcBri1  # Diagnostic Request for Interior Light Source | Diagnostic request to manipulate a light actuator accordingly in order to unconditionally activate a light actuator with a certain brightness or release the light actuator. Initial value {0, Off}
    DiagcReqOfVanityLiFrntLe: interface=DiagcBri1  # Diagnostic Request for Interior Light Source | Diagnostic request to manipulate a light actuator accordingly in order to unconditionally activate a light actuator with a certain brightness or release the light actuator. Initial value {0, Off}
    DiagcReqOfVanityLiFrntRi: interface=DiagcBri1  # Diagnostic Request for Interior Light Source | Diagnostic request to manipulate a light actuator accordingly in order to unconditionally activate a light actuator with a certain brightness or release the light actuator. Initial value {0, Off}
    DiagcReqOfVanityLiGroup: interface=DiagcBri1  # Diagnostic Request for Interior Light Source | Diagnostic request to manipulate a light actuator accordingly in order to unconditionally activate a light actuator with a certain brightness or release the light actuator. Initial value {0, Off}
    DiagcReqOfVanityLiMidLe: interface=DiagcBri1  # Diagnostic Request for Interior Light Source | Diagnostic request to manipulate a light actuator accordingly in order to unconditionally activate a light actuator with a certain brightness or release the light actuator. Initial value {0, Off}
    DiagcReqOfVanityLiMidRi: interface=DiagcBri1  # Diagnostic Request for Interior Light Source | Diagnostic request to manipulate a light actuator accordingly in order to unconditionally activate a light actuator with a certain brightness or release the light actuator. Initial value {0, Off}
    DiagcReqOfVanityLiReLe: interface=DiagcBri1  # Diagnostic Request for Interior Light Source | Diagnostic request to manipulate a light actuator accordingly in order to unconditionally activate a light actuator with a certain brightness or release the light actuator. Initial value {0, Off}
    DiagcReqOfVanityLiReRi: interface=DiagcBri1  # Diagnostic Request for Interior Light Source | Diagnostic request to manipulate a light actuator accordingly in order to unconditionally activate a light actuator with a certain brightness or release the light actuator. Initial value {0, Off}
    DispBltLockAck: interface=DispBltLockAck1  # Display Belt Lock Acknowledge | Acknowledge from Human Machine Interface (HMI) to end the active warning / display request
    DispBltLockReq: interface=DispBltLockReq1  # Display Belt Lock Request | Request from seat belt reminder to Human Machine Interface (HMI) to signal a locked/non locked seat belt on seating position. The actual display content are to get from dedicated ports.
    DispBltLockStOfDrvr: interface=DispBltLockSt1  # Display Belt Lock State of Driver | State of the lock of belt at driver seating position to display in case of when the display belt lock requests.
    DispBltLockStOfPass: interface=DispBltLockSt1  # Display Belt Lock State of Passenger | State of the lock of belt at passenger seating position to display in case of when the display belt lock requests.
    DispBltLockStOfRowFirstMid: interface=DispBltLockSt1  # Display Belt Lock State of First Row Middle | State of the lock of belt at seating position at first row in the middle to display in case of when the display belt lock requests.
    DispBltLockStOfRowSecLe: interface=DispBltLockSt1  # Display Belt Lock State of Row Second Left | State of the lock of belt at seating position at second row in the left to display in case of when the display belt lock requests.
    DispBltLockStOfRowSecMid: interface=DispBltLockSt1  # Display Belt Lock State of Second Row Middle | State of the lock of belt at seating position at second row in the middle to display in case of when the display belt lock requests.
    DispBltLockStOfRowSecRi: interface=DispBltLockSt1  # Display Belt Lock State of Second Row Right | State of the lock of belt at seating position at second row in the right to display in case of when the display belt lock requests.
    DispBltLockStOfRowThrdLe: interface=DispBltLockSt1  # Display Belt Lock State of Third Row Left | State of the lock of belt at seating position at third row in the left to display in case of when the display belt lock requests.
    DispBltLockStOfRowThrdMid: interface=DispBltLockSt1  # Display Belt Lock State of Third Row Middle | State of the lock of belt at seating position at third row in the middle to display in case of when the display belt lock requests.
    DispBltLockStOfRowThrdRi: interface=DispBltLockSt1  # Display Belt Lock State of Third Row Right | State of the lock of belt at seating position at third row in the right to display in case of when the display belt lock requests.
    DispBucdStOfDrvr: interface=DispBucdStOfOccpt1  # Display Buckled State of Driver | State of buckled occupant displayed optionally for the driver seat position in case of seat belt reminder warning.
    DispBucdStOfOccptAtRowFirstMid: interface=DispBucdStOfOccpt1  # Display Buckled State of Occupant at Row First Middle | State of buckled occupant displayed optionally for the seat position at first row in middle in case of seat belt reminder warning.
    DispBucdStOfOccptAtRowSecLe: interface=DispBucdStOfOccpt1  # Display Buckled State of Occupant at Row Second Left | State of buckled occupant displayed optionally for the seat position at second row on left in case of seat belt reminder warning .
    DispBucdStOfOccptAtRowSecMid: interface=DispBucdStOfOccpt1  # Display Buckled State of Occupant at Row Second Middle | State of buckled occupant displayed optionally for the seat position at second row in middle in case of seat belt reminder warning .
    DispBucdStOfOccptAtRowSecRi: interface=DispBucdStOfOccpt1  # Display Buckled State of Occupant at Row Second Right | State of buckled occupant displayed optionally for the seat position at second row on right in case of seat belt reminder warning.
    DispBucdStOfOccptAtRowThrdLe: interface=DispBucdStOfOccpt1  # Display Buckled State of Occupant at Row Third Left | State of buckled occupant displayed optionally for the seat position at third row on left in case of seat belt reminder warning.
    DispBucdStOfOccptAtRowThrdMid: interface=DispBucdStOfOccpt1  # Display Buckled State of Occupant at Row Third Middle | State of buckled occupant displayed optionally for the seat position at third row in middle in case of seat belt reminder warning.
    DispBucdStOfOccptAtRowThrdRi: interface=DispBucdStOfOccpt1  # Display Buckled State of Occupant at Row Third Right | State of buckled occupant displayed optionally for the seat position at third row on right in case of seat belt reminder warning.
    DispBucdStOfPass: interface=DispBucdStOfOccpt1  # Display Buckled State of Passenger | State of buckled occupant displayed optionally for the passenger seat position in case of seat belt reminder warning.
    DispPaseDfct: interface=DispPaseDfct1  # Defect Display Passive Entry | Display information of the defects of Passive entry
    DispRainSnsrActv: interface=DispRainSnsr1  # Display Rain Sensor Active | Informs driver, if rain sensor is currently active.
    DoorChdCmd: interface=ChdProtnCmd1  # Door Child Command | Command to activate or deactivate the child protection related to a door.
    DoorChdCmdOfDoorLockReLe: interface=ChdProtnCmd1  # Rear Door Child Command | Command to activate or deactivate the child protection related to a rear door.
    DoorChdCmdOfDoorLockReRi: interface=ChdProtnCmd1  # Rear Door Child Command | Command to activate or deactivate the child protection related to a rear door.
    DoorChdSt: interface=ChdProtnSt1  # Door Child Status | Status of the child protection related to a door.
    DoorChdStOfDoorLockReLe: interface=ChdProtnSt1  # Rear Door Child State | State of the child protection related to a rear door.
    DoorChdStOfDoorLockReRi: interface=ChdProtnSt1  # Rear Door Child State | State of the child protection related to a rear door.
    DoorHndl: interface=DoorHndlSt1  # Door Handle | Information related to the door handle (door handle activated or not)
    DoorHndlSen: interface=DoorHndlSenSt1  # Door Handle Sensor | Information related to the door handle sensor (door handle sensor touched or not)
    DoorKeyPadOfLidRe: interface=LockgCenReq1  # Rear Lid Door Keypad | Request to activate central locking master on the rear lid from door key pad
    DoorKeyPadReLe: interface=LockgCenReq1  # Rear Left Door Keypad | Request to activate central locking master from the rear left door key pad
    DoorKeyPadReLeOfLidRe: interface=LockgCenReq1  # Rear Left Door Keypad Rear Lid | Request to activate central locking master on the rear lid from the rear left door key pad
    DoorKeyPadReRi: interface=LockgCenReq1  # Rear Right Door Keypad | Request to activate central locking master from the rear right door key pad
    DoorKeyPadReRiOfLidRe: interface=LockgCenReq1  # Rear Right Door Keypad Rear Lid | Request to activate central locking master on the rear lid from the rear right door key pad
    DoorSt: interface=DoorSt1  # Door Status | Information of the door, indicates whether this door is opened or closed
    DoorStOfDoorLockReLe: interface=DoorSt1  # Rear Door Status | Information of a rear door, indicates whether this door is opened or closed
    DoorStOfDoorLockReRi: interface=DoorSt1  # Rear Door Status | Information of a rear door, indicates whether this door is opened or closed
    DoorStOfDrvrDoorLock: interface=DoorSt1  # Front Door Status | Information of the front door, indicates whether this door is opened or closed
    DoorStOfPassDoorLock: interface=DoorSt1  # Front Door Status | Information of the front door, indicates whether this door is opened or closed
    DoorSts: interface=DoorSts1  # Door Status | Information of the door, indicates whether this door is opened or closed
    DoorStsOfDoorLockReLe: interface=DoorSts1  # Rear Door Status | Information of a rear door, indicates whether this door is opened or closed
    DoorStsOfDoorLockReRi: interface=DoorSts1  # Rear Door Status | Information of a rear door, indicates whether this door is opened or closed
    DoorStsOfDrvrDoorLock: interface=DoorSts1  # Front Door Status | Information of the front door, indicates whether this door is opened or closed
    DoorStsOfPassDoorLock: interface=DoorSts1  # Front Door Status | Information of the front door, indicates whether this door is opened or closed
    DrvFlgGearShiftDwnReq: interface=GearShiftDwnReqFromDrvr1  # Gear Shift Down Request by Driver | Gear shift down request by driver
    DrvFlgGearShiftUpReq: interface=GearShiftUpReqFromDrvr1  # Gear Shift Up Request by Driver | Gear shift up request by driver
    DrvFlgKdDetd: interface=DrvFlgKdDetd1  # Driver: Kickdown Detected | kickdown-switch (pushed for Kickdown, not pushed) or derived from pedal value | 0 = No Kickdown Detected 1 = Kickdown Detected
    DrvReqRatVirtAccrPedl: interface=DrvReqRatVirtAccrPedl1  # Driver Request: Virtual Accelerator Pedal Ratio | Driver accelerator pedal request, including virtual pedal ratio (e.g. for Adaptive Cruise Control (ACC) or Cruise Control (CC)). Evaluated signal, jitter free, including plausibility check, monitoring and replacement value but without filtering. 0%: (Virtual) driver is off the pedal, offsets are removed. 100% : Must be ensured at end point of the pedal. Shall cover the 100% as well. | Example of realization: Within Adaptive Cruise Control (ACC) / Cruise Control (CC) this is based on the total requested propulsion wheel torque by the driver or Vehicle Longitudinal Control (VLC), otherwise this is the "Accelerator Pedal Ratio" value.Signal is sent with initialisation.
    DrvReqTqCluFast: interface=DrvReqTqCluFast1  # Driver Request of Torque at Clutch Fast Path | Torque at clutch requested by the driver to be generated by the powertrain fast path. | Combination of all real and virtual driver requests including idle speed control. Virtual driver requests contain cruise control, distance cruise control, vehicle speed limiter, etc. Example for “Timing and accuracy requirements to torque signals” in a typical series project: see Explanation Document for Application Interfaces of the Powertrain Domain (Auxiliary Document). Data format for typical network representation for series projects: Base Type: Uint12 Unit: Nm Type: linear Resolution: 1 Offset: - 2048 Physically used range: Hex Lower/Upper Limit: 0h / FFDh Physical Lower/Upper Limit: -2048 / 2045 Special values outside the physically used range: FFEh = Init FFFh = Error, Signal content invalid Cycle Time: 10 ms (max.) for Control Unit internal calculation and Bus communication.
    DrvReqTqCluSlow: interface=DrvReqTqCluSlow1  # Driver Request of Clutch Torque (Slow Torque Path) | Torque at clutch requested by the driver to be generated by the powertrain (slow path).
    DrvReqTqWhlFast: interface=DrvReqTqWhlFast1  # Driver Request of Wheel Torque (Fast Torque Path) | Wheel torque (to all the driven wheels) requested by the driver to be generated by the powertrain.
    DrvReqTqWhlSlow: interface=DrvReqTqWhlSlow1  # Driver Request of Wheel Torque (Slow Torque Path) | Anticipated wheel torque (to all the driven wheels) requested by the driver to be generated by the powertrain.
    DrvgSide: interface=DrvgSide1  # Driving Side | Information related to the position of the steering wheel in the vehicle (right or left)
    DrvrBtnForSeatClima: interface=HmiBtn1  # Driver Button from HMI for Seat Climatisation | Driver Button Activation From Hmi (on, off) for Seat Climatisation
    DrvrDoorKeyPad: interface=LockgCenReq1  # Driver Door Keypad | Request to activate central locking master from the driver door key pad
    DrvrDoorKeyPadOfLidRe: interface=LockgCenReq1  # Driver Door Keypad Rear Lid | Request to activate central locking master on the rear lid from the driver door key pad
    DrvrProf: interface=ProfPenSt1  # Driver Profile | Status of current selected personalization profile from profile manager. It is a common profile selectable from transponder, remote key, keyless access, Human Machine Interface (HMI),...
    DrvrSteerTqBas: interface=DrvrSteerTq1  # Driver Steering Torque Base | Measured driver steer torque at the column. | Does not include the wheel inertia effect, some friction between the sensor and the steering wheel and the steering kinematics. Includes pinion torque sensor for rack drive system and ONLY denotes the driver torque.
    DrvrSteerTqMeasd: interface=DrvrSteerTq1  # Driver Steering Torque Measured | Conditioned driver steer torque at the column. Conditioning includes filtering, offset compensation, model-based plausibility checks etc. | Does not include the wheel inertia effect, some friction between the sensor and the steering wheel and the steering kinematics. Includes pinion torque sensor for rack drive system and ONLY denotes the driver torque.
    DrvrSteerTqRaw: interface=DrvrSteerTq1  # Driver Steering Torque Raw | Measured driver steer torque at the column. | Does not include the wheel inertia effect, some friction between the sensor and the steering wheel and the steering kinematics. Includes pinion torque sensor for rack drive system and ONLY denotes the driver torque.
    DrvrSteerTqStd: interface=DrvrSteerTq1  # Driver Steering Torque Standard | Conditioned driver steer torque at the column. Conditioning includes filtering, offset compensation, model-based plausibility checks etc. | Does not include the wheel inertia effect, some friction between the sensor and the steering wheel and the steering kinematics. Includes pinion torque sensor for rack drive system and ONLY denotes the driver torque.
    DrvrStgDispForSeatClima: interface=StgDisp1  # Driver Stage Display for Seat Climatisation to HMI | Feedback to Hmi of Driver Stage requested
    DrvrStgForSeatClima: interface=StgReq1  # Driver Stage Request for Seat Climatisation | Driver Stage Request (no climatisation, heating level, cooling level)
    DrvrTqAbsltFrntReqBySteerDrvrAsscSys: interface=DrvrSteerTq1  # Driver Torque Absolute Front Request by Steering Driver Assistance System | Requested absolute driver steering torque by Steering Driver Assistance System (does not include the wheel inertia effect, some friction between the sensor and the steering wheel, the steering kinematics...)
    DrvrTqDeltaFrntReqBySteerDrvrAsscSys: interface=DrvrSteerTq1  # Driver Torque Delta Front Request by Steering Driver Assistance System | Steering Driver Assistance System requested delta driver steering torque (does not include the wheel inertia effect, some friction between the sensor and the steering wheel, the steering kinematics, ...). Driver steering torque measured at the steering column. | Request can come from different High Level Functions.
    DrvrTqDeltaFrntReqBySteerVehStabyCtrl: interface=DrvrSteerTq1  # Driver Torque Delta Front Request by Steering Vehicle Stabilizing Control | Steering Vehicle Stabilizing Control requested delta driver steering torque (does not include the wheel inertia effect, some friction between the sensor and the steering wheel, the steering kinematics, ...). Driver steering torque measured at the steering column. | Request can come from different High Level Functions.
    DshbBri: interface=BriReq1  # Dashboard Brightness | Request to set the dashboard brightness (e.g. sets the illumination brightness of the instrument cluster).
    DstTrvld: interface=DstTrvld1  # Distance Travelled | Traveled distance since last clamp on
    DtOpend: interface=TrsmFlgDtOpen1  # Drivetrain Opened | Indicates whether the drive train is open due to driver input. Transitional states between fully open and fully closed drivetrain shall be indicated as open in this signal. | Automatic Transmission (AT): Lever in N or in P or in neutral state because of internal reasons (e.g. internal failure) Manual Transmission (MT): Estimation based on clutch pedal pressed and optional neutral gear recognition. 0 : Drivetrain fully closed 1 : Drivetrain fully open or between fully open and fully closed.
    DtTqDistbnStIndcn: interface=DtTqDistbnStIndcn1  # Drivetrain Torque Distribution Status Indication | Indication of Drivetrain torque distribution functional status.
    DtTqDistbnStsIndcn: interface=DtTqDistbnStsIndcn1  # Drivetrain Torque Distribution Status Indication | Indication of Drivetrain torque distribution functional status.
    DtdRatTqDistbnReq: interface=PtTqDistbnToWhls1  # Requested Drivetrain Torque Distribution | The Drivetrain Torque Distribution strategy in chassis requests a distribution of the total powertrain torque at wheels, not a modification to that total torque. Therefore the distribution is requested as a percentage value for each wheel.
    DtdTqDftlAxleFrntReq: interface=DftlTqReq1  # Drivetrain Torque Distribution: Requested Differential Torque at Front Axle Actuator | Requested torque at the differential on the front axle as requested by Drivetrain Torque Distribution (DTD). Sign convention: positive to the right or front.
    DtdTqDftlAxleReReq: interface=DftlTqReq1  # Drivetrain Torque Distribution: Requested Differential Torque at Rear Axle Actuator | Requested torque at the differential at the rear axle as requested by Drivetrain Torque Distribution (DTD). Sign convention: positive to the right or front.
    DtdTqDftlTrfReq: interface=DftlTqReq1  # Drivetrain Torque Distribution: Requested Differential Torque at Transfer Case | Requested torque at the transfer case differential as requested by Drivetrain Torque Distribution (DTD). Sign convention: positive to the right or front.
    EgyMngt: interface=EgyMngtSt1  # Energy Management | Information used to optimize the energy available in the vehicle. This port is used to communicate a potential need of optimization of the energy available in the vehicle through functions. Functions will adapt their behaviours in adequacy with the optimization needed and with their own constraints.
    EgyMngtSt: interface=EgyMngtSts1  # State of Energy Management | This signal reflects the load dump stages in case of improper battery/generator balance. The handling of over- or under-voltage is not covered within this signal.
    EmTqDynJ: interface=EmTqDynJ1  # Electric Machine Dynamic Moment of Inertia | Inertia torque of the electric machine at clutch level. Definition of the sign: Increasing speed creates a negative sign, decreasing speed creates a positive sign. | The signal contains the dynamic torque created by the inertia of the electric machine which, on parallel hybrid projects, increases or decreases the torque at clutch. Example for “Timing and accuracy requirements to torque signals” in a typical series project: see Explanation Document for Application Interfaces of the Powertrain Domain (Auxiliary Document). Data format for typical network representation for series projects: Base Type: Uint12 Unit: Nm Type: linear Resolution: 1 Offset: - 2048 Physically used range: Hex Lower/Upper Limit: 0h / FFDh Physical Lower/Upper Limit: -2048 / 2045 Special values outside the physically used range: FFEh = Init FFFh = Error, Signal content invalid Cycle Time: 10 ms (max.) for Control Unit internal calculation and Bus communication.
    EmgyBrk: interface=LiExtReq1  # Emergency Brake | This port provides request to turn on hazard warning due to heavy deceleration
    EmgyLockg: interface=LockUnlckReq1  # Emergency Locking | User request for emergency locking in case of danger.
    EngHoodSt: interface=EngHoodSt1  # Engine Hood Status | Indication about engine hood (or bonnet) status.
    EngHoodSts: interface=EngHoodSts1  # Engine Hood Status | Indication about engine hood (or bonnet) status.
    EngId: interface=Authn1  # Engine Identifier | Identifier of the engine, for validation by Immobilizer.
    EngIdReq: interface=Authn1  # Engine Identifier Request | Request for engine identifier from Immobilizer.
    EngN: interface=EngN1  # Engine Speed | The consolidatedl rotational speed of the engine crankshaft. | E.g. evaluated from a segment synchronous source.
    EngNGearTar: interface=EngNGearTar1  # Engine Speed at Target Gear | used for Dual Clutch Transmission(DCT) to provide the transmission a predicted engine torque. The transmission pre-calculates this speed.
    EngNGrdt: interface=EngNGrdt1  # Engine Speed Gradient | Actual engine speed gradient
    EngNMax: interface=EngNMax1  # Maximum Allowed Engine Speed | Maximum permitted engine speed for engine protection, must not be exceeded by shifting | default value after reset: max value
    EngNMin: interface=EngNMin1  # Minimum Allowed Engine Speed | Minimum engine speed from engine control point of view E.g. engine idle speed to be arbitrated by Powertrain coordinator (PTC) with all other requested engine speeds.(Air Conditioner (A/C), alternator, transmission, ...) | signal is sent with initialisation
    EngPAmbAir: interface=EngPAmbAir1  # Engine Ambient Air Pressure | Engine ambient air pressure
    EngRunngDirSt: interface=EngRunngDirSt1  # Engine Running Direction State | E.g. used for engine stop/start systems
    EngSpd: interface=EngN1  # Engine Speed | The actual rotational speed of the engine crankshaft. | E.g. evaluated from a segment synchronous source.
    EngSpdGrdt: interface=EngNGrdt1  # Engine Speed Gradient | Actual engine speed gradient
    EngStrtRem: interface=EngStrtRemReq1  # Remote Engine Start | Information to start the engine from a remote control
    EngT: interface=EngT1  # Engine Temperature | Consolidated engine temperature
    EngTqActAtClu: interface=PtTqClu1  # Engine Torque Actual at Clutch | Current engine torque at clutch (including losses from e.g. air conditioning, oil pump etc.)
    EngTqActAtCrksft: interface=EngTqCrksft1  # Engine Torque Engaged at Crankshaft | Actual engine torque at crank level, assuming no auxiliary load = Indicated torque + Internal engine torque loss. | It is a computed value including all interventions not considering inertia of the engine. Example of realization: The torque is an average (cylinder average not time average) of all cylinders with current operating parameters including ignition timing, lambda, fuel cut level, fuel quantity, injection timing and others.'''''' The signal is valid if the engine is higher than a certain engine speed threshold. This threshold depends on the engine (e.g. about 500 rpm for four cylinder engines). Below this limit the accuracy of this value may decrease significantly. For hybrid stop/start strategy the engine speed of the fired engine should always be above the speed threshold. Default value after reset is zero.
    EngTqCluMin: interface=EngTqCluMin1  # Minimum Engine Torque at Clutch | Minimum engine torque at clutch level of not fired engine at current engine speed. | Minimum engine torque at clutch considers following contributors if present 1) internal engine torque losses like friction, pumping, mechanical driven water pump etc. 2) losses with influence on torque at clutch caused by alternator, airconditioning, power steering etc. Loss differences from engine to engine and variable torque losses over life cycle have to be considered. Usually this signal corresponds to the drag torque of the combustion engine at current speed. Example for “Timing and accuracy requirements to torque signals” in a typical series project: see Explanation Document for Application Interfaces of the Powertrain Domain (Auxiliary Document). Data format for typical network representation for series projects: Base Type: Uint12 Unit: Nm Type: linear Resolution: 1 Offset: - 2048 Physically used range: Hex Lower/Upper Limit: 0h / FFDh Physical Lower/Upper Limit: -2048 / 2045 Special values outside the physically used range: FFEh = Init FFFh = Error, Signal content invalid Cycle Time: 10 ms (max.) for Control Unit internal calculation and Bus communication.
    EngTqConsoldAtClu: interface=PtTqClu1  # Engine Torque Consolidated at Clutch | Current engine torque at clutch (including losses from e.g. air conditioning, oil pump etc.)
    EngTqCrksft: interface=EngTqCrksft1  # Engine Torque at Crankshaft | Indicated torque of combustion engine plus internal engine torque losses. Torque influence of inertia is not considered. | Torque at crankshaft considers following contributors if present 1) indicated torque of combustion engine, calculated on basis of injection timing and injected fuel, ignition angle and air mass. 2) internal engine torque losses like friction, pumping, mechanical driven water pump etc. Not considered are torque losses caused by alternator, airconditioning, power steering etc. Torque influence of inertia is not considered. Loss differences from engine to engine and variable torque losses over life cycle have to be considered. Signal includes all torque requests from accelerator pedal, cruise control, speed limiter, etc. and all interventions like torque and speed interventions. Example of realization: The torque is a cylinder average via two crankshaft revolutions, not a time average, of all cylinders considering current operating parameters. They include engine temperature, ignition timing and air mass measured or calculated, lambda, fuel cut level, fuel quantity, injection timing, knock control adaption, geographic altitude and others. Example for “Timing and accuracy requirements to torque signals” in a typical series project: see Explanation Document for Application Interfaces of the Powertrain Domain (Auxiliary Document). Data format for typical network representation for series projects: Base Type: Uint12 Unit: Nm Type: linear Resolution: 1 Offset: - 2048 Physically used range: Hex Lower/Upper Limit: 0h / FFDh Physical Lower/Upper Limit: -2048 / 2045 Special values outside the physically used range: FFEh = Init FFFh = Error, Signal content invalid Cycle Time: 10 ms (max.) for Control Unit internal calculation and Bus communication.
    EngTqCrksftMax: interface=EngTqCrksftMax1  # Maximum Engine Torque at Crankshaft | The maximum torque at crankshaft at the current engine speed and actual air mass (both gasoline and diesel), including the static power limitation of the engine (e.g. calibrated restrictions for engine protection) | Example of realization: The maximum torque is realized by fast and slow path e.g.with the earliest possible ignition angle at current lambda (gasoline in homogeneous mode) or the maximum fuel mass and injection timing (diesel) including average knocking (average of cylinders), smoke limitation.The signal is valid if the engine speed is higher than a certain engine speed threshold. This threshold depends on the engine (e.g. about 500 rpm for four cylinder engines). Below this limit the accuracy of this value may decrease significantly. For hybrid stop/start strategy the engine speed of the fired engine should always be above the speed threshold. Default value after reset is zero
    EngTqCrksftMaxFast: interface=EngTqCrksftMaxFast1  # Maximum Engine Torque at Crankshaft Fast Path | Maximum engine torque at crankshaft fast path including current engine speed, the actual air mass (both gasoline and diesel) and the static power limitation of the engine (e.g. calibrated restrictions for engine protection). This signal is relevant for torque requests realized by fast path. | Example of realization: The maximum torque is realized by fast path e.g.with the earliest possible ignition angle at current lambda (gasoline in homogeneous mode) or the maximum fuel mass and optimum injection timing concerning torque (diesel) , including average knocking (average of cylinders), smoke limitation.
    EngTqCrksftMaxOptmCdn: interface=EngTqCrksftMaxOptmCdn1  # Maximum Engine Torque at Crankshaft at Optimum Conditions | The maximum torque at crankshaft at the current engine speed, maximum air mass, current ambient pressure and air temperature (both gasoline and diesel), including the static power limitation of the engine (e.g. calibrated restrictions for engine protection). Calculated for ideal conditions. | Example of Realization: The maximum torque is realized by fast and slow path e.g.with the earliest possible ignition angle at optimum lambda concerning torque (gasoline) or the maximum fuel mass and injection timing (diesel). Smoke limitation is included in the signal. Average knocking is not considered (without knock control), but the pre-calibrated knocking limitation.The signal is valid if the engine speed is higher than a certain engine speed threshold. This threshold depends on the engine (e.g. about 500 rpm for four cylinder engines). Below this limit the accuracy of this value may decrease significantly. For hybrid stop/start strategy the engine speed of the fired engine should always be above the speed threshold. Default value after reset is zero
    EngTqCrksftMaxProtn: interface=EngTqCrksftMaxProtn1  # Maximum Allowed Torque at Crankshaft for Engine Protection | Maximum crankshaft torque including engine protection. If no protection function is active, the value of this interface will be the upper limit of the chosen data type. | Example of realization: Including catalyst protection, over heating, intake air system protection and fail safe etc.signal is sent with initialisation
    EngTqCrksftMaxSpdCur: interface=EngTqCrksftMaxSpdCur1  # Engine: Maximum Torque at Crankshaft at Current Speed | Maximum possible torque at crankshaft at current speed with maximum possible air mass at current ambient pressure and air temperature, including static power limitation of the engine. | Theoretical full load engine torque at crankshaft at actual engine speed. Maximally charged for turbo systems. Static power limitation contains e.g. restrictions for protection and static smoke limitation. Permanent knock limitation is considered, knock control not. Example for “Timing and accuracy requirements to torque signals” in a typical series project: see Explanation Document for Application Interfaces of the Powertrain Domain (Auxiliary Document). Data format for typical network representation for series projects: Base Type: Uint12 Unit: Nm Type: linear Resolution: 1 Offset: - 2048 Physically used range: Hex Lower/Upper Limit: 0h / FFDh Physical Lower/Upper Limit: -2048 / 2045 Special values outside the physically used range: FFEh = Init FFFh = Error, Signal content invalid Cycle Time: 10 ms (max.) for Control Unit internal calculation and Bus communication.
    EngTqCrksftMin: interface=EngTqCrksftMin1  # Minimum Engine Torque at Crankshaft Considering All Engine Losses | Minimum engine torque at crankshaft level of not fired engine at current engine speed. | Minimum engine torque at crankshaft considers internal engine torque losses like friction, pumping, mechanical driven water pump etc. Loss differences from engine to engine and variable torque losses over life cycle have to be considered. Usually this signal corresponds to the drag torque of the combustion engine at current speed. Example for “Timing and accuracy requirements to torque signals” in a typical series project: see Explanation Document for Application Interfaces of the Powertrain Domain (Auxiliary Document). Data format for typical network representation for series projects: Base Type: Uint12 Unit: Nm Type: linear Resolution: 1 Offset: - 2048 Physically used range: Hex Lower/Upper Limit: 0h / FFDh Physical Lower/Upper Limit: -2048 / 2045 Special values outside the physically used range: FFEh = Init FFFh = Error, Signal content invalid Cycle Time: 10 ms (max.) for Control Unit internal calculation and Bus communication.
    EngTqCrksftMinBasc: interface=EngTqCrksftMinBasc1  # Minimum Engine Torque at Crankshaft for Powertrain Realized by Slow Path | The minimum torque at crankshaft at the current engine speed and the minimum air mass (both gasoline and diesel) not including spark retard (gasoline) and fuel cut off | Example of realization: The minimum torque is realized by slow path e.g.normal ignition timing for the minimum mass air at current lambda (gasoline homogeneous) or the minimum fuel mass and injection timing (diesel) For diesel engines this interface is possibly equivalent to the torque losses, because minimum fuel mass could be zero. Otherwise minimum torque for fired engine'The signal is valid if the engine speed is higher than a certain engine speed threshold. This threshold depends on the engine (e.g. about 500 rpm for four cylinder engines). Below this limit the accuracy of this value may decrease significantly. For hybrid stop/start strategy the engine speed of the fired engine should always be above the speed threshold. Default value after reset is zero'
    EngTqCrksftMinFast: interface=EngTqCrksftMinFast1  # Minimum Engine Torque at Crankshaft Fast Path | Minimum torque at crankshaft of combustion engine at latest possible ignition angle. Calculated at current engine speed with current air mass, current ambient pressure and current air temperature. | Signal is relevant for gasoline engines only. The latest possible ignition angle, also called "Max. ignition retard", depends on exhaust temperature, catalyst protection, etc.. Reducing torque request by the transmission down to this torque level should be realized only by ignition retard and not by cylinder cut off. For diesel engines this signal depends on the minimum fuel mass which usually is zero. On parallel hybrid projects this is the minimum torque the combustion engine can realize. Example for “Timing and accuracy requirements to torque signals” in a typical series project: see Explanation Document for Application Interfaces of the Powertrain Domain (Auxiliary Document). Data format for typical network representation for series projects: Base Type: Uint12 Unit: Nm Type: linear Resolution: 1 Offset: - 2048 Physically used range: Hex Lower/Upper Limit: 0h / FFDh Physical Lower/Upper Limit: -2048 / 2045 Special values outside the physically used range: FFEh = Init FFFh = Error, Signal content invalid Cycle Time: 10 ms (max.) for Control Unit internal calculation and Bus communication.
    EngTqCrksftMinWoCutOff: interface=EngTqCrksftMinWoCutOff1  # Minimum Engine Torque at Crankshaft for Powertrain Realized by Slow and Fast Path | The minimum torque at crankshaft at the current engine speed and the minimum air mass (both gasoline and diesel) including spark retard (gasoline), not including fuel cut off | Example of realization: The minimum torque is realized by slow and fast path e.g.considering a certain spark retard for the minimum air mass at current lambda (gasoline homogeneous) or the minimum fuel mass and injection timing (diesel). The possible amount of spark retard can be defined depending on the application, e.g. according to drive ability criteria. For diesel engines this interface is possibly equivalent to the torque losses, because minimum fuel mass could be zero. Otherwise minimum torque for fired engine'The signal is valid if the engine speed is higher than a certain engine speed threshold. This threshold depends on the engine (e.g. about 500 rpm for four cylinder engines). Below this limit the accuracy of this value may decrease significantly. For hybrid stop/start strategy the engine speed of the fired engine should always be above the speed threshold. Default value after reset is zero'
    EngTqDecAtCluReqByEscFast: interface=EngTqDecAtCluReqByEscFast1  # Engine Torque Decrease at Clutch Request by ESC Fast | Decreasing engine torque at clutch requested by Electronic Stability Control below the driver input torque including virtual driver request. Fast refers to the immediate / instant torque request, typically achieved by ignition timing.
    EngTqDecAtCluReqByEscSlow: interface=EngTqDecAtCluReqByEscSlow1  # Engine Torque Decrease at Clutch Request by ESC Slow | Decreasing engine torque at clutch requested by Electronic Stability Control below the driver input torque including virtual driver request. Slow refers to the longer term or torque reserve request, usually the input to throttle control.
    EngTqDynJ: interface=EngTqDynJ1  # Engine Dynamic Moment of Inertia | Inertia torque of combustion engine at clutch level. Definition of the sign: Increasing speed creates a negative sign, decreasing speed creates a positive sign. | The signal contains the dynamic torque created by the inertia which increases or decreases the torque at clutch. The engine internal inertia and the inertia of the ancillaries up to the clutch have to be considered. Example for “Timing and accuracy requirements to torque signals” in a typical series project: see Explanation Document for Application Interfaces of the Powertrain Domain (Auxiliary Document). Data format for typical network representation for series projects: Base Type: Uint12 Unit: Nm Type: linear Resolution: 1 Offset: - 2048 Physically used range: Hex Lower/Upper Limit: 0h / FFDh Physical Lower/Upper Limit: -2048 / 2045 Special values outside the physically used range: FFEh = Init FFFh = Error, Signal content invalid Cycle Time: 10 ms (max.) for Control Unit internal calculation and Bus communication.
    EngTqIncAtCluReqByEsc: interface=EngTqIncAtCluReqByEsc1  # Engine Torque Increase at Clutch Request by ESC Slow | Increasing engine torque requested by Electronic Stability Control over the driver input torque including virtual driver. If the engine has a slow (usually by throttle control) and fast path (typically by ignition timing) this signal is used for increasing on both torque paths.
    EngTqResvPt: interface=EngTqResvPt1  # Torque Reserve Request from Engine to Powertrain | Reserved torque request to be coordinated by the Powertrain coordinator (PTC). This reserved torque could be realized either by the combustion engine or by another torque source (e.g. electric motor in a hybrid system). It does not include reserved torque requests which will be coordinated inside the combustion engine, e.g. torque reserve for catalyst heating or torque reserve to realize a change in the engine operation mode. | Default value after reset is zero
    EngTracCtrlIntvg: interface=EngTracCtrlIntvg1  # Engine Traction Control Intervening | Engine traction control is intervening (TRUE) when a torque reduction at the wheels is requested. Traction control is not intervening (indicated by FALSE) when a torque reduction at the wheels is not requested.
    EpbActrFltSt: interface=EpbActrFltSt1  # EPB Actuator Fault Status | Failure status of the parking brake actuators
    EpbActrFltSts: interface=EpbActrFltSts1  # EPB Actuator Fault Status | Failure status of the parking brake actuators
    EpbActrMod: interface=EpbActrMod1  # EPB Actuator Mode | Indication of the action executed by the parking brake actuator or its status.
    EpbActrTq: interface=EpbActrTq1  # EPB Actuator Torque | Brake torque applied by Electric Parking Brake actuator. | Based on nominal brake parameters (constant pads friction) and (estimated or measured) brake pressures (clamp forces).
    EpbActvn: interface=EpbActvn1  # EPB Activation | Activation or deactivation of the Electric Parking Brake by the driver.
    EpbBtnCtrlSt: interface=EpbBtnCtrlSt1  # EPB Button Control Status | Status of Electric Parking Brake (EPB) control button
    EpbBtnCtrlSts: interface=EpbBtnCtrlSts1  # EPB Button Control Status | Status of Electric Parking Brake (EPB) control button
    EpbDrvrActvnIndcn: interface=EpbDrvrActvnIndcn1  # EPB Driver Activation Indication | Indication to the cockpit (HMI) that the driver has applied/released the parking brake.
    EscCtrlIndcn: interface=EscCtrlIndcn1  # ESC Control Indication | Electronic Stability Control (ESC) controller is intervening.
    EscFlgNoFuCutOff: interface=NoFuCutOffReq1  # Request "No Fuel Cut Off" by Electronic Stability Control (ESC) | Suppress engine fuel cut off - 0: no suppression of fuel cut off - 1: suppression of fuel cut off
    EscReqPasMod: interface=EscReqPasMod1  # ESC Request Passive Mode | Request to switch the Electronic Stability Control (ESC) system to a passive mode.
    EscSt: interface=EscSt1  # Electronic Stability Control (ESC) Status | Status of activation/ deactivation of Electronic Stability Control (ESC)
    EscStIndcn: interface=EscStIndcn1  # ESC Status Indication | Electronic Stability Control (ESC) is turned on.
    EscStShiftPrevnStaby: interface=GearShiftPrevn1  # Electronic Stability Control (ESC): State of Shift Prevention for Stability Reasons | Avoid change of gear for stability reasons.
    EscSts: interface=EscSts1  # Electronic Stability Control (ESC) Status | Status of activation/ deactivation of Electronic Stability Control (ESC)
    EscStsIndcn: interface=EscStsIndcn1  # ESC Status Indication | Electronic Stability Control (ESC) is turned on.
    EscTqCluPtMaxFast: interface=EngTqDecAtCluReqByEscFast1  # Maximum Powertrain Clutch Torque Requested by Electronic Stability Control (ESC) Fast Path | Reducing engine torque requested by Electronic stability control below the driver input torque including virtual driver request. Fast refers to the immediate / instant torque request, typically achieved by ignition timing.
