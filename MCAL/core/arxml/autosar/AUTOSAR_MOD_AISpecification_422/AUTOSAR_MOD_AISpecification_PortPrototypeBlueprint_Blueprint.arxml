[part 3 of 3: package /AUTOSAR/AISpecification/PortPrototypeBlueprints_Blueprint]
AUTOSAR XML (schema 4-2-2)
package /AUTOSAR/AISpecification/PortPrototypeBlueprints_Blueprint  (continued)
  2154 x port prototype blueprint:  (continued)
    PitchRateAtCen: interface=PitchRate2  # Pitch Rate at Center | Pitch Rate from sensor element. Coordinate system according to ISO 8855. Raw signal
    PitchRateBas: interface=PitchRate1  # Pitch Rate Base | Pitch rate measured along vehicle y- axis (i.e. compensated for orientation). Coordinate system according to ISO 8855
    PitchRateMeasd: interface=PitchRate1  # Pitch Rate Measured | Pitch rate calculated along vehicle y-axis. Coordinate system according to ISO 8855. Filtered and offset-compensated
    PitchRateRaw: interface=PitchRate1  # Pitch Rate Raw | Pitch rate measured along vehicle y- axis (i.e. compensated for orientation). Coordinate system according to ISO 8855
    PitchRateStd: interface=PitchRate1  # Pitch Rate Standard | Pitch rate calculated along vehicle y-axis. Coordinate system according to ISO 8855. Filtered and offset-compensated
    PosnStore: interface=StorePosnCmd1  # Store Seat Axis Position | Request to store the position of a certain seat axis to the memory position 'profile'.
    PresStOfDrvr: interface=PresStOfOccpt1  # Presence State of Driver | Announce the presence of an occupant at driver seat position
    PresStOfOccptAtRowFirstMid: interface=PresStOfOccpt1  # Presence State of Occupant at Row First Middle | Announce the presence of an occupant at middle seating position at first row
    PresStOfOccptAtRowSecLe: interface=PresStOfOccpt1  # Presence State of Occupant at Row Second Left | Announce the presence of an occupant at left seating position at second row
    PresStOfOccptAtRowSecMid: interface=PresStOfOccpt1  # Presence State of Occupant at Row Second Middle | Announce the presence of an occupant at middle seating position at second row
    PresStOfOccptAtRowSecRi: interface=PresStOfOccpt1  # Presence State of Occupant at Row Second Right | Announce the presence of an occupant at right seating position at second row
    PresStOfOccptAtRowThrdLe: interface=PresStOfOccpt1  # Presence State of Occupant at Row Third Left | Announce the presence of an occupant at left seating position at third row
    PresStOfOccptAtRowThrdMid: interface=PresStOfOccpt1  # Presence State of Occupant at Row Third Middle | Announce the presence of an occupant at middle seating position at third row
    PresStOfOccptAtRowThrdRi: interface=PresStOfOccpt1  # Presence State of Occupant at Row Third Right | Announce the presence of an occupant at right seating position at third row
    PresStOfPass: interface=PresStOfOccpt1  # Presence State of Passenger | Announce the presence of an occupant at passenger seat position
    PrkgBrkActv: interface=PrkgBrkActv1  # Parking Brake Active | Parking brake (conventional or electrical) is activated.
    PrkgBrkAppldIndcn: interface=PrkgBrkAppldIndcn1  # Parking Brake Applied Indication | Indication to Human Machine Interface (HMI) that parking brake is activated.
    PrkgLi: interface=LiExtCmd1  # Parking Light | This port provides command to turn on/off the parking lights
    PrkgLiIndcn: interface=PrkgLiIndcn1  # Parking Light Indication | This port provides indication about the Parking lights on (possible values: left, right, both) /off status to instrument cluster and other body functionalities
    PrkgLiLe: interface=LiExtCmd1  # Parking Light Left | This port provides command to turn on/off parking lights on left side
    PrkgLiLeOut: interface=LiExtCmd1  # Parking Light Left Output | This port provides command to turn on/off parking lights on left side
    PrkgLiRi: interface=LiExtCmd1  # Parking Light Right | This port provides command to turn on/off parking lights on right side
    PrkgLiRiOut: interface=LiExtCmd1  # Parking Light Right Output | This port provides command to turn on/off parking lights on right side
    PrkgLiSwt: interface=PrkgLiIndcn1  # Parking Light Switch | Requests to switch on left, right, both or no parking lights.
    PtDrvReqTqCluVirtEngSpd: interface=PtDrvReqTqCluVirtEngSpd1  # Powertrain: Virtual Driver Request of Torque at Clutch at Target Speed | Virtual driver demand torque at clutch at "Transmission: Engine Speed at Target gear", TrsmEngSpdGearTar. Environmental conditions e.g. altitude and temperature and engine internal limits e.g. smoke limitation and full load limit are considered. | See also: "Transmission: Engine Speed at Target gear", TrsmEngSpdGearTar. Data format for typical network representation for series projects: Base Type: Uint12 Unit: Nm Type: linear Resolution: 1 Offset: - 2048 Physically used range: Hex Lower/Upper Limit: 0h / FFDh Physical Lower/Upper Limit: -2048 / 2045 Special values outside the physically used range: FFEh = Init FFFh = Error, Signal content invalid Cycle Time: 10 ms (max.) for Control Unit internal calculation and Bus communication. Image “Detailed signal content of Torque at Clutch Signals” shows the influence of functionalities on the Torque at Clutch Signals. Example: “Smoke limitation” is marked with an “X” to indicate that it is considered in the signal.
    PtEngTqCrksftMinFast: interface=PtEngTqCrksftMinFast1  # Powertrain: Minimum Engine Torque at Clutch Fast Path | Minimum torque at clutch of combustion engine at latest possible ignition angle. Calculated at current engine speed with current air mass, current ambient pressure and current air temperature. | Signal is relevant for gasoline engines only. The latest possible ignition angle, also called "Max. ignition retard", depends on exhaust temperature, catalyst protection, etc.. Reducing torque request by the transmission down to this torque level should be realized only by ignition retard and not by cylinder cut off. For diesel engines this signal depends on the minimum fuel mass which usually is zero. On parallel hybrid projects this is the minimum torque the combustion engine can realize. Example for “Timing and accuracy requirements to torque signals” in a typical series project: see Explanation Document for Application Interfaces of the Powertrain Domain (Auxiliary Document). Data format for typical network representation for series projects: Base Type: Uint12 Unit: Nm Type: linear Resolution: 1 Offset: - 2048 Physically used range: Hex Lower/Upper Limit: 0h / FFDh Physical Lower/Upper Limit: -2048 / 2045 Special values outside the physically used range: FFEh = Init FFFh = Error, Signal content invalid Cycle Time: 10 ms (max.) for Control Unit internal calculation and Bus communication.
    PtFlgAcDeactvt: interface=PtFlgAcDeactvt1  # Powertrain: Request to Deactivate Air Conditioner (A/C) | Request to deactivate Air Conditioner (A/C) 0 = no deactivation of A/C requested 1 = deactivation of A/C requested
    PtFlgAltDeactvt: interface=PtFlgAltDeactvt1  # Powertrain: Request to Deactivate Alternator (Generator) | Request to deactivate Alternator (generator) 0 = no deactivation of Alternator requested 1 = deactivation of Alternator requested
    PtFlgDrvOvrdVlc: interface=PtFlgDrvOvrdVlc1  # Powertrain: Driver Request Overrides Vehicle Longitudinal Control (VLC) | Flag is set to 1 if driver request overrides Vehicle Longitudinal Control (VLC), otherwise the flag is set to 0
    PtFlgEngRun: interface=PtFlgEngRun1  # Powertrain: Engine Is Running | Powertrain: Cranking finished and engine is running 0 = engine not running 1 = engine running
    PtFlgEngStop: interface=PtFlgEngStop1  # Powertrain: Engine Is Stopped | Powertrain: Engine is stopped 0 = engine not stopped 1 = engine stopped
    PtFlgEngStopReq: interface=PtFlgEngStopReq1  # Powertrain: Engine Stop Request | Powertrain: Engine stop request 0 = no request to stop engine 1 = request to stop engine
    PtFlgEngStopReqAllwd: interface=PtFlgEngStopReqAllwd1  # Powertrain: Request to Stop Engine Is Allowed | Powertrain: Request to stop engine is allowed 0 = request to stop engine not allowed 1 = request to stop engine allowed
    PtFlgEngStrtReq: interface=PtFlgEngStrtReq1  # Powertrain: Engine Start Request | Powertrain: Engine start request 0 = no request to start engine 1 = request to start engine
    PtFlgEngStrtReqAllwd: interface=PtFlgEngStrtReqAllwd1  # Powertrain: Request to Start Engine Is Allowed | Powertrain: Request to start engine is allowed 0 = request to start engine not allowed 1 = request to start engine allowed
    PtFlgHvacDeactvt: interface=PtFlgHvacDeactvt1  # Powertrain: Request to Deactivate Air Conditioner (A/C) | Request to deactivate Air Conditioner (A/C) 0 = no deactivation of A/C requested 1 = deactivation of A/C requested
    PtFlgNoTqWhlReq: interface=PtFlgNoTqWhlReq1  # Powertrain: No Torque Request for Wheel Torque | Wheel torque request below or equal a certain threshold. Torque demands considered : Driver (accelerator pedal), Cruise Control, Adaptive Cruise Control, Variable Vehicle Speed Limitation, Torque increase by Electronic Stability Control (Msr) | 0: Torque request above threshold 1: Torque request below or equal threshold e.g. threshold could be given by loss torques or a calibration value
    PtFlgTqDecPsbl: interface=PtFlgTqDecPsbl1  # Powertrain: Torque Decrease Possible | A decrease of powertrain torque is possible (especially for Electronic Stability Control (ESC)). | If the limit of torque realization is reached during an intervention the bit will change to false. 0 = decrease of powertrain torque is not possible 1 = decrease of powertrain torque is possible
    PtFlgTqIncPsbl: interface=PtFlgTqIncPsbl1  # Powertrain: Torque Increase Possible | An increase of powertrain torque is possible (especially for Electronic Stability Control (ESC)). | If the limit of torque realization is reached during an intervention the bit will change to false. 0 = increase of powertrain torque is not possible 1 = increase of powertrain torque is possible
    PtIntvModTqCluMaxFast: interface=PtIntvModTqCluMaxFast1  # Intervention Mode Permitted for Maximum Torque at Clutch Requested for Shift Intervention on Fast Path | Combination of ignition retard and cylinder cut-off for realization of maximum torque requested for shift intervention on fast path. | 0 = no restrictions => ignition angle and cylinder cut-off allowed, default for diesel engines 1 = Ignition angle and cylinder cut-off 2 = Ignition angle => cylinder cut-off not allowed 3 = Cylinder cut-off => ignition angle not allowed On parallel hybrid projects realization of the torque request by the electric machine is allowed. If the distribution of the torque request to electric machine and combustion engine has to be defined a separate signal is necessary. Data format for typical network representation for series projects: BaseType: Uint2 Unit: -- Type: Enum 0 = no restriction 1 = ignition angle and cylinder cut-off 2 = ignition angle 3 = cylinder cut-off Cycle Time: 10 ms (max.) for Control Unit internal calculation and Bus communication. Typical receiver: Powertrain
    PtNClu: interface=PtNClu1  # Speed at Clutch from Powertrain | Signal is used only for vehicles, where the engine speed can be different from the speed at converter or clutch. This signal is a combination of the engine speed and the speed of the electric machine, at the engine/electric machine side of the transmission clutch or converter. | Definition of "Clutch": Signal is sent with initialisation. for Automatic Transmission (AT), Continuously Variable Transmission (CVT) it is the converter clutch for Manual Transmission (MT), Automatic Manual Transmission (AMT) it is the clutch between the gear box and the engine drivetrain.
    PtNEngSp: interface=PtNEngSp1  # Powertrain: Engine Speed Setpoint | calculated engine speed setpoint e.g. idle engine speed setpoint during idle | Default value after reset: zero
    PtRatTqDistbnReq: interface=PtRatTqDistbnReq1  # Powertrain: Requested Percental Distribution of Torque to Wheels | This signal only considers the torque which can be distributed from one or more central torque producers to the wheels by the transmission system. It does not consider additional torque producers located e.g. at the individual wheels. Where no torque is distributed to the wheels by the transmission system (e.g. one axle not driven or directly driven by an electric machine), the respective values are zero. The sum of all 4 values must be 100%.
    PtTqActAtWhls: interface=PtTqWhlInd1  # Powertrain Torque Actual at Wheels | Vector of 4 signals. Actual torque delivered by the powertrain to the individual wheels. The sum of all 4 signals must be equal to actual total powertrain torque at wheels. | In case of actor/sensor failures or if there is no possibility to determine the correct distribution a rough estimation is done. Additionally a qualifier has to be set, to inform about invalid or backup values.
    PtTqClu: interface=PtTqClu1  # Powertrain: Torque at Clutch | Indicated torque of combustion engine plus torque of electric machine, where present, plus internal engine torque losses plus all losses with influence on torque at clutch. Torque influence of inertia is not considered. | Torque at clutch is a torque at the mechanical interface between engine and transmission. E.g. for manual transmissions the mechanical interface is the primary side of the clutch, for automatic transmissions this is the primary side of the converter. Torque at clutch considers following contributors if present: 1) indicated torque of combustion engine, calculated on basis of injection timing and injected fuel, ignition angle and air mass. 2) torque of electric machine at clutch level 3) internal engine torque losses like friction, pumping, mechanical driven water pump etc. 4) losses with influence on torque at clutch caused by alternator, airconditioning, Power steering etc. Torque influence of inertia is not considered. Loss differences from engine to engine and variable torque losses over life cycle have to be considered. On parallel hybrid projects the torque of the combustion engine has to be considered in dependence of the state of the Engine Clutch. The transmission oil pump is located on transmission side of the interface and is therefore not considered in the signal. The signal can be calculated based on “Engine Torque at Crankshaft” EngTqCrksft, as its description applies here as well: Signal includes all torque requests from accelerator pedal, cruise control, speed limiter, etc. and all interventions like torque and speed interventions. Example of realization: The torque is a cylinder average via two crankshaft revolutions, not a time average, of all cylinders considering current operating parameters. They include engine temperature, ignition timing and air mass measured or calculated, lambda, fuel cut level, fuel quantity, injection timing, knock control adaption, geographic altitude and others. Data format for typical network representation for series projects: Base Type: Uint12 Unit: Nm Type: linear Resolution: 1 Offset: - 2048 Physically used range: Hex Lower/Upper Limit: 0h / FFDh Physical Lower/Upper Limit: -2048 / 2045 Special values outside the physically used range: FFEh = Init FFFh = Error, Signal content invalid Cycle Time: 10 ms (max.) for Control Unit internal calculation and Bus communication. Example for “Timing and accuracy requirements to torque signals” in a typical series project: Image “Detailed signal content of Torque at Clutch Signals” shows the influence of functionalities on the Torque at Clutch Signals. Example: “Smoke limitation” is marked with an “X” to indicate that it is considered in the signal.
    PtTqCluDyn: interface=PtTqCluDyn1  # Dynamic Torque at Clutch from Powertrain | This signal has to consider all engine internal and auxiliary inertia torques, but no transmission inertia torques. | Example of usage: Used for Transmission to calculate a predictive slipping time of the clutch to prepare an ideal termination of shifting. Note definition of "dynamic torque correction": This signal has to consider all internal inertia torques of specific components: Dynamic Torque at Clutch = Torque At Clutch + Engine dynamic moment of inertia. Default value after reset is zero.
    PtTqCluDynJ: interface=PtTqCluDynJ1  # Powertrain: Dynamic Moment of Inertia at Clutch | Dynamic Moment of Inertia of all Components of the Drive Unit on Clutch Level. Definition of the sign: Increasing speed creates a negative sign, decreasing speed creates a positive sign. | The signal contains the dynamic torque created by the inertia which increases or decreases the torque at clutch. The engine internal inertia and the inertia of the ancillaries up to the clutch have to be considered. On parallel hybrid projects the inertia of combustion engine and electric machine are considered. Additionally the inertia of Engine Clutch has to be considered. Example for “Timing and accuracy requirements to torque signals” in a typical series project: see Explanation Document for Application Interfaces of the Powertrain Domain (Auxiliary Document). Data format for typical network representation for series projects: Base Type: Uint12 Unit: Nm Type: linear Resolution: 1 Offset: - 2048 Physically used range: Hex Lower/Upper Limit: 0h / FFDh Physical Lower/Upper Limit: -2048 / 2045 Special values outside the physically used range: FFEh = Init FFFh = Error, Signal content invalid Cycle Time: 10 ms (max.) for Control Unit internal calculation and Bus communication.
    PtTqCluMaxDrv: interface=PtTqCluMaxDrv1  # Powertrain: Maximum Available Torque at Clutch for Driver | Maximum possible torque at clutch at optimum conditions delivered by powertrain for driver | Example of realization: Could take into account: current engine speed, ambient pressure, air temperature, static power limitation due to engine, auxiliaries (everything with impact to the torque output, e.g. power steering pump, Air Conditioner (A/C), generator or starter generator), smoke limitation, fuel quality correction Including maximum over boost
    PtTqCluMaxSpdCluCur: interface=PtTqCluMaxSpdCluCur1  # Powertrain: Maximum Torque at Clutch at Current Clutch Speed | Maximum possible torque at clutch at current clutch speed with maximum possible air mass at current ambient pressure and air temperature, including static power limitation of the engine. | Theoretical full load engine torque at clutch at actual engine speed. Maximally charged for turbo systems. On parallel hybrid projects the signal is the sum of the maximum torque of combustion engine and electric machine considering the status of the Engine Clutch. Static power limitation contains e.g. restrictions for protection and static smoke limitation. Permanent knock limitation is considered, knock control not. Example for “Timing and accuracy requirements to torque signals” in a typical series project: see Explanation Document for Application Interfaces of the Powertrain Domain (Auxiliary Document). Data format for typical network representation for series projects: Base Type: Uint12 Unit: Nm Type: linear Resolution: 1 Offset: - 2048 Physically used range: Hex Lower/Upper Limit: 0h / FFDh Physical Lower/Upper Limit: -2048 / 2045 Special values outside the physically used range: FFEh = Init FFFh = Error, Signal content invalid Cycle Time: 10 ms (max.) for Control Unit internal calculation and Bus communication.
    PtTqCluMinDrv: interface=PtTqCluMinDrv1  # Powertrain: Minimum Available Torque at Clutch for Driver | Minimum possible torque at clutch delivered by powertrain for driver | Example of realization: Could take into account: Losses of auxiliaries, integral part of idle speed controller, indicated torque, engine friction, fuel cut off
    PtTqCluReqWoTrsmIntv: interface=PtTqCluReqWoTrsmIntv1  # Powertrain: Requested Torque at Clutch without Transmission Intervention | "Driver Request of Torque at Clutch Fast Path", DrvReqTqCluFast including all interventions except transmission shift interventions, including all limitations. Limitations include environmental conditions like altitude, temperature, etc. and engine limitations like smoke limitation, full load limit, etc. . | Further explanation see signal "Driver Request of Torque at Clutch Fast Path", DrvReqTqCluFast. Data format for typical network representation for series projects: Base Type: Uint12 Unit: Nm Type: linear Resolution: 1 Offset: - 2048 Physically used range: Hex Lower/Upper Limit: 0h / FFDh Physical Lower/Upper Limit: -2048 / 2045 Special values outside the physically used range: FFEh = Init FFFh = Error, Signal content invalid Cycle Time: 10 ms (max.) for Control Unit internal calculation and Bus communication. Example for “Timing and accuracy requirements to torque signals” in a typical series project: Image “Detailed signal content of Torque at Clutch Signals” shows the influence of functionalities on the Torque at Clutch Signals. Example: “Smoke limitation” is marked with an “X” to indicate that it is considered in the signal.
    PtTqCluTarGear: interface=PtTqCluTarGear1  # Powertrain: Predicted Torque at Clutch at Target Gear | Used for Dual Clutch Transmission (DCT) to calculate the clutch pressure to terminate the shifting comfortably. This torque is calculated with actual pedal position and an engine speed at target gear. | Default value after reset is zero
    PtTqCluWoTrsmIntv: interface=PtTqCluWoTrsmIntv1  # Powertrain: Torque at Clutch without Transmission Intervention | "Torque at Clutch" that would be realised if no transmission shift interventions would be active. | Outside a transmission intervention the signal should show the same value as "Powertrain: Torque at Clutch", PtTqClu. During interventions the signal should show the desired torque without considering the intervention, independent of realization by ignition, air, cylinder cutoff. Influences of the transmission request for shifts onto the air path or cylinder cutoff are NOT considered, not even if the fast path request can only be realized by influencing the air path or cylinder cutoff. Data format for typical network representation for series projects: Base Type: Uint12 Unit: Nm Type: linear Resolution: 1 Offset: - 2048 Physically used range: Hex Lower/Upper Limit: 0h / FFDh Physical Lower/Upper Limit: -2048 / 2045 Special values outside the physically used range: FFEh = Init FFFh = Error, Signal content invalid Cycle Time: 10 ms (max.) for Control Unit internal calculation and Bus communication. Typical Receiver: Transmission Example for “Timing and accuracy requirements to torque signals” in a typical series project: Image “Detailed signal content of Torque at Clutch Signals” shows the influence of functionalities on the Torque at Clutch Signals. Example: “Smoke limitation” is marked with an “X” to indicate that it is considered in the signal.
    PtTqCrksftReqFast: interface=PtTqCrksftReqFast1  # Crankshaft Torque Request to Be Realized by the Fast Path of Powertrain | Required crankshaft torque which should be generated by engine. The engine will restrict this request to its internal limits. | Example of realization: Including fast torque intervention from brake control, transmission control etc.
    PtTqCrksftReqSlow: interface=PtTqCrksftReqSlow1  # Crankshaft Torque Request to Be Realized by the Slow Path of Powertrain | Crankshaft torque which should be realized by the slow path to prepare the engine for a future torque setpoint. The engine will restrict this request to its internal limits. | Example of realization: If there is no distinction between slow and fast path control within the engine management (e.g. for a Diesel engine), this signal can be ignored by the engine management. Without fast torque intervention from brake control, transmission control etc.
    PtTqDecAtWhlsReqByEscFast: interface=PtTqTotAtWhls1  # Powertrain Torque Decrease at Wheels Request by Stability Control Fast | Decreasing torque at wheels requested by Electronic Stability Control below the driver input torque including virtual driver request. Fast refers to the immediate / instant torque request, typically achieved by ignition timing.
    PtTqDecAtWhlsReqByEscSlow: interface=PtTqTotAtWhls1  # Powertrain Torque Decrease at Wheels Request by Stability Control Slow | Decreasing torque at wheels requested by Electronic Stability Control over the driver input torque including virtual driver (target value). Slow refers to the longer term or torque reserve request, usually the input to throttle control.
    PtTqDistbnToWhlsReqdByDtd: interface=PtTqDistbnToWhls1  # Requested Drivetrain Torque Distribution | The Drivetrain Torque Distribution strategy in Chassis requests a distribution of the total powertrain torque at wheels, not a modification to that total torque. Therefore the distribution is requested as a percentage value for each wheel.
    PtTqIncAtWhlsReqByEscFast: interface=PtTqTotAtWhls1  # Powertrain Torque Increase at Wheels Request by ESC Fast | Increasing torque at wheels requested by Electronic Stability Control over the driver input torque including virtual driver (target value). Fast refers to the immediate / instant torque request, typically achieved by ignition timing.
    PtTqIncAtWhlsReqByEscSlow: interface=PtTqTotAtWhls1  # Powertrain Torque Increase at Wheels Request by Stability Control Slow | Increasing torque at wheels requested by Electronic Stability Control over the driver input torque including virtual driver (target value). Slow refers to the longer term or torque reserve request, usually the input to throttle control.
    PtTqMaxAc: interface=PtTqMaxAc1  # Powertrain: Maximum Allowed Torque for A/C Compressor | Allowable torque for Air Conditioning (A/C) compressor. It is an engine crankshaft torque. Examples of realization: This interface could contain either - the torque that the Air Conditioning (A/C) compressor is allowed to consume in steady state - the highest torque that the Air Conditioning (A/C) compressor is allowed to consume at any point in time
    PtTqMaxAlt: interface=PtTqMaxAlt1  # Powertrain: Maximum Allowed Mechanical Load for Alternator (Generator) at Engine Crank Shaft | Allowed mechanical load for alternator (generator) at engine crank shaft.
    PtTqMaxHvac: interface=PtTqMaxHvac1  # Powertrain: Maximum Allowed Torque for A/C Compressor | Allowable torque for Air Conditioning (A/C) compressor. It is an engine crankshaft torque. Examples of realization: This interface could contain either - the torque that the Air Conditioning (A/C) compressor is allowed to consume in steady state - the highest torque that the Air Conditioning (A/C) compressor is allowed to consume at any point in time
    PtTqMaxSteer: interface=PtTqMaxSteer1  # Powertrain: Maximum Allowed Mechanical Load for Steering at Engine Crank Shaft | Allowed mechanical load for steering at engine crank shaft. | In case of electric steering, this should be zero Nm, because the load is included in alternator load.
    PtTqMaxTrsmOilPmp: interface=PtTqMaxTrsmOilPmp1  # Powertrain: Maximum Allowed Transmission Oil Pump Load | Maximum allowed transmission oil pump load at engine crank shaft. | If the oil pump is driven by the engine crank shaft then this value must take into account all relevant dynamic effects. If it is an electric oil pump, the value should be zero Nm, because the load is included in alternator load. The value of this signal is converted to engine crank shaft torque by the provider.
    PtTqResvEng: interface=PtTqResvEng1  # Torque Reserve Request from Powertrain to Engine | Reserved torque request coordinated in the Powertrain coordinator (PTC) to be realized by the combustion engine. The coordination can consider multiple reserved torque requirements, e.g. auxiliary loads such as Air Conditioning (A/C) compressor. | Default value after reset is zero
    PtTqTotActAtWhls: interface=PtTqWhl1  # Powertrain Torque Total Actual at Wheels | Total wheel torque provided by powertrain (sum of torques at wheels) | This signal is computed from "Actual torque at clutch" and other torque losses with influence on wheel torque (e.g. converter, differential). It considers all torque interventions. It includes the actual torque ratio. Negative values indicate drag torque, independently from driving direction.Default value after reset is zero.
    PtTqTotAvlMaxAtWhls: interface=PtTqWhlMax1  # Powertrain Torque Total Available Maximum at Wheels | Maximum possible total torque at wheels. | Example of realization: Could take into account: Current engine speed, ambient pressure, air temperature, static power limitation due to engine, auxiliaries (everything with impact to the torque output, e.g. power steering pump, air conditioner (A/C), generator or starter generator), smoke limitation, fuel quality correction. Incl. actual over boost (whilst temporarily active triggered by driver request). The calculation of torque at wheel could take into account the current gear, hydraulic converter and all losses in the transmission system.Must be initialised to the upper limit of the chosen data type.
    PtTqTotAvlMinAtWhls: interface=PtTqWhlMinWoCutOff1  # Powertrain Torque Total Available Minimum at Wheels | Minimum possible total powertrain torque at wheels without complete fuel cut off. | Any torque value between minimum and maximum can be requested and it is expected that the Powertrain Coordinator (PTC) will deliver that value. Example of realization: Could take into account: Losses of auxiliaries, integral part of idle speed controller, indicated torque, engine friction, fuel cut off Complete fuel cut off excluded, since these are just the complete losses. This is the minimum torque value which can be achieved without any discontinuity and/or impact on emissions.Must be initialised to the lower limit of the chosen data type.
    PtTqTotFastReqAtWhlsByRsc: interface=PtTqTotAtWhls2  # Powertrain Torque Total Fast at Wheels Request by RSC | Requested wheel torque from Roll Stability Control (RSC) to Electronic Stability Control (ESC) (fast). The maximum torque is to be delivered by the powertrain, e.g. a torque decrease request [absolute] for Acceleration Slip Control (ASC) (to prevent wheel spin). The minimum torque is to be delivered by the powertrain, e.g. a torque increase request [absolute] for Engine Drag Torque Control (MSR) (to prevent wheel lock up). If the maximum request is less than the minimum request, the priority must be clearly defined. If no request is active, the value will be the upper limit of the chosen data type. | Must be initialised to the upper and lower limit of the chosen data type.
    PtTqTotMaxAtWhlsReqdByVlc: interface=PtTqTotAtWhls1  # Maximum Torque at Wheel by Vehicle Longitudinal Control (VLC) | Requested wheel torque (to all the driven wheels) after coordination among several vehicle longitudinal control systems (e.g. cruise control, adaptive cruise control, collision mitigation) to be generated by the powertrain. This is the maximum torque to be delivered by the powertrain, e.g. a torque limit request [absolute] (vehicle speed limitation). If the maximum request is less than the minimum request the priority is the Maximum Request (which in the case is the lower value!). If no request is active, the value will be the upper limit of the chosen data type. | Must be initialised to the upper limit of the chosen data type.
    PtTqTotMinAtWhlsReqdByVlc: interface=PtTqTotAtWhls1  # Minimum Torque at Wheel by Vehicle Longitudinal Control (VLC) | Requested wheel torque (to all the driven wheels) after coordination among several vehicle longitudinal control systems (e.g. cruise control, adaptive cruise control, collision mitigation) to be generated by the powertrain. This is the minimum torque to be delivered by the powertrain, e.g. a torque request [absolute] for CC/ACC (Cruise Control, Adaptive Cruise Control). If the maximum request is less than the minimum request the priority must be clearly defined. If no request is active, the value will be the lower limit of the chosen data type. | Must be initialised to the lower limit of the chosen data type.
    PtTqTotReqdAtWhls: interface=PtTqWhlReq1  # Powertrain Torque Total Requested at Wheels | Total requested propulsion wheel torque (sum of torques at wheel). Output wheel torque request from powertrain coordinator (includes wheel torque requests: driver / Vehicle Longitudinal Control (VLC) / Electronic Stability Control (ESC) ). | Negative values indicate drag torque, independently from driving direction.Default value after reset is zero.
    PtTqTotReqdAtWhlsForVlc: interface=PtTqWhlReqDrvVlc1  # Powertrain Torque Total Requested at Wheels for Vehicle Longitudinal Control (VLC) | Total requested propulsion wheel torque (sum of torques at wheel) by the driver or Vehicle Longitudinal Control (VLC). Result of arbitration of driver vs. driver assistance functions in powertrain coordinator.
    PtTqTotSlowReqAtWhlsByRsc: interface=PtTqTotAtWhls2  # Powertrain Torque Total Slow at Wheels Request by RSC | Requested wheel torque from Roll Stability Control (RSC) to Electronic Stability Control (ESC) (slow). The maximum torque is to be delivered by the powertrain, e.g. a torque decrease request [absolute] for Acceleration Slip Control (ASC) (to prevent wheel spin). The minimum torque is to be delivered by the powertrain, e.g. a torque increase request [absolute] for Engine Drag Torque Control (MSR) (to prevent wheel lock up). If the maximum request is less than the minimum request, the priority is the maximum request (which is the lower value in this case!) If no request is active, the value will be the upper limit of the chosen data type. | Must be initialised to the upper and lower limit of the chosen data type.
    PtTqWhl: interface=PtTqWhl1  # Total Wheel Torque Provided by Powertrain | Total wheel torque provided by powertrain (sum of torques at wheels) | This signal is computed from "Actual torque at clutch" and other torque losses with influence on wheel torque (e.g. converter, differential). It considers all torque interventions. It includes the actual torque ratio. Negative values indicate drag torque, independently from driving direction.Default value after reset is zero
    PtTqWhlInd: interface=PtTqWhlInd1  # Torque Delivered by the Powertrain to the Individual Wheels | Vector of 4 signals. Consolidated torque delivered by the powertrain to the individual wheels. The sum of all 4 signals must be equal to Actual total powertrain torque at wheels. | In case of actor/sensor failures or if there is no possibility to determine the correct distribution a rough estimation is done.
    PtTqWhlMax: interface=PtTqWhlMax1  # Powertrain: Maximum Possible Total Torque at Wheels | Maximum possible total torque at wheels. | Example of realization: Could take into account: current engine speed, ambient pressure, air temperature, static power limitation due to engine, auxiliaries (everything with impact to the torque output, e.g. power steering pump, Air Conditioner (A/C), generator or starter generator), smoke limitation, fuel quality correction Incl. actual over boost (whilst temporarily active triggered by driver request). The calculation of torque at wheel could take into account the current gear, hydraulic converter and all losses in the transmission system.Must be initialised to the upper limit of the chosen data type.
    PtTqWhlMaxDrv: interface=PtTqWhlMaxDrv1  # Maximum Possible Total Torque at Wheels at Optimum Conditions Delivered by Powertrain for Driver | Maximum possible total torque at wheels at optimum conditions delivered by powertrain for Driver | Example of realization: Could take into account: current engine speed, ambient pressure, air temperature, static power limitation due to engine, auxiliaries (everything with impact to the torque output, e.g. power steering pump, Air Conditioner (A/C), generator or starter generator), smoke limitation, fuel quality correction Incl. maximum over boost The calculation of torque at wheel could take into account the current gear, hydraulic converter and all losses in the transmission system.Must be initialised to the upper limit of the chosen data type.
    PtTqWhlMin: interface=PtTqWhlMin1  # Minimum Available Total Powertrain Torque at Wheels | Minimum possible total powertrain torque at wheels "for unfired engine". Lowest possible value of the torque delivered to the wheels by the powertrain assuming that complete fuel cut off is enabled. | Example of realization: Could take into account: Losses of auxiliaries, engine friction, complete fuel cut off'Must be initialised to the lower limit of the chosen data type.'
    PtTqWhlMinDrv: interface=PtTqWhlMinDrv1  # Minimum Possible Total Torque at Wheels Delivered by Powertrain for Driver | Minimum possible total torque at wheels delivered by powertrain for driver | Example of realization: Could take into account: Losses of auxiliaries, integral part of idle speed controller, indicated torque, engine friction, fuel cut off'Must be initialised to the lower limit of the chosen data type.'
    PtTqWhlMinWoCutOff: interface=PtTqWhlMinWoCutOff1  # Minimum Possible Total Powertrain Torque at Wheels without Complete Fuel Cut Off | Minimum possible total powertrain torque at wheels without complete fuel cut off. | Any torque value between minimum and maximum can be requested and it is expected that the Powertrain Coordinator (PTC) will deliver that value. Example of realization: Could take into account: Losses of auxiliaries, integral part of idle speed controller, indicated torque, engine friction, fuel cut off Complete fuel cut off excluded, since these are just the complete losses. This is the minimum torque value which can be achieved without any discontinuity and/or impact on emissions.Must be initialised to the lower limit of the chosen data type.
    PtTqWhlReq: interface=PtTqWhlReq1  # Powertrain: Total Requested Propulsion Wheel Torque | Total requested propulsion wheel torque (sum of torques at wheel). Output wheel torque request from powertrain coordinator (includes wheel torque requests driver / Vehicle Longitudinal Control (VLC) / Electronic Stability Control (ESC) ). | Negative values indicate drag torque, independently from driving direction.Default value after reset is zero.
    PtTqWhlReqDrvVlc: interface=PtTqWhlReqDrvVlc1  # Powertrain: Total Requested Propulsion Wheel Torque by the Driver or Vehicle Longitudinal Control (VLC) | Total requested propulsion wheel torque (sum of torques at wheel) by the driver or Vehicle Longitudinal Control (VLC). Result of arbitration of driver vs. driver assistance functions in powertrain coordinator. | Negative values indicate drag torque, independently from driving direction.
    PuddleLi: interface=LiExtCmd1  # Puddle Light | This port provides command to turn on/off puddle lights
    PuddleLiLeOut: interface=LiExtCmd1  # Puddle Light Left Output | This port provides command to turn on/off left puddle lights
    PuddleLiRiOut: interface=LiExtCmd1  # Puddle Light Right Output | This port provides command to turn on/off right puddle lights
    PullAid: interface=PullAidCmd1  # Door Pull Aid | Command to assist the movement of a door
    PullAidOfDoorLockReLe: interface=PullAidCmd1  # Rear Door Pull Aid | This port provide the Pull Aid Command to assist the movement of a rear door.
    PullAidOfDoorLockReRi: interface=PullAidCmd1  # Rear Door Pull Aid | This port provide the Pull Aid Command to assist the movement of a rear door.
    PullAidOfDrvrDoorLock: interface=PullAidCmd1  # Front Door Pull Aid | This port provide the Pull Aid Command to assist the movement of a front door.
    PullAidOfLidRe: interface=PullAidCmd1  # Pull Aid of Lid Rear | This port provide the Pull Aid Command to assist the movement of the rear lid.
    PullAidOfPassDoorLock: interface=PullAidCmd1  # Front Door Pull Aid | This port provide the Pull Aid Command to assist the movement of a front door.
    PwrSply: interface=PwrSplySt1  # Power Supply | Current power supply status
    RadioFrqPanic: interface=RadioFrqPanicReq1  # Radio Frequency Panic | Request to activate panic alarm from Radio Frequency (RF)
    RadioSt: interface=RadioSt1  # Radio Status | Radio presence status
    RadioSts: interface=RadioSts1  # Radio Status | Radio presence status
    RainAmntSt: interface=RainAmntSt1  # Rain Amount Status | information related to the amount of rain detected by the rain sensor
    RainAmntSts: interface=RainAmntSts1  # Rain Amount Status | information related to the amount of rain detected by the rain sensor
    RainSenErr: interface=RainSenErr1  # Rain Sensing Error | Information related to errors or defects detected on the rain sensor
    RainSenReq: interface=RainSenReq1  # Rain Sensing Request | Request switching on off rain sensing and a rain sensing sensitivity level.
    RideHeiLvlEstimdFrnt: interface=RideHeiLvl1  # Ride Height Level Estimated Front | The actual estimated ride height at the front axle.
    RideHeiLvlEstimdRe: interface=RideHeiLvl1  # Ride Height Level Estimated Rear | The actual estimated ride height at the rear axle.
    RideHeiLvlMeasdFrnt: interface=RideHeiLvl1  # Ride Height Level Measured Front | The measured ride height at the front axle (Filtered and offset compensated).
    RideHeiLvlMeasdFrntBas: interface=RideHeiLvl1  # Ride Height Level Measured Front Base | The actual measured ride height at the front axle.
    RideHeiLvlMeasdFrntRaw: interface=RideHeiLvl1  # Ride Height Level Measured Front Raw | The actual measured ride height at the front axle.
    RideHeiLvlMeasdFrntStd: interface=RideHeiLvl1  # Ride Height Level Measured Front Standard | The actual measured ride height at the front axle (Filtered and offset compensated).
    RideHeiLvlMeasdRe: interface=RideHeiLvl1  # Ride Height Level Measured Rear | The measured ride height at the rear axle (Filtered and offset compensated).
    RideHeiLvlMeasdReBas: interface=RideHeiLvl1  # Ride Height Level Measured Rear Base | The actual measured ride height at the rear axle.
    RideHeiLvlMeasdReRaw: interface=RideHeiLvl1  # Ride Height Level Measured Rear Raw | The actual measured ride height at the rear axle.
    RideHeiLvlMeasdReStd: interface=RideHeiLvl1  # Ride Height Level Measured Rear Standard | The actual measured ride height at the rear axle (Filtered and offset compensated).
    RoadBnkAEstimnByEsc: interface=RoadBnkAEstimn1  # Road Bank Acceleration Estimated by ESC | Acceleration component resulting from a banked road provided by Electronic Stability Control (ESC).
    RoadCdn: interface=RoadCdnSt1  # Road Condition | Information about road condition status
    RoadExct: interface=RoadExct1  # Road Excitation | Vertical wheel oscillation amplitude and frequency
    RoadInclnAEstimn: interface=RoadInclnAEstimn1  # Road Inclination Acceleration Estimated | Acceleration component resulting from road inclination in terms of vehicle coordinates. Estimated from longitudinal acceleration from wheel speeds and longitudinal acceleration sensor.
    RoadWhlAgAbsltFrntReqBySteerDrvrAsscSys: interface=RoadWhlAg1  # Road Wheel Angle Absolute Front Request by Steering Driver Assistance System | Requested road wheel angle for front steering actuator by Steering Driver Assistance System.
    RoadWhlAgAbsltFrntReqBySteerVehStabyCtrl: interface=RoadWhlAg1  # Road Wheel Angle Absolute Front Request by Steering Vehicle Stabilizing Control | Requested road wheel angle for front steering actuator by Steering Vehicle Stabilizing System.
    RoadWhlAgAbsltReReqBySteerDrvrAsscSys: interface=RoadWhlAg1  # Road Wheel Angle Absolute Rear Request by Steering Driver Assistance System | Requested absolute road wheel angle for rear wheel steering actuator by Steering Driver Assistance System.
    RoadWhlAgAbsltReReqBySteerVehStabyCtrl: interface=RoadWhlAg1  # Road Wheel Angle Absolute Rear Request by Steering Vehicle Stabilizing Control | Requested absolute road wheel angle for rear wheel steering actuator by Steering Vehicle Stabilizing System.
    RoadWhlAgDeltaFrntReqBySteerDrvrAsscSys: interface=RoadWhlAg1  # Road Wheel Angle Delta Front Request by Steering Driver Assistance System | Driver Assistance System (DAS) requests additional (road wheel) steer angle interventions via front steering actuator (= delta steer angle at steered wheels, at angle superposition steering systems: Middle front axle delta steering angle). Angle related to average front wheel angle.
    RoadWhlAgDeltaFrntReqBySteerVehStabyCtrl: interface=RoadWhlAg1  # Road Wheel Angle Delta Front Request by Steering Vehicle Stabilizing Control | Steering Vehicle Stabilizing Control requests delta (road wheel) steer angle interventions via front steering actuator (= delta steer angle at steered wheels, at angle superposition steering systems: Middle front axle delta steering angle). Angle related to average front wheel angle.
    RoadWhlAgDeltaReReqBySteerDrvrAsscSys: interface=RoadWhlAg1  # Road Wheel Angle Delta Rear Request by Steering Driver Assistance System | Driver Assistance System (DAS) requests additional road wheel steer angle interventions via rear steering actuator (= delta steer angle at steered wheels, at angle superposition steering systems: Middle rear axle delta steering angle). Actual not mediated.
    RoadWhlAgDeltaReReqBySteerVehStabyCtrl: interface=RoadWhlAg1  # Road Wheel Angle Delta Rear Request by Steering Vehicle Stabilizing Control | Steering Vehicle Stabilizing Control requests delta road wheel steer angle interventions via rear steering actuator (= delta steer angle at steered wheels, at angle superposition steering systems: Middle rear axle delta steering angle).
    RoadWhlAgEstimdFrnt: interface=RoadWhlAg1  # Road Wheel Angle Estimated Front | Road wheel angle at front steered wheels. Includes all steering control algorithms (e.g. calculated by a relation converter: Steer wheel angle - road wheel angle using a characteristic map).
    RoadWhlAgEstimdFrntWishdByDrvr: interface=RoadWhlAg1  # Road Wheel Angle Estimated Front Wished by Driver | Front road wheel angle driver wish based on the driver steering wheel input angle plus Variable Gear Ratio plus Steering Driver Assistance System angle. Does not include additional steering road wheel angle from stabilizing control algorithms.
    RoadWhlAgEstimdRe: interface=RoadWhlAg1  # Road Wheel Angle Estimated Rear | Actual estimated road wheel angle at rear steered wheels. Includes all steering control algorithms (e.g. calculated by a relation converter: Steer wheel angle - road wheel angle using a characteristic map).
    RoadWhlAgSpdEstimdFrnt: interface=RoadWhlAgSpd1  # Road Wheel Angle Speed Estimated Front | Time-derivative of the estimated front road wheel angle.
    RoadWhlAgSpdEstimdFrntWishdByDrvr: interface=RoadWhlAgSpd1  # Road Wheel Angle Speed Estimated Front Wished by Driver | Time-derivative of front road wheel angle driver wish.
    RoadWhlAgTotReqFrnt: interface=RoadWhlAg2  # Road Wheel Angle Total Request Front | Total front road wheel angle requests after arbitration of the high level steering functions.
    RoadWhlAgTotReqRe: interface=RoadWhlAg2  # Road Wheel Angle Total Request Rear | Total rear road wheel angle requests after arbitration of the high level steering functions.
    RollCmpLvl: interface=RollCmpLvl1  # Roll Compensation Level | The current compensation level of the body roll angle
    RollMomtmDistbn: interface=RollMomtmDistbn1  # Roll Momentum Distribution | Estimated stabilizer roll torque difference front to rear defined relative to the total stabilizer torque (front and rear)
    RollRateAtCen: interface=RollRate3  # Roll Rate at Center | Roll Rate from sensor element. Coordinate system according to ISO 8855. Raw signal
    RollRateBas: interface=RollRate1  # Roll Rate Base | Roll Rate from sensor element. Coordinate system according to ISO 8855. Raw signal.
    RollRateMeasd: interface=RollRate1  # Roll Rate Measured | Roll Rate from sensor element. Coordinate system according to ISO 8855. Derived from Base Signal after filtering, Offset-Compensation, Model-based Plausibility Check, etc.
    RollRateRaw: interface=RollRate1  # Roll Rate Raw | Roll Rate from sensor element. Coordinate system according to ISO 8855. Raw signal.
    RollRateRngExtd: interface=RollRate2  # Roll Rate Range Extended | Roll Rate from sensor element. Coordinate system according to ISO 8855. Extended signal range.
    RollRateStd: interface=RollRate1  # Roll Rate Standard | Roll Rate from sensor element. Coordinate system according to ISO 8855. Derived from Base Signal after filtering, Offset-Compensation, Model-based Plausibility Check, etc.
    RoofCnvtbCmd: interface=RoofCnvtbCmd1  # Convertible Roof Command | Command for convertible operation: to open or close the convertible roof
    RoofCnvtbInTr: interface=UpReqForRoofCnvtb1  # Convertible Roof Up Request | Request related to Roof folded in the trunk. This request assists the customer to open the trunk with the roof folded in for a luggage access.
    RoofCnvtbInfo: interface=RoofCnvtbSt1  # Convertible Roof Information | Information on the convertible roof (Opened or Closed)
    RoofCnvtbReqFromHmi: interface=RoofCnvtbReq1  # Convertible Roof Request from HMI | Request from Hmi to get the vehicle in a convertible mode
    RoofCnvtbReqRem: interface=RoofCnvtbReq1  # Convertible Roof Request from Remote Key | Request from the remote key to get the vehicle in a convertible mode
    RoofCnvtbSt: interface=RoofCnvtbSt1  # Convertible Roof Status | Information on the convertible roof (Opened or Closed), needed for an internal use of the function
    RoofCnvtbSts: interface=RoofCnvtbSts1  # Convertible Roof Status | Information on the convertible roof (Opened or Closed), needed for an internal use of the function
    RoofPosn: interface=PosnSt1  # Roof Position | Position of the convertible roof
    RoofUnlckd: interface=SnsrRoofCnvtbSt1  # Roof Unlocked Status | Status of convertible sensor for roof unlocked
    RscCtrlDi: interface=RscCtrlDi1  # RSC Control Disable | Roll Stability Control is disabled due to detected fault or electronic control unit (ECU) initialization.
    RscCtrlIntvgPerWhl: interface=RscCtrlIntvgPerWhl1  # RSC Control Intervening per Wheel | Wheel has roll stability control intervening. Wheel individual.
    SeatAxisActtn: interface=SeatMove1  # Seat Axis Actuation Command | This port allows a command of the axis movement in a certain direction, with a certain speed
    SeatAxisMemPosn: interface=SeatStorePosnSt1  # Seat Axis Memory Position | Memory-position data from storage memory for the current profile of a certain seat axis.
    SeatAxisMemPosnOfAxisActrBackBlstrLe: interface=SeatStorePosnSt1  # Seat Axis Memory Position | Memory position data from storage memory for the current profile of a certain seat axis.
    SeatAxisMemPosnOfAxisActrBackBlstrRi: interface=SeatStorePosnSt1  # Seat Axis Memory Position | Memory position data from storage memory for the current profile of a certain seat axis.
    SeatAxisMemPosnOfAxisActrCushBlstrLe: interface=SeatStorePosnSt1  # Seat Axis Memory Position | Memory position data from storage memory for the current profile of a certain seat axis.
    SeatAxisMemPosnOfAxisActrCushBlstrRi: interface=SeatStorePosnSt1  # Seat Axis Memory Position | Memory position data from storage memory for the current profile of a certain seat axis.
    SeatAxisMemPosnOfAxisActrCushExtn: interface=SeatStorePosnSt1  # Seat Axis Memory Position | Memory position data from storage memory for the current profile of a certain seat axis.
    SeatAxisMemPosnOfAxisActrHdrestFold: interface=SeatStorePosnSt1  # Seat Axis Memory Position | Memory position data from storage memory for the current profile of a certain seat axis.
    SeatAxisMemPosnOfAxisActrHdrestHei: interface=SeatStorePosnSt1  # Seat Axis Memory Position | Memory position data from storage memory for the current profile of a certain seat axis.
    SeatAxisMemPosnOfAxisActrHdrestTilt: interface=SeatStorePosnSt1  # Seat Axis Memory Position | Memory position data from storage memory for the current profile of a certain seat axis.
    SeatAxisMemPosnOfAxisActrHei: interface=SeatStorePosnSt1  # Seat Axis Memory Position | Memory position data from storage memory for the current profile of a certain seat axis.
    SeatAxisMemPosnOfAxisActrHeiFrnt: interface=SeatStorePosnSt1  # Seat Axis Memory Position | Memory position data from storage memory for the current profile of a certain seat axis.
    SeatAxisMemPosnOfAxisActrHeiRe: interface=SeatStorePosnSt1  # Seat Axis Memory Position | Memory position data from storage memory for the current profile of a certain seat axis.
    SeatAxisMemPosnOfAxisActrIncl: interface=SeatStorePosnSt1  # Seat Axis Memory Position | Memory position data from storage memory for the current profile of a certain seat axis.
    SeatAxisMemPosnOfAxisActrLumExtn: interface=SeatStorePosnSt1  # Seat Axis Memory Position | Memory position data from storage memory for the current profile of a certain seat axis.
    SeatAxisMemPosnOfAxisActrLumHei: interface=SeatStorePosnSt1  # Seat Axis Memory Position | Memory position data from storage memory for the current profile of a certain seat axis.
    SeatAxisMemPosnOfAxisActrSld: interface=SeatStorePosnSt1  # Seat Axis Memory Position | Memory position data from storage memory for the current profile of a certain seat axis.
    SeatAxisMemPosnOfAxisActrTopIncl: interface=SeatStorePosnSt1  # Seat Axis Memory Position | Memory position data from storage memory for the current profile of a certain seat axis.
    SeatAxisMove: interface=SeatMove1  # Seat Axis Move Request | Request to move the specified axis of the seat to the indicated position.
    SeatAxisMoveOfAxisActrBackBlstrLe: interface=SeatMove1  # Seat Axis Move Request | Request to move the specified axis of the seat to the indicated position.
    SeatAxisMoveOfAxisActrBackBlstrRi: interface=SeatMove1  # Seat Axis Move Request | Request to move the specified axis of the seat to the indicated position.
    SeatAxisMoveOfAxisActrCushBlstrLe: interface=SeatMove1  # Seat Axis Move Request | Request to move the specified axis of the seat to the indicated position.
    SeatAxisMoveOfAxisActrCushBlstrRi: interface=SeatMove1  # Seat Axis Move Request | Request to move the specified axis of the seat to the indicated position.
    SeatAxisMoveOfAxisActrCushExtn: interface=SeatMove1  # Seat Axis Move Request | Request to move the specified axis of the seat to the indicated position.
    SeatAxisMoveOfAxisActrHdrestFold: interface=SeatMove1  # Seat Axis Move Request | Request to move the specified axis of the seat to the indicated position.
    SeatAxisMoveOfAxisActrHdrestHei: interface=SeatMove1  # Seat Axis Move Request | Request to move the specified axis of the seat to the indicated position.
    SeatAxisMoveOfAxisActrHdrestTilt: interface=SeatMove1  # Seat Axis Move Request | Request to move the specified axis of the seat to the indicated position.
    SeatAxisMoveOfAxisActrHei: interface=SeatMove1  # Seat Axis Move Request | Request to move the specified axis of the seat to the indicated position.
    SeatAxisMoveOfAxisActrHeiFrnt: interface=SeatMove1  # Seat Axis Move Request | Request to move the specified axis of the seat to the indicated position.
    SeatAxisMoveOfAxisActrHeiRe: interface=SeatMove1  # Seat Axis Move Request | Request to move the specified axis of the seat to the indicated position.
    SeatAxisMoveOfAxisActrIncl: interface=SeatMove1  # Seat Axis Move Request | Request to move the specified axis of the seat to the indicated position.
    SeatAxisMoveOfAxisActrLumExtn: interface=SeatMove1  # Seat Axis Move Request | Request to move the specified axis of the seat to the indicated position.
    SeatAxisMoveOfAxisActrLumHei: interface=SeatMove1  # Seat Axis Move Request | Request to move the specified axis of the seat to the indicated position.
    SeatAxisMoveOfAxisActrSld: interface=SeatMove1  # Seat Axis Move Request | Request to move the specified axis of the seat to the indicated position.
    SeatAxisMoveOfAxisActrTopIncl: interface=SeatMove1  # Seat Axis Move Request | Request to move the specified axis of the seat to the indicated position.
    SeatAxisPosn: interface=SeatAxisPosnSt1  # Seat Axis Position | This provides information about the current status of the seat axis actuator. There are three parts: current movement, speed and position.
    SeatAxisPosnOfAxisActrBackBlstrLe: interface=SeatAxisPosnSt1  # Seat Axis Position | This provides information about the current status of the seat axis actuator. There are three parts: current movement, speed and position.
    SeatAxisPosnOfAxisActrBackBlstrRi: interface=SeatAxisPosnSt1  # Seat Axis Position | This provides information about the current status of the seat axis actuator. There are three parts: current movement, speed and position.
    SeatAxisPosnOfAxisActrCushBlstrLe: interface=SeatAxisPosnSt1  # Seat Axis Position | This provides information about the current status of the seat axis actuator. There are three parts: current movement, speed and position.
    SeatAxisPosnOfAxisActrCushBlstrRi: interface=SeatAxisPosnSt1  # Seat Axis Position | This provides information about the current status of the seat axis actuator. There are three parts: current movement, speed and position.
    SeatAxisPosnOfAxisActrCushExtn: interface=SeatAxisPosnSt1  # Seat Axis Position | This provides information about the current status of the seat axis actuator. There are three parts: current movement, speed and position.
    SeatAxisPosnOfAxisActrHdrestFold: interface=SeatAxisPosnSt1  # Seat Axis Position | This provides information about the current status of the seat axis actuator. There are three parts: current movement, speed and position.
    SeatAxisPosnOfAxisActrHdrestHei: interface=SeatAxisPosnSt1  # Seat Axis Position | This provides information about the current status of the seat axis actuator. There are three parts: current movement, speed and position.
    SeatAxisPosnOfAxisActrHdrestTilt: interface=SeatAxisPosnSt1  # Seat Axis Position | This provides information about the current status of the seat axis actuator. There are three parts: current movement, speed and position.
    SeatAxisPosnOfAxisActrHei: interface=SeatAxisPosnSt1  # Seat Axis Position | This provides information about the current status of the seat axis actuator. There are three parts: current movement, speed and position.
    SeatAxisPosnOfAxisActrHeiFrnt: interface=SeatAxisPosnSt1  # Seat Axis Position | This provides information about the current status of the seat axis actuator. There are three parts: current movement, speed and position.
    SeatAxisPosnOfAxisActrHeiRe: interface=SeatAxisPosnSt1  # Seat Axis Position | This provides information about the current status of the seat axis actuator. There are three parts: current movement, speed and position.
    SeatAxisPosnOfAxisActrIncl: interface=SeatAxisPosnSt1  # Seat Axis Position | This provides information about the current status of the seat axis actuator. There are three parts: current movement, speed and position.
    SeatAxisPosnOfAxisActrLumExtn: interface=SeatAxisPosnSt1  # Seat Axis Position | This provides information about the current status of the seat axis actuator. There are three parts: current movement, speed and position.
    SeatAxisPosnOfAxisActrLumHei: interface=SeatAxisPosnSt1  # Seat Axis Position | This provides information about the current status of the seat axis actuator. There are three parts: current movement, speed and position.
    SeatAxisPosnOfAxisActrSld: interface=SeatAxisPosnSt1  # Seat Axis Position | This provides information about the current status of the seat axis actuator. There are three parts: current movement, speed and position.
    SeatAxisPosnOfAxisActrTopIncl: interface=SeatAxisPosnSt1  # Seat Axis Position | This provides information about the current status of the seat axis actuator. There are three parts: current movement, speed and position.
    SeatAxisStorePosn: interface=StorePosnCmd1  # Store Seat Axis Position | Request to store the position of a certain seat axis to the memory position 'profile'.
    SeatAxisStorePosnOfAxisActrBackBlstrLe: interface=StorePosnCmd1  # Store Seat Axis Position | Request to store the position of a certain seat axis to the memory position 'profile'.
    SeatAxisStorePosnOfAxisActrBackBlstrRi: interface=StorePosnCmd1  # Store Seat Axis Position | Request to store the position of a certain seat axis to the memory position 'profile'.
    SeatAxisStorePosnOfAxisActrCushBlstrLe: interface=StorePosnCmd1  # Store Seat Axis Position | Request to store the position of a certain seat axis to the memory position 'profile'.
    SeatAxisStorePosnOfAxisActrCushBlstrRi: interface=StorePosnCmd1  # Store Seat Axis Position | Request to store the position of a certain seat axis to the memory position 'profile'.
    SeatAxisStorePosnOfAxisActrCushExtn: interface=StorePosnCmd1  # Store Seat Axis Position | Request to store the position of a certain seat axis to the memory position 'profile'.
    SeatAxisStorePosnOfAxisActrHdrestFold: interface=StorePosnCmd1  # Store Seat Axis Position | Request to store the position of a certain seat axis to the memory position 'profile'.
    SeatAxisStorePosnOfAxisActrHdrestHei: interface=StorePosnCmd1  # Store Seat Axis Position | Request to store the position of a certain seat axis to the memory position 'profile'.
    SeatAxisStorePosnOfAxisActrHdrestTilt: interface=StorePosnCmd1  # Store Seat Axis Position | Request to store the position of a certain seat axis to the memory position 'profile'.
    SeatAxisStorePosnOfAxisActrHei: interface=StorePosnCmd1  # Store Seat Axis Position | Request to store the position of a certain seat axis to the memory position 'profile'.
    SeatAxisStorePosnOfAxisActrHeiFrnt: interface=StorePosnCmd1  # Store Seat Axis Position | Request to store the position of a certain seat axis to the memory position 'profile'.
    SeatAxisStorePosnOfAxisActrHeiRe: interface=StorePosnCmd1  # Store Seat Axis Position | Request to store the position of a certain seat axis to the memory position 'profile'.
    SeatAxisStorePosnOfAxisActrIncl: interface=StorePosnCmd1  # Store Seat Axis Position | Request to store the position of a certain seat axis to the memory position 'profile'.
    SeatAxisStorePosnOfAxisActrLumExtn: interface=StorePosnCmd1  # Store Seat Axis Position | Request to store the position of a certain seat axis to the memory position 'profile'.
    SeatAxisStorePosnOfAxisActrLumHei: interface=StorePosnCmd1  # Store Seat Axis Position | Request to store the position of a certain seat axis to the memory position 'profile'.
    SeatAxisStorePosnOfAxisActrSld: interface=StorePosnCmd1  # Store Seat Axis Position | Request to store the position of a certain seat axis to the memory position 'profile'.
    SeatAxisStorePosnOfAxisActrTopIncl: interface=StorePosnCmd1  # Store Seat Axis Position | Request to store the position of a certain seat axis to the memory position 'profile'.
    SeatBltRmnAcoustWarnReq: interface=SeatBltRmnAcoustWarnReq1  # Seat Belt Reminder Acoustic Warning Request | Request to Human Machine Interface (HMI) to sound the seat belt reminder unbuckled warning.
    SeatBltRmnFrqCtrlAcoustWarn: interface=SeatBltRmnFrqCtrlAcoustWarn1  # Seat Belt Reminder Frequenz Control Acoustic Warning | Control of warning frequency to sound in case unbuckled occupants detected
    SeatBltRmnLdnCtrlAcoustWarn: interface=SeatBltRmnLdnCtrlAcoustWarn1  # Seat Belt Reminder Loudness Control Acoustic Warning | Control of warning loudness to sound in case unbuckled occupants detected
    SeatBltRmnOpticWarnReq: interface=SeatBltRmnOpticWarnReq1  # Seat Belt Reminder Optical Warning Request | Request to HMI to display the seat belt reminder optical warning of unbuckled occupants. Optionally the seating position of the not buckled occupant(s) is to display. Therefore dedicated ports are available for seating positions giving the buckling state of the occupant.
    SeatBltRmnWarnSt: interface=SeatBltRmnWarnSt1  # Seat Belt Reminder Warning State | Detected warning state of seat belt reminder
    SeatClimaCmd: interface=SeatClimaCmd1  # Command To Actuator Of Seat Climatisation | Climatisation command To Actuator Of a Seat
    SeatFixa: interface=SeatFixaSt1  # Seat Fixation Status | Information on correct fixation of the seat
    SeatFixaSt: interface=SeatFixaSt1  # Seat Fixation Status | Information on correct fixation of the seat
    SeatFixaStOfDrvrSeat: interface=SeatFixaSt1  # Seat Fixation Status | Information on correct fixation of the seat
    SeatFixaStOfPassSeat: interface=SeatFixaSt1  # Seat Fixation Status | Information on correct fixation of the seat
    SeatFixaStOfSeatRowFirstMid: interface=SeatFixaSt1  # Seat Fixation Status | Information on correct fixation of the seat
    SeatFixaStOfSeatRowSecLe: interface=SeatFixaSt1  # Seat Fixation Status | Information on correct fixation of the seat
    SeatFixaStOfSeatRowSecMid: interface=SeatFixaSt1  # Seat Fixation Status | Information on correct fixation of the seat
    SeatFixaStOfSeatRowSecRi: interface=SeatFixaSt1  # Seat Fixation Status | Information on correct fixation of the seat
    SeatFixaStOfSeatRowThrdLe: interface=SeatFixaSt1  # Seat Fixation Status | Information on correct fixation of the seat
    SeatFixaStOfSeatRowThrdMid: interface=SeatFixaSt1  # Seat Fixation Status | Information on correct fixation of the seat
    SeatFixaStOfSeatRowThrdRi: interface=SeatFixaSt1  # Seat Fixation Status | Information on correct fixation of the seat
    SeatFixaSts: interface=SeatFixaSts1  # Seat Fixation Status | Information on correct fixation of the seat
    SeatFixaStsOfDrvrSeat: interface=SeatFixaSts1  # Seat Fixation Status | Information on correct fixation of the seat
    SeatFixaStsOfPassSeat: interface=SeatFixaSts1  # Seat Fixation Status | Information on correct fixation of the seat
    SeatFixaStsOfSeatRowFirstMid: interface=SeatFixaSts1  # Seat Fixation Status | Information on correct fixation of the seat
    SeatFixaStsOfSeatRowSecLe: interface=SeatFixaSts1  # Seat Fixation Status | Information on correct fixation of the seat
    SeatFixaStsOfSeatRowSecMid: interface=SeatFixaSts1  # Seat Fixation Status | Information on correct fixation of the seat
    SeatFixaStsOfSeatRowSecRi: interface=SeatFixaSts1  # Seat Fixation Status | Information on correct fixation of the seat
    SeatFixaStsOfSeatRowThrdLe: interface=SeatFixaSts1  # Seat Fixation Status | Information on correct fixation of the seat
    SeatFixaStsOfSeatRowThrdMid: interface=SeatFixaSts1  # Seat Fixation Status | Information on correct fixation of the seat
    SeatFixaStsOfSeatRowThrdRi: interface=SeatFixaSts1  # Seat Fixation Status | Information on correct fixation of the seat
    SeatMoveAut: interface=SeatMoveAutReq1  # Auto Adjust Move | Request to perform automatic seat movement to a certain position. This position could be determined by a user request from the seat panel, an access from the remote key, a keyless access, driver-easy-entry request or if reverse gear was detected, to move the head-rest to the "down position".
    SeatMoveSt: interface=SeatMoveSt1  # Seat Move Status | This port provides information about movement status of the seat to the requested position.
    SeatMoveSts: interface=SeatMoveSts1  # Seat Move Status | This port provides information about movement status of the seat to the requested position.
    SeatPosnStore: interface=SeatStorePosnReq1  # Seat Position Store | Request to store the position of the seat to the corresponding profile number.
    SeatT: interface=SeatTVal1  # Seat Temperature | Temperature level From Sensor Of a Seat
    SeatTCmd: interface=SeatTCmd1  # Seat Temperature to Adapter | Seat Temperature Command To Adapter
    SeatTCmdOfDrvrSeat: interface=SeatTCmd1  # Seat Temperature to Adapter | Seat Temperature Command To Adapter
    SeatTCmdOfPassSeat: interface=SeatTCmd1  # Seat Temperature to Adapter | Seat Temperature Command To Adapter
    SeatTCmdOfSeatReLe: interface=SeatTCmd1  # Seat Temperature to Adapter | Seat Temperature Command To Adapter
    SeatTCmdOfSeatReRi: interface=SeatTCmd1  # Seat Temperature to Adapter | Seat Temperature Command To Adapter
    SetSpd: interface=SetSpd1  # Set Speed | Set speed, set by the driver. This set speed is used to control the vehicle target speed in case of free driving or Cruise Control only.
    SetSpdDec: interface=SetSpdDec1  # Set Speed Decrease | Status of deceleration switch to decrease the Adaptive Cruise Control (ACC) / Cruise Control (CC) set speed. ACC decreases the target speed by specified steps defined in the ACC state machine. Cruise Control decelerates the vehicle as long as the driver pushes the button.
    SetSpdInc: interface=SetSpdInc1  # Set Speed Increase | Status of acceleration switch to increase the Adaptive Cruise Control (ACC) / Cruise Control (CC) set speed. ACC increases the target speed by specified steps defined in the ACC state machine. Cruise Control accelerates the vehicle as long as the driver pushes the button.
    SetSpdIndcn: interface=SetSpdIndcn1  # Set Speed Indication | Set speed of driver using Cruise Control (CC) or Adaptive Cruise Control (ACC) as displayed for driver.
    ShiftInProgs: interface=TrsmFlgShiftProgs1  # Shift in Progress | Indicates that a gear shift is in progress, i.e. transient torque transfer | Example of realizations: In case of an Automatic Transmission (AT): Comparison of target gear and actual gear. If they are not equal a shift is in progress. In case of Manual Transmission (MT): If the clutch state is not closed a shift is in progress.
    SideMkr: interface=LiExtCmd1  # Side Marker | This port provides command to turn on/off side markers
    SideMkrOut: interface=LiExtCmd1  # Side Marker Output | This port provides command to turn on/off side markers
    SnsrAlrmSimpleSt: interface=SnsrAlrmSimpleSt1  # Status Of Sensor Adapter Simple Alarm | State of the adapter simple alarm antitheft sensor
    SnsrAlrmSimpleStOfBackWin: interface=SnsrAlrmSimpleSt1  # Status of [Sensor Adapter Simple Alarm] | State of the simple alarm antitheft sensors remapped towards different alarm adapters.
    SnsrAlrmSimpleStOfDoorFrntLe: interface=SnsrAlrmSimpleSt1  # Status of [Sensor Adapter Simple Alarm] | State of the simple alarm antitheft sensors remapped towards different alarm adapters.
    SnsrAlrmSimpleStOfDoorFrntRi: interface=SnsrAlrmSimpleSt1  # Status of [Sensor Adapter Simple Alarm] | State of the simple alarm antitheft sensors remapped towards different alarm adapters.
    SnsrAlrmSimpleStOfDoorReLe: interface=SnsrAlrmSimpleSt1  # Status of [Sensor Adapter Simple Alarm] | State of the simple alarm antitheft sensors remapped towards different alarm adapters.
    SnsrAlrmSimpleStOfDoorReRi: interface=SnsrAlrmSimpleSt1  # Status of [Sensor Adapter Simple Alarm] | State of the simple alarm antitheft sensors remapped towards different alarm adapters.
    SnsrAlrmSimpleStOfHood: interface=SnsrAlrmSimpleSt1  # Status of [Sensor Adapter Simple Alarm] | State of the simple alarm antitheft sensors remapped towards different alarm adapters.
    SnsrAlrmSimpleStOfRadio: interface=SnsrAlrmSimpleSt1  # Status of [Sensor Adapter Simple Alarm] | State of the simple alarm antitheft sensors remapped towards different alarm adapters.
    SnsrAlrmSimpleStOfSnsrGlassBreak: interface=SnsrAlrmSimpleSt1  # Status of [Sensor Adapter Simple Alarm] | State of the simple alarm antitheft sensors remapped towards different alarm adapters.
    SnsrAlrmSimpleStOfTankFlap: interface=SnsrAlrmSimpleSt1  # Status of [Sensor Adapter Simple Alarm] | State of the simple alarm antitheft sensors remapped towards different alarm adapters.
    SnsrAlrmSimpleStOfTr: interface=SnsrAlrmSimpleSt1  # Status of [Sensor Adapter Simple Alarm] | State of the simple alarm antitheft sensors remapped towards different alarm adapters.
    SnsrAlrmSimpleStOfTrlr: interface=SnsrAlrmSimpleSt1  # Status of [Sensor Adapter Simple Alarm] | State of the simple alarm antitheft sensors remapped towards different alarm adapters.
    SnsrAlrmSimpleSts: interface=SnsrAlrmSimpleSts1  # Status Of Sensor Adapter Simple Alarm | State of the adapter simple alarm antitheft sensor
    SnsrAlrmSimpleStsOfBackWin: interface=SnsrAlrmSimpleSts1  # Status of [Sensor Adapter Simple Alarm] | State of the simple alarm antitheft sensors remapped towards different alarm adapters.
    SnsrAlrmSimpleStsOfDoorFrntLe: interface=SnsrAlrmSimpleSts1  # Status of [Sensor Adapter Simple Alarm] | State of the simple alarm antitheft sensors remapped towards different alarm adapters.
    SnsrAlrmSimpleStsOfDoorFrntRi: interface=SnsrAlrmSimpleSts1  # Status of [Sensor Adapter Simple Alarm] | State of the simple alarm antitheft sensors remapped towards different alarm adapters.
    SnsrAlrmSimpleStsOfDoorReLe: interface=SnsrAlrmSimpleSts1  # Status of [Sensor Adapter Simple Alarm] | State of the simple alarm antitheft sensors remapped towards different alarm adapters.
    SnsrAlrmSimpleStsOfDoorReRi: interface=SnsrAlrmSimpleSts1  # Status of [Sensor Adapter Simple Alarm] | State of the simple alarm antitheft sensors remapped towards different alarm adapters.
    SnsrAlrmSimpleStsOfHood: interface=SnsrAlrmSimpleSts1  # Status of [Sensor Adapter Simple Alarm] | State of the simple alarm antitheft sensors remapped towards different alarm adapters.
    SnsrAlrmSimpleStsOfRadio: interface=SnsrAlrmSimpleSts1  # Status of [Sensor Adapter Simple Alarm] | State of the simple alarm antitheft sensors remapped towards different alarm adapters.
    SnsrAlrmSimpleStsOfSnsrGlassBreak: interface=SnsrAlrmSimpleSts1  # Status of [Sensor Adapter Simple Alarm] | State of the simple alarm antitheft sensors remapped towards different alarm adapters.
    SnsrAlrmSimpleStsOfTankFlap: interface=SnsrAlrmSimpleSts1  # Status of [Sensor Adapter Simple Alarm] | State of the simple alarm antitheft sensors remapped towards different alarm adapters.
    SnsrAlrmSimpleStsOfTr: interface=SnsrAlrmSimpleSts1  # Status of [Sensor Adapter Simple Alarm] | State of the simple alarm antitheft sensors remapped towards different alarm adapters.
    SnsrAlrmSimpleStsOfTrlr: interface=SnsrAlrmSimpleSts1  # Status of [Sensor Adapter Simple Alarm] | State of the simple alarm antitheft sensors remapped towards different alarm adapters.
    SnsrAntithftPasSt: interface=SnsrAlrmSt1  # Passive Anti Theft Sensor State | State of the passive antitheft sensor
    SnsrCtrl: interface=CmdForSnsr1  # Sensor Control For Sensor Adapter Alarm | Command to control the adapter alarm antitheft sensor (arm, disarm, exclude,...)
    SnsrCtrlForBackWin: interface=CmdForSnsr1  # Sensor Control for [Sensor Adapter Simple Alarm] | Command to control the adapter simple alarm antitheft sensor (arm, disarm, exclude,...)
    SnsrCtrlForDoorFrntLe: interface=CmdForSnsr1  # Sensor Control for [Sensor Adapter Simple Alarm] | Command to control the adapter simple alarm antitheft sensor (arm, disarm, exclude,...)
    SnsrCtrlForDoorFrntRi: interface=CmdForSnsr1  # Sensor Control for [Sensor Adapter Simple Alarm] | Command to control the adapter simple alarm antitheft sensor (arm, disarm, exclude,...)
    SnsrCtrlForDoorReLe: interface=CmdForSnsr1  # Sensor Control for [Sensor Adapter Simple Alarm] | Command to control the adapter simple alarm antitheft sensor (arm, disarm, exclude,...)
    SnsrCtrlForDoorReRi: interface=CmdForSnsr1  # Sensor Control for [Sensor Adapter Simple Alarm] | Command to control the adapter simple alarm antitheft sensor (arm, disarm, exclude,...)
    SnsrCtrlForHood: interface=CmdForSnsr1  # Sensor Control for [Sensor Adapter Simple Alarm] | Command to control the adapter simple alarm antitheft sensor (arm, disarm, exclude,...)
    SnsrCtrlForRadio: interface=CmdForSnsr1  # Sensor Control for [Sensor Adapter Simple Alarm] | Command to control the adapter simple alarm antitheft sensor (arm, disarm, exclude,...)
    SnsrCtrlForScanrIntr: interface=CmdForSnsr1  # Sensor Control for Interior Scanner | Command to control the adapter complex alarm antitheft sensor (arm, disarm, exclude,...)
    SnsrCtrlForSnsrGlassBreak: interface=CmdForSnsr1  # Sensor Control for [Sensor Adapter Simple Alarm] | Command to control the adapter simple alarm antitheft sensor (arm, disarm, exclude,...)
    SnsrCtrlForSnsrIncln: interface=CmdForSnsr1  # Sensor Control for Inclination Sensor | Command to control the adapter complex alarm antitheft sensor (arm, disarm, exclude,...)
    SnsrCtrlForSoundrBattBacked: interface=CmdForSnsr1  # Sensor Control for Battery Backed Sounder | Command to control the adapter complex alarm antitheft sensor (arm, disarm, exclude,...)
    SnsrCtrlForTankFlap: interface=CmdForSnsr1  # Sensor Control for [Sensor Adapter Simple Alarm] | Command to control the adapter simple alarm antitheft sensor (arm, disarm, exclude,...)
    SnsrCtrlForTr: interface=CmdForSnsr1  # Sensor Control for [Sensor Adapter Simple Alarm] | Command to control the adapter simple alarm antitheft sensor (arm, disarm, exclude,...)
    SnsrCtrlForTrlr: interface=CmdForSnsr1  # Sensor Control for [Sensor Adapter Simple Alarm] | Command to control the adapter simple alarm antitheft sensor (arm, disarm, exclude,...)
    SnsrCtrlOfAntithftPas: interface=CmdForSnsr1  # Passive Anti Theft Sensor Control | Command to control the passive antitheft sensor (arm, disarm, exclude,...)
    SnsrGlassBreakOut: interface=SnsrGlassBreakSt1  # Glass Break Sensor Sensor Out | State of the glass break antitheft sensor
    SnsrInclnIn: interface=SnsrInclnCmd1  # Inclination Sensor In | Command to control the inclination sensor (configuration, arm, disarm,...)
    SnsrInclnInhb: interface=SnsrInclInhbReq1  # Inhibit Inclination Sensor | Inhibition request by user via Hmi for the inclination sensor
    SnsrInclnInhb1: interface=SnsrInclnInhbReq1  # Inhibit Inclination Sensor | Inhibition request by user via Hmi for the inclination sensor
    SnsrInclnOut: interface=SnsrInclnSt1  # Inclination Sensor Out | State of the inclination antitheft sensor
    SnsrIntrScanrIn: interface=SnsrIntrScanrCmd1  # Interior Scanner Sensor In | Command to control the interior scanner sensor (configuration, arm, disarm,...)
    SnsrIntrScanrInhb: interface=SnsrIntrScanrInhbReq1  # Inhibit Interior Scanner Sensor | Inhibition request by user for the interior scanner sensor
    SnsrIntrScanrOut: interface=SnsrIntrScanrSt1  # Interior Scannner Sensor Out | State of the interior scanner antitheft sensor
    SnsrSoundrBattBackedIn: interface=SnsrSoundrBattBackedCmd1  # Battery Backed Sounder Sensor In | Command to control the battery backed sounder sensor (configuration, arm, disarm, charging...)
    SnsrSoundrBattBackedOut: interface=SnsrSoundrBattBackedSt1  # Battery Backed Sounder Sensor Out | State of the battery backed sounder sensor antitheft sensor
    SnsrSt: interface=SnsrAlrmSt1  # Sensor State Of Sensor Adapter Alarm | State of the adapter alarm antitheft sensor
    SnsrStOfBackWin: interface=SnsrAlrmSt1  # Sensor State of [Sensor Adapter Simple Alarm] | State of the adapter simple alarm antitheft sensor
    SnsrStOfDoorFrntLe: interface=SnsrAlrmSt1  # Sensor State of [Sensor Adapter Simple Alarm] | State of the adapter simple alarm antitheft sensor
    SnsrStOfDoorFrntRi: interface=SnsrAlrmSt1  # Sensor State of [Sensor Adapter Simple Alarm] | State of the adapter simple alarm antitheft sensor
    SnsrStOfDoorReLe: interface=SnsrAlrmSt1  # Sensor State of [Sensor Adapter Simple Alarm] | State of the adapter simple alarm antitheft sensor
    SnsrStOfDoorReRi: interface=SnsrAlrmSt1  # Sensor State of [Sensor Adapter Simple Alarm] | State of the adapter simple alarm antitheft sensor
    SnsrStOfHood: interface=SnsrAlrmSt1  # Sensor State of [Sensor Adapter Simple Alarm] | State of the adapter simple alarm antitheft sensor
    SnsrStOfRadio: interface=SnsrAlrmSt1  # Sensor State of [Sensor Adapter Simple Alarm] | State of the adapter simple alarm antitheft sensor
    SnsrStOfScanrIntr: interface=SnsrAlrmSt1  # Sensor State of Interior Scanner | State of the adapter complex alarm antitheft sensor
    SnsrStOfSnsrGlassBreak: interface=SnsrAlrmSt1  # Sensor State of [Sensor Adapter Simple Alarm] | State of the adapter simple alarm antitheft sensor
    SnsrStOfSnsrIncln: interface=SnsrAlrmSt1  # Sensor State of Inclination Sensor | State of the adapter complex alarm antitheft sensor
    SnsrStOfSoundrBattBacked: interface=SnsrAlrmSt1  # Sensor State of Battery Backed Sounder | State of the adapter complex alarm antitheft sensor
    SnsrStOfTankFlap: interface=SnsrAlrmSt1  # Sensor State of [Sensor Adapter Simple Alarm] | State of the adapter simple alarm antitheft sensor
    SnsrStOfTr: interface=SnsrAlrmSt1  # Sensor State of [Sensor Adapter Simple Alarm] | State of the adapter simple alarm antitheft sensor
    SnsrStOfTrlr: interface=SnsrAlrmSt1  # Sensor State of [Sensor Adapter Simple Alarm] | State of the adapter simple alarm antitheft sensor
    SpdLatEstimdByEsc: interface=SpdLat1  # Speed Lateral Estimated by ESC | Estimated lateral vehicle speed component at Center Of Gravity (COG) (depending on available sensors).
    SprgCoeffEstimd: interface=SprgCoeffEstimd1  # Spring Coefficient Estimated | Estimation of the actual spring coefficient provided by the spring system
    SprgCoeffEstimd1: interface=SprgCoeff1  # Spring Coefficient Estimated | Estimation of the actual spring coefficient provided by the spring system
    SprgCtrlTunActvReq: interface=SprgCtrlTunActvReq1  # Spring Control Tuning Active Request | Spring control tuning mode request by the driver.
    SprgCtrlTunMod: interface=SprgCtrlTunMod1  # Spring Control Tuning Mode | Spring tuning mode for display to the driver and provided to other systems
    SprgFEstimd: interface=SprgFEstimd1  # Spring Force Estimated | Estimation of the actual spring forces provided by the spring system.
    SprgFEstimd1: interface=SprgF1  # Spring Force Estimated | Estimation of the actual spring forces provided by the spring system.
    SprgTrvl: interface=SprgTrvl1  # Spring Travel | Spring travel continuous values at individual wheels (one for each corner).
    SsmFlgGearParkReq: interface=GearParkReq1  # Standstill Manager: Request to Engage the Parking Lock | Parking lock request from Stand Still Manager to automatic transmission to set parking position.
    SsmReqTypToEpb: interface=BrkReqTyp1  # Stand Still Management Request Type to EPB | Type of vehicle deceleration force requested by Stand Still Manager to Electric Parking Brake.
    SsmReqTypToEsc: interface=BrkReqTyp2  # Stand Still Management Request Type to ESC | Type of vehicle deceleration force requested by Stand Still Manager (SSM) to Electronic Stability Control (ESC).
    SsmStToEpb: interface=SsmSt1  # Stand Still Management Status to EPB | Failure status of the Stand Still Manager (SSM) regarding electric parking brake.
    SsmStToEsc: interface=SsmSt1  # Stand Still Management Status to ESC | Failure status of the Stand Still Manager (SSM) regarding hydraulic brake.
    SsmStsToEpb: interface=SsmSts1  # Stand Still Management Status to EPB | Failure status of the Stand Still Manager (SSM) regarding electric parking brake.
    SsmStsToEsc: interface=SsmSts1  # Stand Still Management Status to ESC | Failure status of the Stand Still Manager (SSM) regarding hydraulic brake.
    St: interface=LvlDefrstSt1  # Defrost Status | Port for Defrost Status
    StOfActrDefrstFrnt: interface=LvlDefrstSt1  # Defrost Status | Port for Defrost Status
    StOfActrDefrstRe: interface=LvlDefrstSt1  # Defrost Status | Port for Defrost Status
    StOfActrMirrDefrst: interface=LvlDefrstSt1  # Defrost Status | Port for Defrost Status
    StabrCtrlMod: interface=StabrCtrlMod1  # Stabilizer Control Mode | Stabilizer mode for display to driver and provided to other systems
    StabrCtrlTunReq: interface=StabrCtrlTunReq1  # Stabilizer Control Tuning Request | Stabilizer control tuning mode request by the driver.
    StabrRate: interface=StabrRate1  # Stabilizer Rate | Current stabilizer rate of active stabilizers.
    StabrRateReq: interface=StabrRate1  # Stabilizer Rate Request | Requested stabilizer rate to be set by active stabilizer system.
    StabrSt: interface=StabrSt1  # Stabilizer Status | Status of the active or switchable stabilizer on front and rear axle.
    StabrSts: interface=StabrSts1  # Stabilizer Status | Status of the active or switchable stabilizer on front and rear axle.
    StandStillCmftReqByAcc: interface=StandStillCmftReqByAcc1  # Stand Still Comfort Request by ACC | To keep standstill requested by Adaptive Cruise Control (ACC) to Vehicle Longitudinal Control (VLC).
    SteerAgGrdtMaxAllwd: interface=SteerAgGrdtSuppsnMaxAllwd1  # Steering Angle Gradient Maximum Allowed | Maximum allowed superposition steering angle gradient normalized to road wheel angle (actuator potential).
    SteerAgSum: interface=SteerWhlAg1  # Steering Angle Sum | Sum of driver steering angle and superposition angle on steering wheel level.
    SteerAgSuppsn: interface=SteerWhlAg1  # Steering Angle Superposition | Total superposition steering angle on road wheel level.
    SteerAgSuppsnBascSt: interface=SteerSt1  # Steering Angle Superposition Basic Status | Status of Basic Steering Angle Superposition.
    SteerAgSuppsnBascSts: interface=SteerSts1  # Steering Angle Superposition Basic Status | Status of Basic Steering Angle Superposition.
    SteerAgSuppsnEstimdOfCmftFct: interface=SteerWhlAg1  # Steering Angle Superposition Estimated of Comfort Function | Estimated superposition steering angle from comfort functions (e.g. variable gear ratio, pre-control, etc.) on road wheel level.
    SteerCtrlTunReq: interface=SteerCtrlTunReq1  # Steering Control Tuning Request | Steering controller tuning request by the driver.
    SteerDrvrAsscSysModReq: interface=SteerDrvrAsscSysModReq1  # Steering Driver Assistance System Mode Request | Indication to Steering Driver Assistance System, which among several functional or tuning modes has to be activated.
    SteerDrvrAsscSysStIndcn: interface=SteerDrvrAsscSysStIndcn1  # Steering Driver Assistance System Status Indication | Indication from Steering Driver Assistance System of which functional (or non-functional) status it has.
    SteerDrvrAsscSysStsIndcn: interface=SteerDrvrAsscSysStsIndcn1  # Steering Driver Assistance System Status Indication | Indication from Steering Driver Assistance System of which functional (or non-functional) status it has.
    SteerLoadHyd: interface=SteerLoadHyd1  # Steering Load Hydraulic | Hydraulic power steering load at engine crankshaft. This value must take into account all relevant dynamic effects. If electric power steering, this value should be zero, because the load is included in alternator load. It is converted to engine crankshaft torque by the provider. | Default value after reset is zero.
    SteerLoadHydReq: interface=SteerLoadHyd1  # Steering Load Hydraulic Request | Requested hydraulic power steering load at engine crankshaft. This value represents the torque consumption in a predicted future state. If electric power steering, this value should be zero, because the load is included in alternator load. It is converted to engine crankshaft torque by the provider. | Default value after reset is zero.
    SteerMotAgFrntBas: interface=SteerMotAgFrnt1  # Steering Motor Angle Front Base | Measured angle of the front steering device at the steer motor (for steering angle superposition systems).
    SteerMotAgFrntMeasd: interface=SteerMotAgFrnt1  # Steering Motor Angle Front Measured | Conditioned angle of the front steering device at the steer motor (for steering angle superposition systems) (Filtered and Offset corrected)
    SteerMotAgFrntRaw: interface=SteerMotAgFrnt1  # Steering Motor Angle Front Raw | Measured angle of the front steering device at the steer motor (for steering angle superposition systems).
    SteerMotAgFrntStd: interface=SteerMotAgFrnt1  # Steering Motor Angle Front Standard | Conditioned angle of the front steering device at the steer motor (for steering angle superposition systems) (Filtered and Offset corrected)
    SteerMotAgSpdFrntMeasd: interface=SteerMotAgSpdFrnt1  # Steering Motor Angle Speed Front Measured | Conditioned derivative of the angular position measured at the front steering device with respect to the motor shaft.
    SteerMotAgSpdFrntStd: interface=SteerMotAgSpdFrnt1  # Steering Motor Angle Speed Front Standard | Conditioned derivative of the angular position measured at the front steering device with respect to the motor shaft.
    SteerTq: interface=SteerLoadHyd1  # Actual Hydraulic Power Steering Load at Engine Crank Shaft | Hydraulic power steering load at engine crankshaft. This value must take into account all relevant dynamic effects. If electric power steering, this value should be zero, because the load is included in alternator load. It is converted to engine crankshaft torque by the provider. | Default value after reset is zero.
    SteerTqReq: interface=SteerLoadHyd1  # Requested Hydraulic Power Steering Load at Engine Crank Shaft | Requested hydraulic power steering load at engine crankshaft. This value represents the torque consumption in a predicted future state. If electric power steering, this value should be zero, because the load is included in alternator load. It is converted to engine crankshaft torque by the provider. | Default value after reset is zero.
    SteerTqSum: interface=SteerTqSum1  # Steering Torque Sum | Sum of driver steering torque and superposition delta torque at steering wheel level.
    SteerTqSuppsnBascSt: interface=SteerSt1  # Steering Torque Superposition Basic Status | Status of Basic Steering Torque Superposition.
    SteerTqSuppsnBascSts: interface=SteerSts1  # Steering Torque Superposition Basic Status | Status of Basic Steering Torque Superposition.
    SteerTqSuppsnFrntSt: interface=SteerTqSuppsnFrntSt1  # Steering Torque Superposition Front Status | Status of the Basic Steering Torque Superposition that indicates whether it is able to apply the requested delta torque or not.
    SteerTqSuppsnFrntSts: interface=SteerTqSuppsnFrntSts1  # Steering Torque Superposition Front Status | Status of the Basic Steering Torque Superposition that indicates whether it is able to apply the requested delta torque or not.
    SteerVehStabyCtrlMod: interface=SteerVehStabyCtrlMod1  # Steering Vehicle Stability Control Mode | Steering vehicle stability system mode currently in operation.
    SteerVehStabyCtrlModReq: interface=SteerVehStabyCtrlModReq1  # Steering Vehicle Stability Control Mode Request | Vehicle stability system tuning mode request by the driver.
    SteerWhlAgBas: interface=SteerWhlAg1  # Steering Wheel Angle Base | Measured steering angle at steering positioned between the steering wheel and the Basic Steering Angle Superposition (BSAS) system if it is there. Driving intention of driver. (Does not include steering kinematic effects).
    SteerWhlAgMeasd: interface=SteerWhlAg1  # Steering Wheel Angle Measured | Conditioned steer angle at steering positioned between the steering wheel and the Basic Steering Angle Superposition (BSAS) system if it is there. Driving intention of driver. (Does not include steering kinematic effects, offset-compensated, filtered). Derived from measured steering wheel angular position)
    SteerWhlAgRaw: interface=SteerWhlAg1  # Steering Wheel Angle Raw | Measured steering angle at steering positioned between the steering wheel and the Basic Steering Angle Superposition (BSAS) system if it is there. Driving intention of driver. (Does not include steering kinematic effects).
    SteerWhlAgSpdMeasd: interface=SteerWhlAgSpd1  # Steering Wheel Angle Speed Measured | Conditioned (offset-compensated, filtered) steering wheel angle speed. | E.g. measured by a sensor located between the steering wheel and the Steering Angle Superposition system (if available). Does not include steering kinematic effects. Derived from measured steering wheel angular position.
    SteerWhlAgSpdStd: interface=SteerWhlAgSpd1  # Steering Wheel Angle Speed Standard | Conditioned (offset-compensated, filtered) steering wheel angle speed. | E.g. measured by a sensor located between the steering wheel and the Steering Angle Superposition system (if available). Does not include steering kinematic effects. Derived from measured steering wheel angular position.
    SteerWhlAgStd: interface=SteerWhlAg1  # Steering Wheel Angle Standard | Conditioned steer angle at steering positioned between the steering wheel and the Basic Steering Angle Superposition (BSAS) system if it is there. Driving intention of driver. (Does not include steering kinematic effects, offset-compensated, filtered). Derived from measured steering wheel angular position)
    SteerYawStabyCtrlIntvg: interface=YawStabyCtrlIntvg1  # Steering Yaw Stability Control Intervening | Current intervention of yaw stability control by steering.
    StgDispReLeForSeatClima: interface=StgDisp1  # Rear Left Stage Display for Seat Climatisation to HMI | Feedback to Hmi of Rear Left Passenger Stage requested
    StgDispReRiForSeatClima: interface=StgDisp1  # Rear Right Stage Display for Seat Climatisation to HMI | Feedback to Hmi of Rear Right Passenger Stage requested
    StgReLeForSeatClima: interface=StgReq1  # Rear Left Stage Request for Seat Climatisation | Rear Left Passenger Stage Request (no climatisation, heating level, cooling level)
    StgReRiForSeatClima: interface=StgReq1  # Rear Right Stage Request for Seat Climatisation | Rear Right Passenger Stage Request (no climatisation, heating level, cooling level)
    Sts: interface=LvlDefrstSts1  # Defrost Status | Port for Defrost Status
    StsOfActrDefrstFrnt: interface=LvlDefrstSts1  # Defrost Status | Port for Defrost Status
    StsOfActrDefrstRe: interface=LvlDefrstSts1  # Defrost Status | Port for Defrost Status
    StsOfActrMirrDefrst: interface=LvlDefrstSts1  # Defrost Status | Port for Defrost Status
    SuspCtrlTunReq: interface=SuspCtrlTunReq1  # Suspension Control Tuning Request | Request to Suspension to switch between several functional or tuning modes.
    SuspHei: interface=CarHeiSt1  # Car Height | Port that receives information about the suspension height (that is related to vehicle actual total load or tyres pressure status)
    SuspMod: interface=SuspMod1  # Suspension Mode | Suspension mode for display to the driver.
    SuspYawStabyCtrlIntvg: interface=YawStabyCtrlIntvg1  # Suspension Yaw Stability Control Intervening | Active intervention from yaw stability control performed by the suspension
    SwilSprgSt: interface=SwilSprgSt1  # Switchable Spring Status | Status provided by switchable spring.
    SwilSprgSts: interface=SwilSprgSts1  # Switchable Spring Status | Status provided by switchable spring.
    SwtBeamHi: interface=LiExtReq1  # High Beam Switch | Demand to activate/ deactivate high beam.
    SwtBeamLo: interface=LiExtReq1  # Low Beam Switch | Demand to activate/ deactivate low beam.
    SwtFlashBeam: interface=LiExtReq1  # Flash Beam Switch | Request to switch on the flash beam
    SwtFogLiFrnt: interface=LiExtReq1  # Front Fog Light Switch | Requests to switch on front fog lights
    SwtFogLiRe: interface=LiExtReq1  # Rear Fog Light Switch | Requests to switch on rear fog lights
    SwtForHzrdWarn: interface=LiExtReq1  # Hazard Warning Switch | Demand to activate/ deactivate hazard warning blinking
    SwtHomeCmngAndHomeLvng: interface=LiExtReq1  # Coming Home Leaving Home Switch | Demand to activate/ deactivate coming home/ leaving home functionalities
    SwtIndcr: interface=IndcrTurnReq1  # Turn Signal Lever Switch | Driver's turn indication, it is traditionally based on a movement of the left lever. It is a demand to activate / deactivate left or right indicator blinking or temporary blinking left / right. As long as direction indication is requested, the corresponding value should be set.
    SwtLiAut: interface=LiExtReq1  # Automatic Light Switch | Request the activation of the automatic light mode
    SwtLiDaytiRunng: interface=LiExtReq1  # Daytime Running Light Switch | Demand to activate/ deactivate daytime running light (DRL).
    SwtLiPosn: interface=LiExtReq1  # Position Light Switch | Requests to switch on the position lights. (Parking light left and parking light right at the same time)
    SwtStrt: interface=SwtStrtSt1  # Start Switch | Information related to the start switch. It indicates whether the switch is pushed or not.
    SwtTrSecu: interface=SnsrRoofCnvtbSt1  # Trunk Security Switch Status | Status of convertible sensor for trunk security
    TAtBmp: interface=BmpT1  # Temperature at Bumper | Temperature measured at bumper
    TankFlapHmi: interface=LtchRelsReq1  # Tank Flap HMI | User request to release/unlock the Tank Flap of the vehicle.
    TankFlapLockgCmd: interface=LockCmd1  # Tank Flap Locking Command | Command to lock the tank flap
    TankFlapLockgSt: interface=LockSt1  # Tank Flap Locking State | Locking state of the tank flap
    TankFlapLtchRels: interface=DiagcLtchRels1  # Tank Flap Latch Release | Diagnostic request to the sensor component to release/unlock the latch of tank flap
    TankFlapLtchRelsTog: interface=DiagcTog1  # Tank Flap Latch Release Toggle | Diagnostic request to the sensor component to request a "Toggle-Function" of the latch of the tank flap
    TankFlapSt: interface=DoorSt1  # Tank Flap Status | Information on the state of the tank flap
    TankFlapSts: interface=DoorSts1  # Tank Flap Status | Information on the state of the tank flap
    TelltlDefrstActvn: interface=TelltlDefrstCmd1  # Defrost Telltale Activation | Port for Defrost Telltale Activation
    TelltlDefrstReqFrnt: interface=DefrstReq1  # Front Defrost Telltale Request | Port for Front Defrost Telltale Request From Hvac
    TelltlDefrstReqRe: interface=DefrstReq1  # Rear Defrost Telltale Request | Port for Rear Defrost Telltale Request From Hvac
    TelltlDefrstSt: interface=DefrstSt1  # Defrost Telltale Status | Port for Defrost Telltale Status
    TelltlDefrstSts: interface=DefrstSts1  # Defrost Telltale Status | Port for Defrost Telltale Status
    TerminalClmpMod: interface=TerminalClmpModReq1  # Terminal Clamp Mode | Requested modes to power management and powertrain system, based on driver's operation
    TerminalPosnSt: interface=TerminalPosnSt1  # Terminal Position State | Information on the position of mechanical key switch
    TintgAutReq: interface=TintgAutReq1  # Auto Tinting Request | User request to set the mirrors tinting automatically
    TintgAutSt: interface=TintgAutSt1  # Auto Tinting Status | Status of the automatic tinting.
    TintgAutSts: interface=TintgAutSts1  # Auto Tinting Status | Status of the automatic tinting.
    TintgSt: interface=MirrTintgSt1  # Tinting Status | Status related to the tinting of the mirror
    TintgSts: interface=MirrTintgSts1  # Tinting Status | Status related to the tinting of the mirror
    TintgVal: interface=TintgValReq1  # Tinting Value | Request on the level of tinting needed. It is indicated by a value
    TirePEstimdPerWhl: interface=TirePEstimdPerWhl1  # Tire Pressure Estimated per Wheel | Set of estimated wheel individual absolute tire inflation pressure values. | For indirect measuring systems
    TirePEstimdPerWhl1: interface=TirePPerWhl1  # Tire Pressure Estimated per Wheel | Set of estimated wheel individual absolute tire inflation pressure values. | For indirect measuring systems
    TirePMeasdPerWhl: interface=TirePMeasdPerWhl1  # Tire Pressure Measured per Wheel | Set of current measured tire pressures. | For direct measuring systems
    TirePMonAcptOfWhlNewReq: interface=TirePMonAcptOfWhlNewReq1  # Tire Pressure Monitoring Accept of Wheel New Request | Request that one or more new wheels have to be accepted and monitored by Tire Pressure Monitoring. | For direct measuring systems.
    TirePMonCalStIndcnPerWhl: interface=TirePMonCalStIndcnPerWhl1  # Tire Pressure Monitoring Calibration Status Indication per Wheel | Calibration status indication of the Tire Pressure Monitoring to Human Machine Interface (HMI). Wheel individual. | For direct and indirect measuring systems
    TirePMonCalStsIndcnPerWhl: interface=TirePMonCalStsIndcnPerWhl1  # Tire Pressure Monitoring Calibration Status Indication per Wheel | Calibration status indication of the Tire Pressure Monitoring to Human Machine Interface (HMI). Wheel individual. | For direct and indirect measuring systems
    TirePMonIndcnOfWhlNewRcnd: interface=TirePMonIndcnOfWhlNewRcnd1  # Tire Pressure Monitoring New Wheel Recognized Indication | Indication, that one or more new wheels with new sensor ID have been recognized. | For direct measuring systems
    TirePMonRstAckd: interface=TirePMonRstAckd1  # Tire Pressure Monitoring Reset Acknowledged | Acknowledge of the Tire Pressure Monitoring that a tire pressure monitoring reset request has been received. | For direct and indirect measuring systems
    TirePMonRstReq: interface=TirePMonRstReq1  # Tire Pressure Monitoring Reset Request | Request of a reset of the tire pressure monitoring by the driver or diagnostic tool. | For direct and indirect measuring systems.
    TirePMonSt: interface=TirePMonSt1  # Tire Pressure Monitoring Status | Status of the tire pressure monitoring system. | For direct and indirect measuring systems
    TirePMonSts: interface=TirePMonSts1  # Tire Pressure Monitoring Status | Status of the tire pressure monitoring system. | For direct and indirect measuring systems
    TirePMonWarnIndcn: interface=TirePMonWarnIndcn1  # Tire Pressure Monitoring Warning Indication | Indication that at least at one tire a significant loss of tire pressure has been recognized. | For direct and indirect measuring systems
    TirePMonWarnIndcnPerWhl: interface=TirePMonWarnIndcnPerWhl1  # Tire Pressure Monitoring Warning Indication per Wheel | Indication which type of loss of tire pressure has been recognized at wheel. | For direct and indirect measuring systems. For indirect measuring Tire Pressure Monitoring probably not all states can be used.
    TirePThdPerAxle: interface=TirePThdPerAxle1  # Tire Pressure Threshold per Axle | Set of target tire pressure to be monitored at the axles. | For direct measuring systems.
    TirePThdPerAxleIndcn: interface=TirePThdPerAxle1  # Tire Pressure Threshold per Axle Indication | Set of tire pressure threshold per axle provided by Tire Pressure Monitoring. | For direct measuring systems
    TireTEstimdPerWhl: interface=TireTEstimdPerWhl1  # Tire Temperature Estimated per Wheel | Set of estimated wheel individual air temperature inside tire from Tire Pressure Monitoring.
    TireTEstimdPerWhl1: interface=TireTPerWhl1  # Tire Temperature Estimated per Wheel | Set of estimated wheel individual air temperature inside tire from Tire Pressure Monitoring.
    TireTMeasdPerWhl: interface=TireTMeasdPerWhl1  # Tire Temperature Measured per Wheel | Set of current measured tire temperatures. | For direct measuring systems.
    TogSt: interface=TogSt1  # Toggle Status | The value is used to generate feedback to the user about the system's current state. The value represents one of two states, mutually excluding each other, the system can be in or has changed to.
    TqFastAtCluReqdByDrvr: interface=DrvReqTqCluFast1  # Torque Fast at Clutch Requested by Driver | Torque at clutch requested by the driver to be generated by the powertrain.
    TqSlowAtCluReqdByDrvr: interface=DrvReqTqCluSlow1  # Torque Slow at Clutch Requested by Driver | Anticipated torque at clutch requested by the driver to be generated by the powertrain.
    TracCtrlIndcn: interface=TracCtrlIndcn1  # Traction Control Indication | Traction control is active.
    TracCtrlIntvg: interface=TracCtrlIntvg1  # Traction Control Intervening | Traction control intervention status. True if intervening at at least one wheel.
    TracCtrlOvrdnByRsc: interface=CtrlOvrdnByRsc1  # Traction Control Overridden by RSC | Flag indicating Roll Stability Control (RSC) brake torque overrides Traction Control (TC). This enables RSC to request more torque than TC. (Vector of 4)
    TrfCaseCoorrSt: interface=DftlCoorrSts1  # Status of the Transfer Case Coordinator
    TrlrHitch: interface=TrlrHitchSt1  # Trailer Hitch Status | used to indicate the status/position of trailer hitch
    TrlrIndcrDisp: interface=TrlrIndcrDisp1  # Trailer Indicator Display | This port provides Indication to Instrument cluster of trailer turn indicators status.
    TrlrSt: interface=TrlrSt1  # Trailer Status | Indication about presence of trailer.
    TrlrSts: interface=TrlrSts1  # Trailer Status | Indication about presence of trailer.
    TrlrSwt: interface=TrlrSt1  # Trailer Switch | This port provides Hmi switch status related to presence of trailer
    TrsmActrStOfAxleFrnt: interface=TrsmAxleActrSt1  # Transmission Actuator State Axle Front | Status of the transmission actuator at the front axle.
    TrsmActrStOfAxleRe: interface=TrsmAxleActrSt1  # Transmission Actuator State Axle Rear | Status of the transmission actuator at the rear axle.
    TrsmAuthent: interface=TrsmAuthent1  # Transmission Authentication | Authentication process between transmitter and receiver (device inside the vehicle). This information is internal to Passive Entry (PASE) System
    TrsmAuthentFromPaseMgr: interface=TrsmAuthent1  # Transmission Authentication from Pase Manager | Authentication process between transmitter and receiver (device inside the vehicle). This is an external information delivered by Passive Entry (PASE)
    TrsmAuthentFromRxn: interface=TrsmAuthent1  # Transmission Authentication from Reception | The authentication of the Passive Entry (PASE) access device (transmission device) is used by the access device to be recognized (authenticated) by the system. The authentication information is given by the transmission device to reception device (antenna) to the PASE system.
    TrsmCluStAct: interface=TrsmCluStAct1  # Transmission: Actual Clutch State | Actual state of the clutch. | There exist 4 principal states: open, intermediate, near closed, hard closed (Note: The definition of intermediate and near closed has to be made for each project separately) Definition of "Clutch": Be aware that this information is not necessarily equal with the drivetrain open information. If a torque converter clutch is open, the drivetrain can still be closed. In contrary the drivetrain is open for Manual Transmission (MT) and Automatic Manual Transmission (AMT), if the clutch is open!Default value after reset is open. for Automatic Transmission (AT), Continuously Variable Transmission (CVT) it is the converter clutch for Manual Transmission (MT), Automatic Manual Transmission (AMT) it is the clutch between the gear box and the engine drivetrain
    TrsmCluStConsold: interface=TrsmCluStConsold1  # Transmission: Consolidated Clutch State | Actual state of the clutch. | Be aware that this information is not necessarily equal with the drivetrain open information. If a torque converter clutch is open, the drivetrain can still be closed. In contrary the drivetrain is open for Manual Transmission (MT) and Automatic Manual Transmission (AMT), if the clutch is open!Default value after reset is open.
    TrsmCluStTar: interface=TrsmCluStTar1  # Transmission: Target State of the Clutch | Target state of the clutch. | There exist 4 principal states: open, intermediate, near closed, hard closed (Note: The definition of intermediate and near closed has to be made for each project separately) Definition of "Clutch": Be aware that this information is not necessarily equal with the drivetrain open information. If a torque converter clutch is open, the drivetrain can still be closed. In contrary the drivetrain is open for Manual Transmission (MT) and Automatic Manual Transmission (AMT), if the clutch is open!Default value after reset is open. for Automatic Transmission (AT), Continuously Variable Transmission (CVT) it is the converter clutch for Manual Transmission (MT), Automatic Manual Transmission (AMT) it is the clutch between the gear box and the engine drivetrain
    TrsmFlgCtrsftActv: interface=TrsmFlgCtrsftActv1  # Transmission: Countershaft Active | Indicates whether the gear is in low range mode, e.g. for sport utility vehicles (SUV) or Offroad-vehicles with countershaft gearboxes (high range / low range) - 0: countershaft inactive (standard condition) - 1: countershaft active
    TrsmFlgDtOpen: interface=TrsmFlgDtOpen1  # Transmission: Drivetrain Opened | Indicates whether the drive train is open due to driver input. Transitional states between fully open and fully closed drivetrain shall be indicated as open in this signal. | Automatic Transmission (AT): Lever in N or in P or in neutral state because of internal reasons (e.g. internal failure) Manual Transmission (MT): Estimation based on clutch pedal pressed and optional neutral gear recognition. 0 : Drivetrain fully closed 1 : Drivetrain fully open or between fully open and fully closed.
    TrsmFlgParkLockEngd: interface=TrsmFlgParkLockEngd1  # Transmission: Park Lock Engaged | Status of gearbox on engaged parking lock (P-drive) of the Automatic Transmission (AT). 0 : not engaged 1 : engaged
    TrsmFlgShiftProgs: interface=TrsmFlgShiftProgs1  # Transmission: Flag Indicates That a Gear Shift Is in Progress | Indicates that a gear shift is in progress, i.e. transient torque transfer | Example of realizations: In case of an Automatic Transmission (AT): Comparison of target gear and actual gear. If they are not equal a shift is in progress. In case of Manual Transmission (MT): If the clutch state is not closed a shift is in progress. 0 = no gear shift in progress 1 = gear shift in progress
    TrsmFlgSptMod: interface=TrsmFlgSptMod1  # Transmission: Sport Mode Request by Driver | Flag signals that the driver activated the sport mode. 0 = deactivated 1 = activated
    TrsmFlgWntrMod: interface=TrsmFlgWntrMod1  # Transmission: Winter Mode Request by Driver | Flag signals that the driver activated the winter mode 0 = deactivated 1 = activated
    TrsmId: interface=TrsmId1  # Transmission Identifier | Information related to the access device (transmission device) used to enter the car. This information provides the Identifier (ID), it is sent by the transmission device or access card to be recognized by the system
    TrsmIdFromRxn: interface=TrsmId1  # Transmission Identifier from Reception | The identification of the Passive Entry (PASE) access device (transmission device) is used by the access device to be recognized (Identified) by the system. The identification information is given by the transmission device to reception device (antenna) to the PASE system.
    TrsmNInp: interface=TrsmNInp1  # Transmission: Speed at Input | For Transmission with a Torque Converter this interface represents the turbine speed, which is the output speed of the Torque Converter. For Dual Clutch Transmission (DCT) this speed represents the speed of the active clutch. | For low speed values the speed might be a virtual speed.
    TrsmNrGearAct: interface=TrsmNrGearAct1  # Transmission: Actual Gear | Shows the gear being currently engaged in the gear box. Mapping of physical gear to representation is left open, but according to: - Negative values: Reverse gears. (Only for manual transmission: If no information about reverse gears is available then corresponding positive values are used for reverse gears.) - Positive values: forward gears; 0 is drive train open (no torque at clutch is transmitted between the running engine(s) and the wheels). | The use of Continuously Variable Transmission (CVT) has to be handled by separate SW-functionalities. Also for Continuously Variable Transmission (CVT). 0 is defined as open drive train.Default value after reset is zero.
    TrsmNrGearConsold: interface=TrsmNrGearConsold1  # Transmission: Consolidated Gear | Shows the gear being currently engaged in the gear box. Mapping of physical gear to representation is left open, but according to: - Negative values: Reverse gears. (Only for manual transmission: If no information about reverse gears is available then corresponding positive values are used for reverse gears.) - Positive values: forward gears; 0 is drive train open (no torque at clutch is transmitted between the running engine(s) and the wheels). | The use of Continuously Variable Transmission (CVT) has to be handled by separate SW-functionalities. Also for Continuously Variable Transmission (CVT). 0 is defined as open drive train.Default value after reset is zero.
    TrsmNrGearReq: interface=TrsmNrGearReq1  # Transmission: Requested Gear | Shows the gear being currently requested by the ratio strategy. Mapping of physical gear to representation is left open, but according to: - Negative values: Reverse gears. (Only for manual transmission: If no information about reverse gears is available then corresponding positive values are used for reverse gears.) - Positive values: forward gears; 0 is drive train open (no torque at clutch is transmitted between the running engine(s) and the wheels). | The use of Continuously Variable Transmission (CVT) has to be handled by separate SW-functionalities. Also for Continuously Variable Transmission (CVT). 0 is defined as open drive train.Default value after reset is zero.
    TrsmNrGearTar: interface=TrsmNrGearTar1  # Transmission: Target Gear | Shows the gear which will be engaged in the gear box. | During the shifting process this value informs about the gear which is expected to be engaged in the gear box after the shifting process. Therefore it switches to the expected gear state with the beginning of the shifting process. Mapping of physical gear to representation is left open, but according to: (Only for manual transmission: If no information about reverse gears is available then corresponding positive values are used for reverse gears.) 0 is drive train open (no torque at clutch is transmitted between the running engine(s) and the wheels). The use of Continuously Variable Transmission (CVT) has to be handled by separate SW-functionalities. Also for Continuously Variable Transmission (CVT). 0 is defined as open drive train.Default value after reset is zero. Negative values: Reverse gears. Positive values: forward gears;
    TrsmNrTyp: interface=TrsmNrTyp1  # Transmission Type | Information on standard transmission. | Initialization possible by "EOL" or "Key On". This information can come from compiler switch, calibration label, or as learned variant (SW identifies Gearbox type)signal is sent with initialisation
    TrsmPosnForPase: interface=TrsmPosn1  # Transmission Position for Passive Entry | Information precises the position of all transmitters outside of the vehicle - Near or far from the car - rear or front of the car - right or left side of the car This information is internal for Passive Entry functionality
    TrsmPosnFromPaseMgr: interface=TrsmPosn1  # Transmission Position from Pase Manager | Information precises the position of all transmitters outside of the vehicle - Near or far from the car - rear or front of the car - right or left side of the car This information is displayed through the system
    TrsmRatGear: interface=TrsmRatGear1  # Transmission: Get the Gear Ratio of the Gear of Interest (C/S) | The gear ratio of the gear of interest. (Client/Server) | Theoretical transmission ratio i = ntransmission_in / ntransmission_out transmission_in = after converter transmission_out = gearbox out The gear ratio means the theoretical/physical ratio belonging to each gear and not any actual measured value (proposal for Continuously Variable Transmission(CVT): if there is a wide range for gear states, this value could deliver a theoretical value). Negative values: Reverse driving direction. Without considering the: 1.) axle ratio 2.) converter ratio 3.) High/Low-Range ratio'Default value after reset is 1.0.'
    TrsmRatGearAct: interface=TrsmRatGearAct1  # Transmission: The Actual Gear Ratio Being Currently Engaged in the Gear Box | Actual gear ratio The gear ratio being currently engaged in the gear box. | Theoretical transmission ratio i = ntransmission_in / ntransmission_out transmission_in = after converter transmission_out = gearbox out The gear ratio means the theoretical/physical ratio belonging to each gear and not any actual measured value (proposal for Continuously Variable Transmission(CVT): if there is a wide range for gear states, this value could deliver a theoretical value). Negative values: Reverse driving direction. Without considering the: 1.) axle ratio 2.) converter ratio 3.) High/Low-Range ratio'Default value after reset is 1.0.'
    TrsmRatGearConsold: interface=TrsmRatGearConsold1  # Transmission: The Consolidated Gear Ratio Being Currently Engaged in the Gear Box | Actual gear ratio The gear ratio being currently engaged in the gear box. | Theoretical transmission ratio i = ntransmission_in / ntransmission_out transmission_in = after converter transmission_out = gearbox out The gear ratio means the theoretical/physical ratio belonging to each gear and not any actual measured value (proposal for Continuously Variable Transmission(CVT): if there is a wide range for gear states, this value could deliver a theoretical value). Negative values: Reverse driving direction. Without considering the: 1.) axle ratio 2.) converter ratio 3.) High/Low-Range ratio'Default value after reset is 1.0.'
    TrsmRatGearReq: interface=TrsmRatGearReq1  # Transmission: Requested Gear Ratio | The gear ratio which is requested by ratio strategy | Theoretical transmission ratio i = ntransmission_in / ntransmission_out transmission_in = after converter transmission_out = gearbox out The gear ratio means the theoretical/physical ratio belonging to each gear and not any actual measured value. Proposal for Continuously Variable Transmission (CVT): if there is a wide range for gear states, this value could deliver a theoretical ratio. Negative values: Reverse driving direction. Without considering the: 1.) Axle ratio 2.) Converter ratio 3.) High/Low-Range ratio'Default value after reset is 1.0.'
    TrsmRatGearTar: interface=TrsmRatGearTar1  # Transmission: The Gear Ratio Which Will Be Engaged in the Gear Box When Target Gear Is Reached | Target gear ratio The gear ratio which will be engaged in the gear box when target gear is reached. | Theoretical transmission ratio i = ntransmission_in / ntransmission_out transmission_in = after converter transmission_out = gearbox out The gear ratio means the theoretical/physical ratio belonging to each gear and not any actual measured value (proposal for Continuously Variable Transmission(CVT): if there is a wide range for gear states, this value could deliver a theoretical value). Negative values: Reverse driving direction. Without considering the: 1.) axle ratio 2.) converter ratio 3.) High/Low-Range ratio'Default value after reset is 1.0.'
    TrsmRatTqPtAct: interface=TrsmRatTqPtAct1  # Transmission: Actual Powertrain Torque Ratio | Torque conversion ratio including everything between engine and wheel, i.e. converter gain (only for hydraulic converter), gear box and axle ratio. | TQwheel = (TQclutch * FACconverter * ntransmission_in / nwheel) - TQlossDT TQ conversion ratio = FACconverter * ntransmission_in / nwheel (remark: TQlossDT is not considered here) FACconverter = converter gain transmission_in = after converter/clutch Inertia is not considered. The torque conversion ratio considers only the total powertrain torque at wheels, not the wheel individual torque distribution. At open drivetrain: To get a valid value during the open drivetrain always the lowest gear should be used except: Driver or strategy selects "N" or "P": every transmission has an open drivetrain Low vehicle speed: Manual Transmission (MT), Automatic Manual Transmission (AMT) and Dual Clutch Transmission (DCT) have an open drivetrain. For Automatic Transmission (AT) and Continuously Variable Transmission (CVT) the drivetrain is still closed (hydraulic converter) Shifting: Only Manual Transmission (MT) and Automatic Manual Transmission (AMT) have an open drivetrain for Automatic Manual Transmission (AMT), if a gear shift is detected, the torque ratio calculation changes from using the current gear state to the target gear state at some point during the shift. This point of change must be agreed between transmitter and receiver. The torque ratio never indicates neutral during a shift. for Automatic Transmission (AT), Continuously Variable Transmission (CVT) and Dual Clutch Transmission (DCT): While the drivetrain is open the transmission prepares a theoretical gear position to engage immediately after the driver selects "D". This theoretical gear state information should be used.Default value after reset is 1.0.
    TrsmRatTqPtConsold: interface=TrsmRatTqPtConsold1  # Transmission: Consolidated Powertrain Torque Ratio | Torque conversion ratio including everything between engine and wheel, i.e. converter gain (only for hydraulic converter), gear box and axle ratio. | To get a valid value during the open drivetrain always the lowest gear should be used except:
    TrsmReqTypMaxMinTqCluFastSlow: interface=TrsmReqTypMaxMinTqCluFastSlow1  # Transmission: Request for Realization Type of Max and Min Torque at Clutch Requested by Transmission for Shift Intervention on Fast and Slow Path | Defines reference point of signals "Transmission: Maximum/Minimum Torque at Clutch Requested by Transmission for Shift Intervention on Fast/Slow Path". | The signal "Transmission: Request for Realization Type of Max and Min Torque at Clutch Requested by Transmission for Shift Intervention on Fast and Slow Path" affects all of the following signals: Transmission: Maximum Torque at Clutch Requested by Transmission for Shift Intervention on Fast Path, TrsmTqCluMaxFast Transmission: Minimum Torque at Clutch Requested by Transmission for Shift Intervention on Fast Path, TrsmTqCluMinFast Transmission: Maximum Torque at Clutch Requested by Transmission for Shift Intervention on Slow Path, TrsmTqCluMaxSlow Transmission: Minimum Torque at Clutch Requested by Transmission for Shift Intervention on Slow Path, TrsmTqCluMinSlow. 0 = absolute => the transmission control unit requests an absolute limit for the torque to be produced by the engine on the fast and / or slow path. 1 = relative => the transmission control unit requests a relative intervention for the torque to be produced by the engine on the fast and / or slow path. The reference signal is "Powertrain: Torque at Clutch without Transmission Intervention”, PtTqCluWoTrsmIntv. Data format for typical network representation for series projects: BaseType: Uint1 Unit: -- Type: Enum 0 = absolute 1 = relative Cycle Time: 10 ms (max.) for Control Unit internal calculation and Bus communication. Typical receiver: Powertrain
    TrsmReqTypTqCluFast: interface=TrsmReqTypTqCluFast1  # Transmission: Request for Realisation Type of Torque at Clutch Requested by Transmission for Shift Intervention on Fast Path | Defines reference point and coordination of signal "Torque at Clutch Requested by Transmission for Shift Intervention on Fast Path". | 0 = no request => the transmission control unit does not send a request 1 = absolute maximum => the transmission control unit requests an absolute upper limit for the torque to be produced by the engine. The real engine torque is allowed to be lower. It may be lower due to driver request or due to interventions by other control systems. Usually used for decreasing torque requests. 2 = absolute minimum => the transmission control unit requests an absolute lower limit for the torque to be produced by the engine. The real engine torque is allowed to be higher. It may be higher due to driver request or due to interventions by other control systems. Usually used for increasing torque requests. 3 = absolute exact => the transmission control unit requests exactly the torque to be produced by the engine. The real engine torque has to follow the request. Used for exact torque requests independently whether the request is increasing or decreasing. 4 = relative => the transmission control unit requests a torque relative to the reference "Powertrain: Torque at Clutch without Transmission Intervention", PtTqCluWoTrsmIntv. The torque request to be realized is the sum of "Powertrain: Torque at Clutch without Transmission Intervention", PtTqCluWoTrsmIntv and "Transmission: Torque at Clutch Requested by Transmission for Shift Intervention on Fast Path", TrsmTqCluFast. If the sign of the relative torque request is positive the sum is treated like "2 = absolute minimum". If the sign of the relative torque request is negative the sum is treated like "1 = absolute maximum". Advantage of the relative request: It follows dynamic changes of the reference immediately. It does not depend strongly on bus communication time delays. Advantage of the absolute request: It is independent of the reference and its dynamic behavior and consequently meets exact absolute requests by the transmission control unit. This signal does not define whether the intervention of stability control has priority over the intervention of the transmission control unit or not. It can be used in both cases. This priority of stability versus transmission intervention is not part of this definition. Data format for typical network representation for series projects: BaseType: Uint3 Unit: -- Type: Enum 0 = no request 1 = absolute minimum 2 = absolute maximum 3 = absolute exact 4 = relative 5 = not used 6 = not used 7 = not used Cycle Time: 10 ms (max.) for Control Unit internal calculation and Bus communication.
    TrsmRxnOfPasePanic: interface=TrsmRxnOfPasePanicReq1  # Transmission Reception of Pase Panic | Panic request given by Passive Entry (PASE) Key to command a panic alert.
    TrsmStAxleFrntActr: interface=TrsmAxleActrSt1  # Transmission: Status of the Front Axle Actuator | Status of the Front Axle Actuator. This could be a Torque Vector Device, an active control differential or a locking differential
    TrsmStAxleReActr: interface=TrsmAxleActrSt1  # Transmission: Status of the Rear Axle Actuator | Status of the Rear Axle Actuator. This could be a Torque Vector Device, an active control differential or a locking differential
    TrsmStGearLvr: interface=TrsmStGearLvr1  # Transmission: Actual Gear Lever Position | The signal is based on the lever position. Only defined for automatic transmissions.
    TrsmStTrfCaseDftl: interface=TrsmStTrfCaseDftl1  # Transmission: Status of the Transfer Case Differential | Status of the Transfer Case Differential
    TrsmTOil: interface=TrsmTOil1  # Transmission: Oil Temperature | Transmission oil temperature. | typically based on a measurement
    TrsmTqCluFast: interface=TrsmTqCluFast1  # Transmission: Torque at Clutch Requested by Transmission for Shift Intervention on Fast Path | Torque at clutch requested by Transmission for shift intervention on fast path. | This signal is closely related to the signal for "realisation type" of request: The set of these two signals is an alternative to the set of the following signals: Usually used for shift interventions, but permitted for all purposes. This request realized by the engine must not be visible on the following signals, which are sent by the engine control unit: As long as there is no torque request by the transmission control unit a constant substitute value (“no request”) will be transmitted on the signal. On parallel hybrid projects the transmission control unit transmits the “summarized torque request” of the combustion engine and the electric machine. Data format for typical network representation for series projects: Base Type: Uint12 Unit: Nm Type: linear Resolution: 1 Offset: - 2048 Physically used range: Hex Lower/Upper Limit: 0h / FFDh Physical Lower/Upper Limit: -2048 / 2045 Special values outside the physically used range: FFEh = Init FFFh = Error, Signal content invalid Cycle Time: 10 ms (max.) for Control Unit internal calculation and Bus communication. Transmission: Request for Realisation Type of Torque at Clutch Requested by Transmission for Shift Intervention on Fast Path, TrsmReqTypTqCluFast. Transmission: Maximum Torque at Clutch Requested by Transmission for Shift Intervention on Fast Path, TrsmTqCluMaxFast Transmission: Minimum Torque at Clutch Requested by Transmission for Shift Intervention on Fast Path, TrsmTqCluMinFast. Powertrain: Requested Torque at Clutch without Transmission Intervention, PtTqCluReqWoTrsmIntv Powertrain: Predicted Torque at Clutch without Transmission Intervention, PtTqCluWoTrsmIntvPred Powertrain: Torque at Clutch without Transmission Intervention, PtTqCluWoTrsmIntv.
    TrsmTqCluMaxFast: interface=TrsmTqCluMaxFast1  # Transmission: Maximum Torque at Clutch Requested by Transmission for Shift Intervention on Fast Path | Maximum Torque at clutch requested by Transmission for shift intervention on fast path. | The set of these two signals "Transmission: Maximum/Minimum Torque at Clutch Requested by Transmission for Shift Intervention on Fast Path" TrsmTqCluMaxFast/ TrsmTqCluMinFast is an alternative to the set of the following signals: Usually used for shift intervention, but permitted for all purposes. This request realized by the engine must not be visible on the following signals, which are sent by the engine control unit: As long as there is no torque request by the transmission control unit a constant substitute value (“no request”) or the maximum value will be transmitted on the signal. On parallel hybrid projects the transmission control unit transmits the “summarized torque request” of the combustion engine and the electric machine. This signal is defined for an absolute intervention. The interface for relative interventions to the reference "Powertrain: Torque at Clutch without Transmission Intervention" PtTqCluWoTrsmIntv has to be defined separately. Data format for typical network representation for series projects: Base Type: Uint12 Unit: Nm Type: linear Resolution: 1 Offset: - 2048 Physically used range: Hex Lower/Upper Limit: 0h / FFDh Physical Lower/Upper Limit: -2048 / 2045 Special values outside the physically used range: FFEh = Init FFFh = Error, Signal content invalid Cycle Time: 10 ms (max.) for Control Unit internal calculation and Bus communication. "Transmission: Torque at Clutch Requested by Transmission for Shift Intervention on Fast Path", TrsmTqCluFast "Transmission: Request for Realisation Type of Torque at Clutch Requested by Transmission for Shift Intervention on Fast Path",TrsmReqTypTqCluFast. Powertrain: Requested Torque at Clutch without Transmission Intervention, PtTqCluReqWoTrsmIntv Powertrain: Predicted Torque at Clutch without Transmission Intervention, PtTqCluWoTrsmIntvPred and Powertrain: Torque at Clutch without Transmission Intervention, PtTqCluWoTrsmIntv.
    TrsmTqCluMaxProtn: interface=TrsmTqCluMaxProtn1  # Maximum Torque at Clutch Requested by Transmission for Gearbox Protection | Maximum torque limitation for gearbox protection. | Torque reduction in engine is conducted via fast path and slow path. The engine limits the value of the torque at clutch as defined in signal "Powertrain: Torque at Clutch", PtTqClu - therefore influences of dynamic torque are not considered. Lower limit to be considered by engine depends on the torque necessary for the engine internal stall protection. The global target is to avoid damage of gearbox and drivetrain. Although this signal is a transmission intervention the influence has to be visible also on all signals with suffix "...without transmission intervention". Data format for typical network representation for series projects: Base Type: Uint12 Unit: Nm Type: linear Resolution: 1 Offset: - 2048 Physically used range: Hex Lower/Upper Limit: 0h / FFDh Physical Lower/Upper Limit: -2048 / 2045 Special values outside the physically used range: FFEh = Init FFFh = Error, Signal content invalid Cycle Time: 10 ms (max.) for Control Unit internal calculation and Bus communication. Typical receiver: Powertrain Example for “Transmission Requirement for Engine Response” in a typical series project:
    TrsmTqCluMaxSlow: interface=TrsmTqCluMaxSlow1  # Maximum Torque at Clutch Requested by Transmission for Shift Energy Management on Slow Path | Maximum torque at clutch requested by transmission for Shift Energy Management (torque reduction) on the Torque Reserve path. | Example of realisation: For each kind of gearshift the calculation of transmission intervention is based on "Powertrain Torque Clutch Without Transmission Intervention". For example, this request may be active for a duration up to 1000 ms (2000ms for Dual Clutch Transmission (DCT)). In case of "change in mind" this time has to be initialized anew. Default value: "no request" = upper limit of the chosen data type'Must be initialised to the upper limit of the chosen data type.'
    TrsmTqCluMinFast: interface=TrsmTqCluMinFast1  # Transmission: Minimum Torque at Clutch Requested by Transmission for Shift Intervention on Fast Path | Minimum Torque at clutch requested by Transmission for shift intervention on fast path. | The set of these two signals "Transmission: Maximum/Minimum Torque at Clutch Requested by Transmission for Shift Intervention on Fast Path" TrsmTqCluMaxFast/ TrsmTqCluMinFast is an alternative to the set of the following signals: Usually used for shift intervention, but permitted for all purposes. This request realized by the engine must not be visible on the following signals, which are sent by the engine control unit: As long as there is no torque request by the transmission control unit a constant substitute value (“no request”) or the minimum value will be transmitted on the signal. On parallel hybrid projects the transmission control unit transmits the “summarized torque request” of the combustion engine and the electric machine. This signal is defined for an absolute intervention. The interface for relative interventions to the reference "Powertrain: Torque at Clutch without Transmission Intervention" PtTqCluWoTrsmIntv has to be defined separately. Data format for typical network representation for series projects: Base Type: Uint12 Unit: Nm Type: linear Resolution: 1 Offset: - 2048 Physically used range: Hex Lower/Upper Limit: 0h / FFDh Physical Lower/Upper Limit: -2048 / 2045 Special values outside the physically used range: FFEh = Init FFFh = Error, Signal content invalid Cycle Time: 10 ms (max.) for Control Unit internal calculation and Bus communication. "Transmission: Torque at Clutch Requested by Transmission for Shift Intervention on Fast Path", TrsmTqCluFast "Transmission: Request for Realisation Type of Torque at Clutch Requested by Transmission for Shift Intervention on Fast Path",TrsmReqTypTqCluFast. "Powertrain: Requested Torque at Clutch without Transmission Intervention", PtTqCluReqWoTrsmIntv "Powertrain: Predicted Torque at Clutch without Transmission Intervention", PtTqCluWoTrsmIntvPred "Powertrain: Torque at Clutch without Transmission Intervention", PtTqCluWoTrsmIntv.
    TrsmTqCluMinSlow: interface=TrsmTqCluMinSlow1  # Minimum Torque at Clutch Requested by Transmission for Shift Energy Management on Slow Path | Minimum torque at clutch requested by transmission for Shift Energy Management (torque increase) on the Torque Reserve path. | Example of realisation: For each kind of gearshift the calculation of transmission intervention is based on "Powertrain Torque Clutch Without Transmission Intervention". For example, this request may be active for a duration up to 1000 ms (2000ms for Dual Clutch Transmission (DCT)). In case of "change in mind" this time has to be initialized anew. Default value: "no request" = lower limit of the chosen data type'Must be initialised to the lower limit of the chosen data type.'
    TrsmTqDftlAxleFrntAct: interface=TrsmTqDftlAxleFrntAct1  # Transmission: Actual Differential Torque at Front Axle | Actual theoretical maximum transfer torque at the differential on the front axle as realised by the actuator. | Sign convention: Positive to the right or front.
    TrsmTqDftlAxleFrntConsold: interface=TrsmTqDftlAxleFrntConsold1  # Transmission: Consolidated Differential Torque at Front Axle | Actual theoretical maximum transfer torque at the differential on the front axle as realised by the actuator. | Sign convention: Positive to the right or front.
    TrsmTqDftlAxleFrntMax: interface=TrsmTqDftlAxleFrntMax1  # Transmission: Maximum Differential Torque at Front Axle | Absolute value of the maximum torque at the differential on the front axle. | Sign convention: Positive to the right or front or from faster to slower shaft depending on the available device.
    TrsmTqDftlAxleReAct: interface=TrsmTqDftlAxleReAct1  # Transmission: Actual Differential Torque at Rear Axle | Actual theoretical maximum transfer torque at the differential at the rear axle as realised by the actuator. | Sign convention: Positive to the right or front or from faster to slower shaft depending on the available device.
    TrsmTqDftlAxleReConsold: interface=TrsmTqDftlAxleReConsold1  # Transmission: Consolidated Differential Torque at Rear Axle | Actual theoretical maximum transfer torque at the differential at the rear axle as realised by the actuator. | Sign convention: Positive to the right or front or from faster to slower shaft depending on the available device.
    TrsmTqDftlAxleReMax: interface=TrsmTqDftlAxleReMax1  # Transmission: Maximum Differential Torque at Rear Axle | Absolute value of the maximum torque at the differential at the rear axle | Sign convention: Positive to the right or front or from faster to slower shaft depending on the available device.
    TrsmTqDftlTrfAct: interface=TrsmTqDftlTrfAct1  # Transmission: Actual Differential Transfer Torque | Actual theoretical maximum transfer torque at the differential as realised by the actuator. | Sign convention: Positive to the right or front or from faster to slower shaft depending on the available device.
    TrsmTqDftlTrfConsold: interface=TrsmTqDftlTrfConsold1  # Transmission: Consolidated Differential Transfer Torque | Actual theoretical maximum transfer torque at the differential as realised by the actuator. | Sign convention: Positive to the right or front or from faster to slower shaft depending on the available device.
    TrsmTqDftlTrfMax: interface=TrsmTqDftlTrfMax1  # Transmission: Maximum Differential Transfer Torque | Absolute value of the maximum torque at the Transfer Case Differential | Sign convention: Positive to the right or front or from faster to slower shaft depending on the available device.
    TrsmTqOilPmp: interface=TrsmTqOilPmp1  # Transmission Oil Pump Load | Consolidated transmission oil pump load at engine crank shaft. | If the oil pump is driven by the engine crank shaft then this value must take into account all relevant dynamic effects. If it is an electric oil pump, the value should be zero Nm, because the load is included in alternator load. The value of this signal is converted to engine crank shaft torque by the provider.
    TrsmTqOilPmpReq: interface=TrsmTqOilPmpReq1  # Requested Transmission Oil Pump Load | Requested transmission oil pump load at engine crank shaft. | If the oil pump is driven by the engine crank shaft then this value must take into account all relevant dynamic effects. If it is an electric oil pump, the value should be zero Nm, because the load is included in alternator load. The value of this signal is converted to engine crank shaft torque by the provider.
    TrsmTqWhlIndDistbn: interface=TrsmTqWhlIndDistbn1  # Individual Torque at Wheel Distribution as Realized by Transmission System | Individual Torque at Wheel Distribution as realized by Transmission System. Vector of 4 signals. The DTD (drivetrain torque distribution) component in the transmission system realizes the torque distribution request and powertrain coordinator sends the coordinated actual wheel torques as feedback to the chassis. This interface only considers the torque which can be distributed from one or more central torque producers to the wheels by the transmission system. It does not consider additional torque producers located e.g. at the individual wheels. Where no torque is distributed to the wheels by the transmission system (e.g. one axle not driven or directly driven by an electric machine), the respective values are zero. | In case of actor/sensor failures or if there is no possibility to determine the correct distribution an rough estimation is done. Additionally a qualifier has to be set, to inform about invalid or backup values.
    VehBodyAVertEstimd: interface=VehBodyAVert1  # Vehicle Body Acceleration Vertical Estimated | Vector of estimated vehicle vertical body accelerations. Vector of 4 scalars in the order front left, front right, rear left, rear right. Refer to ISO 8855. Location could differ depending on the number of sensors (2,3,4).
    VehBodyAVertMeasd: interface=VehBodyAVert1  # Vehicle Body Acceleration Vertical Measured | Vector of measured vehicle's vertical body accelerations. Vector of 4 scalars in the order front left, front right, rear left, rear right. Refer to ISO 8855. Location of the sensors could differ depending on the number of sensors (2,3,4) (Filtered and offset compensated).
    VehBodyAVertMeasdBas: interface=VehBodyAVert1  # Vehicle Body Acceleration Vertical Measured Base | Vector of measured vehicle's vertical body accelerations. Vector of 4 scalars in the order front left, front right, rear left, rear right. Refer to ISO 8855. Location of the sensors could differ depending on the number of sensors (2,3,4).
    VehBodyAVertMeasdRaw: interface=VehBodyAVert1  # Vehicle Body Acceleration Vertical Measured Raw | Vector of measured vehicle's vertical body accelerations. Vector of 4 scalars in the order front left, front right, rear left, rear right. Refer to ISO 8855. Location of the sensors could differ depending on the number of sensors (2,3,4).
    VehBodyAVertMeasdStd: interface=VehBodyAVert1  # Vehicle Body Acceleration Vertical Measured Standard | Vector of measured vehicle's vertical body accelerations. Vector of 4 scalars in the order front left, front right, rear left, rear right. Refer to ISO 8855. Location of the sensors could differ depending on the number of sensors (2,3,4) (Filtered and offset compensated).
    VehBrkTqApplyReq: interface=VehBrkTqApplyReq1  # Vehicle Brake Torque Apply Request | Request from Vehicle Longitudinal Control to Electronic Stability Control to apply a desired vehicle global brake torque. | Belongs to VehBrkTqReq.
    VehBrkTqGrdtReqToEpb: interface=VehBrkTqGrdtReq1  # Vehicle Brake Torque Gradient Request to EPB | Time derivative of the requested total vehicle brake torque from Stand Still Manager (SSM) to Electric Parking Brake (EPB).
    VehBrkTqGrdtReqToEsc: interface=VehBrkTqGrdtReq1  # Vehicle Brake Torque Gradient Request to ESC | Time Derivative of the requested total vehicle brake torque from Stand Still Manager (SSM) to Electronic Stability Control (ESC)
    VehBrkTqIntd: interface=VehBrkTqIntd1  # Vehicle Brake Torque Intended | Sum of 4 wheel intended brake torques. Result of arbitration between driver and other chassis functions.
    VehBrkTqReq: interface=VehBrkTqReq1  # Vehicle Brake Torque Request | Requested longitudinal total vehicle brake torque regarding Vehicle Longitudinal Control.
    VehBrkTqReqToEpb: interface=VehBrkTqReq1  # Vehicle Brake Torque Request to EPB | Requested longitudinal total vehicle brake torque regarding Electric Parking Brake.
    VehBrkTqReqToEsc: interface=VehBrkTqReq1  # Vehicle Brake Torque Request to ESC | Requested longitudinal total vehicle brake torque regarding hydraulic brake.
    VehCourseCrvtCorrd: interface=VehCourseCrvtCorrd1  # Vehicle Course Curvature Corrected | Curvature of predicted vehicle course which is calculated from vehicle information and environmental information.
    VehCourseCrvtPred: interface=VehCourseCrvtPred1  # Vehicle Course Curvature Predicted | Curvature of predicted vehicle course which is calculated with vehicle speed and yaw rate.
    VehCrashPitchovrDetd: interface=VehPitchovrMod1  # Vehicle Pitchover Crash Detected | Pitchover event detected
    VehCrashRollovrDetd: interface=VehRollovrMod1  # Vehicle Rollover Crash Detected | Rollover event detected
    VehCrashSevCalcdAtFrnt: interface=CrashSev1  # Vehicle Crash Severity Calculated at Front | Calculated crash severity of vehicle to vehicle or vehicle to object front impacts - used to protect occupants
    VehCrashSevCalcdAtLe: interface=CrashSev1  # Vehicle Crash Severity Calculated at Left | Calculated crash severity of vehicle to vehicle or vehicle to object left side impacts - used to protect occupants
    VehCrashSevCalcdAtRe: interface=CrashSev1  # Vehicle Crash Severity Calculated at Rear | Calculated crash severity of vehicle to vehicle or vehicle to object rear impacts - used to protect occupants
    VehCrashSevCalcdAtRi: interface=CrashSev1  # Vehicle Crash Severity Calculated at Right | Calculated crash severity of vehicle to vehicle or vehicle to object right side impacts - used to protect occupants
    VehDetdByFolwCtrl: interface=VehDetdByFolwCtrl1  # Vehicle Detected by Follow Control | Target vehicle for Follow Control in Adaptive Cruise Control is detected. This information is used as input to Adaptive Cruise Control state machine.
    VehHldReq: interface=VehHldReq1  # Vehicle Hold Request | Vehicle hold request from Vehicle Longitudinal Control (VLC) to Stand Still Manager (SSM).
    VehHldSt: interface=VehHldSt1  # Vehicle Hold Status | Status of Stand Still Manager (SSM) to Vehicle Longitudinal Control (VLC) that indicates whether a vehicle is held or not.
    VehHldSts: interface=VehHldSts1  # Vehicle Hold Status | Status of Stand Still Manager (SSM) to Vehicle Longitudinal Control (VLC) that indicates whether a vehicle is held or not.
    VehMEstimdFromSusp: interface=VehMEstimd1  # Vehicle Mass Estimated from Suspension | Estimation of the vehicle mass provided by the suspension systems.
    VehMEstimdFromSusp1: interface=VehM1  # Vehicle Mass Estimated from Suspension | Estimation of the vehicle mass provided by the suspension systems.
    VehMEstimdFromVlc: interface=VehMEstimd1  # Vehicle Mass Estimated from Vehicle Longitudinal Control (VLC) | Estimation of the vehicle mass provided by the Vehicle Longitudinal Control (VLC) based on the longitudinal dynamics of the vehicle.
    VehMEstimdFromVlc1: interface=VehM1  # Vehicle Mass Estimated from Vehicle Longitudinal Control (VLC) | Estimation of the vehicle mass provided by the Vehicle Longitudinal Control (VLC) based on the longitudinal dynamics of the vehicle.
    VehModSt: interface=VehMod1  # Vehicle Mode Status | Information related to the multiple states of the vehicle such as the factory mode, the show room mode, the customer mode.
    VehModSts: interface=VehMod1  # Vehicle Mode Status | Information related to the multiple states of the vehicle such as the factory mode, the show room mode, the customer mode.
    VehMtnSt: interface=VehMtnSt1  # Vehicle Motion State | Vehicle motion state whether vehicle is moving forward, backward or it is in standstill.
    VehSpdDispd: interface=VehSpdDispd1  # Vehicle Speed Displayed | Vehicle speed shown on speedometer.
    VehSpdLgt: interface=VehSpdLgt1  # Vehicle Speed Longitudinal | Vehicle longitudinal speed based on individual wheel speeds, possibly extended by acceleration sensor. Coordinate system according to ISO 8855. The vehicle speed refers to Center Of Gravity (COG). | During brake intervention the accuracy of vehicle speed may be reduced, e.g. for the measured value only 2 wheel speed sensors are used as the other ones are locked.
    VehStOper: interface=OperModSt1  # Vehicle Operating State | Vehicle operation state. | It can be seen as an abstraction and extension of the normal ignition switch position (also called "clamp position") which is traditionally used to guide functional operation of the vehicle. It also includes information about what state the engine is in, i.e. running or not. This signal should be used to control which functionalities / components are active in the vehicle. All states have to be implemented in all cars, but not necessarily used.
    VehTqWhlMaxSftyLimn: interface=VehTqWhlMaxSftyLimn1  # Safety Torque Limit Calculated from the Vehicle's Maximum Speed | Torque limit calculated from the vehicle's maximum speed limit. This speed limit is not the "comfort" speed limit; it is the safety or vehicle protection limit, not normally selectable by the driver.
    VehVLgt: interface=VehSpdLgt1  # Vehicle Speed (Longitudinal) | Consolidated Vehicle Speed (Longitudinal). For example based on wheel speeds, possibly extended by acceleration sensor. | Coordinate system according to ISO 8855. Refers to Center of Gravity (COG).
    VlcA: interface=ALgt2  # Vehicle Longitudinal Control Acceleration | Actual vehicle acceleration realized either by acceleration control or by driver override which is used as reference for vehicle longitudinal control.
    VlcReqOvrdnByDrvrReq: interface=PtFlgDrvOvrdVlc1  # Vehicle Longitudinal Control (VLC) Request Overridden by Driver Request | Flag is set to 1 if driver request overrides Vehicle Longitudinal Control (VLC), otherwise the flag is set to 0
    VlcStShiftPrevnCmft: interface=GearShiftPrevn1  # Vehicle Longitudinal Control (VLC): State of Shift Prevention for Comfort Reasons | Avoid change of gear for comfort reasons: request to avoid shifting request includes aspects from traffic point of view. Final decision remains in the actuator control. Acceleration request tolerance band has higher priority than the gear shift prevention comfort.
    VlcTqWhlPtMax: interface=PtTqTotAtWhls1  # Maximum Torque at Wheel by Vehicle Longitudinal Control (VLC) | Requested wheel torque (to all the driven wheels) after coordination among several vehicle longitudinal control systems (e.g. cruise control, adaptive cruise control, collision mitigation) to be generated by the powertrain. This is the maximum torque to be delivered by the powertrain, e.g. a torque limit request [absolute] (vehicle speed limitation). If the maximum request is less than the minimum request the priority is the Maximum Request (which in the case is the lower value!). If no request is active, the value of this interface will be the upper limit of the chosen data type. | Must be initialised to the upper limit of the chosen data type.
    VlcTqWhlPtMin: interface=PtTqTotAtWhls1  # Minimum Torque at Wheel by Vehicle Longitudinal Control (VLC) | Requested wheel torque (to all the driven wheels) after coordination among several vehicle longitudinal control systems (e.g. cruise control, adaptive cruise control, collision mitigation) to be generated by the powertrain. This is the minimum torque to be delivered by the powertrain, e.g. a torque request [absolute] for CC/ACC (Cruise Control, Adaptive Cruise Control). If the maximum request is less than the minimum request the priority must be clearly defined. If no request is active, the value of this interface will be the lower limit of the chosen data type. | Must be initialised to the lower limit of the chosen data type.
    WhlAAgrMeasd: interface=WhlAAgr1  # Wheel Acceleration Angular Measured | Angular acceleration of the four individual wheels.
    WhlAAgrStd: interface=WhlAAgr1  # Wheel Acceleration Angular Standard | Angular acceleration of the four individual wheels.
    WhlAVertBas: interface=WhlAVert1  # Wheel Acceleration Vertical Base | Measured vehicle vertical wheel accelerations
    WhlAVertEstimd: interface=WhlAVert1  # Wheel Acceleration Vertical Estimated | Estimated vehicle vertical wheel acceleration
    WhlAVertMeasd: interface=WhlAVert1  # Wheel Acceleration Vertical Measured | Measured vehicle vertical wheel accelerations. Refer to ISO 8855.
    WhlAVertRaw: interface=WhlAVert1  # Wheel Acceleration Vertical Raw | Measured vehicle vertical wheel accelerations
    WhlAVertStd: interface=WhlAVert1  # Wheel Acceleration Vertical Standard | Calculated vehicle vertical wheel accelerations. Refer to ISO 8855.
    WhlBrkOvrheatd: interface=WhlBrkOvrheatd1  # Wheel Brake Overheated | Wheel brake overheating Indication that at least one wheel brake (caliper, disc, pad) temperature is high.
    WhlBrkSlipMaxReqByRsc: interface=WhlBrkSlip1  # Wheel Brake Slip Maximum Request by RSC | Requested maximum wheel brake slip from Roll Stability Control (RSC) to Electronic Stability Control (ESC) for individual wheels. Antilock Braking System (ABS) is expected to limit the wheel slips to these maximum values.
    WhlBrkTq: interface=WhlBrkTq1  # Wheel Brake Torque | Brake torques acting on the wheels. Parking brake torque not included. | Based on nominal brake parameters (constant pads friction) and (estimated or measured) brake pressures (clamp forces).
    WhlBrkTqApplyReqByRsc: interface=WhlBrkTqApplyReq1  # Wheel Brake Torque Apply Request by RSC | Request from Roll Stability Control to Electronic Stability Control to apply a desired vehicle wheel brake torque. | Belongs to WhlBrkTqReqByRsc.
    WhlBrkTqReqByRsc: interface=WhlBrkTq1  # Wheel Brake Torque Request by RSC | Requested brake torques from Roll Stability Control to be acting on the wheels. Absolute values requested. | Based on nominal brake parameters (constant pads friction) and (estimated or measured) brake pressures (clamp forces).
    WhlDirRotlMeasd: interface=WhlDirRotl1  # Wheel Direction Rotational Measured | Vector of 4 scalars assigned to the individual wheels in the order front left, front right, rear left, rear right. Each scalar indicates if the wheel is moving ahead or in reverse.
    WhlDirRotlStd: interface=WhlDirRotl1  # Wheel Direction Rotational Standard | Vector of 4 scalars assigned to the individual wheels in the order front left, front right, rear left, rear right. Each scalar indicates if the wheel is moving ahead or in reverse.
    WhlFVertEstimd: interface=WhlFVert1  # Wheel Force Vertical Estimated | Estimation of the actual vertical wheel forces provided by the suspension systems.
    WhlLoadDifEstimdFrnt: interface=WhlLoadDif1  # Wheel Load Difference Estimated Front | Estimated wheel load difference on the front axle defined as the total front axle load applied to the left wheel (100%: Total axle load on left wheel, 0%: Total axle load on right wheel)
    WhlLoadDifEstimdRe: interface=WhlLoadDif1  # Wheel Load Difference Estimated Rear | Estimated wheel load difference on the rear axle defined as the total rear axle load applied to the left wheel (100%: Total axle load on left wheel, 0%: Total axle load on right wheel)
    WhlRdTolrCoeff: interface=WhlRdTolrCoeff1  # Wheel Radius Tolerance Coefficient | Vector of 4 estimated scalars assigned to the individual wheels in the order front left, front right, rear left, rear right. The product of each scalar with its corresponding circumferential wheel speed allows getting a better estimation of the linear velocity of the contact patch of the wheel over ground. These scalars do not compensate for the possible wheel slip.
    WhlSpdCircumlMeasd: interface=WhlSpdCircuml1  # Wheel Speed Circumferential Measured | Vector of 4 scalars in the order front left, front right, rear left, rear right. These scalars are the product of the individual angular velocities with the nominal (or static) rolling radius. The nominal (or static) rolling radius is representative of each vehicle, and is a value which is very close to the longitudinal speed of the vehicle. If signal is not provided (optional) the radius must be available as a parameter.
    WhlSpdCircumlStd: interface=WhlSpdCircuml1  # Wheel Speed Circumferential Standard | Vector of 4 scalars in the order front left, front right, rear left, rear right. These scalars are the product of the individual angular velocities with the nominal (or static) rolling radius. The nominal (or static) rolling radius is representative of each vehicle, and is a value which is very close to the longitudinal speed of the vehicle. If signal is not provided (optional) the radius must be available as a parameter.
    WhlSpdWarnIndcn: interface=WhlSpdWarnIndcn1  # Wheel Speed Warning Indication | Warning indication, that the maximum speed allowed for the configured tires and/or actual pressure has been exceeded.
    WhlSteerReBascSt: interface=SteerSt1  # Wheel Steering Rear Basic Status | Status of Basic Rear Wheel Steering.
    WhlSteerReBascSts: interface=SteerSts1  # Wheel Steering Rear Basic Status | Status of Basic Rear Wheel Steering.
    WhlVAgrMeasd: interface=WhlVAgr1  # Wheel Velocity Angular Measured | Measured Angular velocity of individual wheels in the order front left, front right, rear left, rear right.
    WhlVAgrRaw: interface=WhlVAgrRaw1  # Wheel Velocity Angular Raw | Set of raw values of wheel speed sensors of individual wheels.
    WhlVAgrStd: interface=WhlVAgr1  # Wheel Velocity Angular Standard | Standard Angular velocity of individual wheels in the order front left, front right, rear left, rear right.
    WinHeatrSt: interface=WinHeatrSt1  # Window Heater Status | Activation status of window heater
    WinHeatrSts: interface=WinHeatrSts1  # Window Heater Status | Activation status of window heater
    WipgAutFrntReq: interface=WipgAutReq1  # Wiping Automatic Front Request | Request to activate/deactivate the automatic mode for the front wiping
    WipgCmd: interface=WinWipgCmd1  # Wiping Command | Rear: Activates rear wiping. Also used to move wiper to park position outside the window area for opening rear lid windows. Front: Sets speed and interval of front wiper. Sets several positions (e.g. service, park, winter).
    WipgCmdForWiprFrnt: interface=WinWipgCmd1  # Command for Wiper | Rear: Activates rear wiping. Also used to move wiper to park position outside the window area for opening rear lid windows. Front: Sets speed and interval of front wiper. Sets several positions (e.g. service, park, winter).
    WipgCmdForWiprRe: interface=WinWipgCmd1  # Command for Wiper | Rear: Activates rear wiping. Also used to move wiper to park position outside the window area for opening rear lid windows. Front: Sets speed and interval of front wiper. Sets several positions (e.g. service, park, winter).
    WipgDiFrnt: interface=WiprWshrDiReq1  # Wiping Disable Front | Request to enable or disable the front wiping
    WipgDiRe: interface=WiprWshrDiReq1  # Wiping Disable Rear | Request to enable or disable the rear wiping
    WipgFrntFromHmi: interface=WipgReq1  # Wiping Front from HMI | Represents user's demand to activate / deactivate front wiping. This demand is given by the Human Machine Interface (HMI) of the vehicle.
    WipgReFromHmi: interface=WipgReq1  # Wiping Rear from HMI | Represents user's demand to activate / deactivate rear wiping. This demand is given by the Human Machine Interface (HMI) of the vehicle.
    WipgSpdIntlFromHmi: interface=WipgSpdIntlReq1  # Wiping Speed Interval from HMI | This information precises the user's demand on the speed of front wiping. This demand is given by the Human Machine Interface (HMI) of the vehicle.
    WiprFrnt: interface=WiprSt1  # Front Wiper Status | Feedback on the status of the front wiper. It indicates whether the front wiper is active or not. This information is used to switch on the exterior light in case of bad weather conditions
    WiprPosnReqFromHmi: interface=WiprPosnCmd1  # Wiper Position Request from HMI | Request to move the wipers to reach a predefined position.
    WiprPosng: interface=WiprPosnCmd1  # Wiper Positioning | Rear: To open rear window move wiper to park position outside of the window area. Front: Sets several wiper positions, e.g. service, park, winter.
    WiprPosngForWiprFrnt: interface=WiprPosnCmd1  # Positioning for Wiper | Rear: To open rear window move wiper to park position outside of the window area. Front: Sets several wiper positions, e.g. service, park, winter.
    WiprPosngForWiprRe: interface=WiprPosnCmd1  # Positioning for Wiper | Rear: To open rear window move wiper to park position outside of the window area. Front: Sets several wiper positions, e.g. service, park, winter.
    WiprSt: interface=WiprSt1  # Wiper Status | Feedback on the status of the wiper. It indicates whether the wiper is active or not. This information is used to switch on the exterior light in case of bad weather conditions
    WiprStFrnt: interface=WiprSt1  # Front Wiper Status | Feedback on the status of the front wiper. It indicates whether the front wiper is active or not. This information is used to switch on the exterior light in case of bad weather conditions
    WiprStOfWiprFrnt: interface=WiprSt1  # Status of Wiper | Front: Feedback on the status of the front wiper. It indicates whether the front wiper is active or not. This information is used to switch on the exterior light in case of bad weather conditions. Rear: Feedback on the status of the rear wiper. It indicates whether the rear wiper is active or not. This information is used to switch on the exterior light in case of bad weather conditions.
    WiprStOfWiprRe: interface=WiprSt1  # Status of Wiper | Front: Feedback on the status of the front wiper. It indicates whether the front wiper is active or not. This information is used to switch on the exterior light in case of bad weather conditions. Rear: Feedback on the status of the rear wiper. It indicates whether the rear wiper is active or not. This information is used to switch on the exterior light in case of bad weather conditions.
    WiprSts: interface=WiprSts1  # Wiper Status | Feedback on the status of the wiper. It indicates whether the wiper is active or not. This information is used to switch on the exterior light in case of bad weather conditions
    WiprStsFrnt: interface=WiprSts1  # Front Wiper Status | Feedback on the status of the front wiper. It indicates whether the front wiper is active or not. This information is used to switch on the exterior light in case of bad weather conditions
    WiprStsOfWiprFrnt: interface=WiprSts1  # Status of Wiper | Front: Feedback on the status of the front wiper. It indicates whether the front wiper is active or not. This information is used to switch on the exterior light in case of bad weather conditions. Rear: Feedback on the status of the rear wiper. It indicates whether the rear wiper is active or not. This information is used to switch on the exterior light in case of bad weather conditions.
    WiprStsOfWiprRe: interface=WiprSts1  # Status of Wiper | Front: Feedback on the status of the front wiper. It indicates whether the front wiper is active or not. This information is used to switch on the exterior light in case of bad weather conditions. Rear: Feedback on the status of the rear wiper. It indicates whether the rear wiper is active or not. This information is used to switch on the exterior light in case of bad weather conditions.
    WshngDiFrnt: interface=WiprWshrDiReq1  # Washing Disable Front | Request to enable or disable the front washing
    WshngDiRe: interface=WiprWshrDiReq1  # Washing Disable Rear | Request to enable or disable the rear washing
    WshngFrntFromHmi: interface=WshngReq1  # Washing Front from HMI | Carries a user request to activate the washing of front windows. This demand is provided by the Human Machine Interface (HMI) of the vehicle
    WshngReFromHmi: interface=WshngReq1  # Washing Rear from HMI | Carries a user request to activate the washing of rear windows. This demand is provided by the Human Machine Interface (HMI) of the vehicle
    WshrFldSt: interface=WshrFldSt1  # Washer Fluid Status | Provides the current fluid level contained within this washer tank.
    WshrFldStOfWshrFldTankFrnt: interface=WshrFldSt1  # Status of Washer Fluid Tank | Provides the current fluid level contained within this washer tank.
    WshrFldStOfWshrFldTankRe: interface=WshrFldSt1  # Status of Washer Fluid Tank | Provides the current fluid level contained within this washer tank.
    WshrFldSts: interface=WshrFldSts1  # Washer Fluid Status | Provides the current fluid level contained within this washer tank.
    WshrFldStsOfWshrFldTankFrnt: interface=WshrFldSts1  # Status of Washer Fluid Tank | Provides the current fluid level contained within this washer tank.
    WshrFldStsOfWshrFldTankRe: interface=WshrFldSts1  # Status of Washer Fluid Tank | Provides the current fluid level contained within this washer tank.
    WshrFrnt: interface=WshngCmd1  # Activation Of Washer Front | Users demand for front window washing on/off
    WshrSt: interface=WshrSt1  # Washer Status | Provide information about the washer actuator: fault detected, no fault.
    WshrStFrnt: interface=WshrSt1  # Washer Status Front | Provide information about the washer actuator: fault detected, no fault.
    WshrStOfWshrFrnt: interface=WshrSt1  # Status of Washer Front | Front: Status feedback. Failure feedback. In some implementations, a user wash request results also in a fixed number of wipe-cycles. If washer is defective, these wipe cycles should be suppressed.
    WshrStOfWshrHdlamp: interface=WshrSt1  # Status of Washer Head Lamp | Headlamp: Status feedback. Failure feedback. In some implementations, a user wash request results also in a fixed number of wipe-cycles. If washer is defective, these wipe cycles should be suppressed.
    WshrStOfWshrRe: interface=WshrSt1  # Status of Washer Rear | Rear: Status feedback. Failure feedback. In some implementations, a user wash request results also in a fixed number of wipe-cycles. If washer is defective, these wipe cycles should be suppressed.
    WshrSts: interface=WshrSts1  # Washer Status | Provide information about the washer actuator: fault detected, no fault.
    WshrStsFrnt: interface=WshrSts1  # Washer Status Front | Provide information about the washer actuator: fault detected, no fault.
    WshrStsOfWshrFrnt: interface=WshrSts1  # Status of Washer Front | Front: Status feedback. Failure feedback. In some implementations, a user wash request results also in a fixed number of wipe-cycles. If washer is defective, these wipe cycles should be suppressed.
    WshrStsOfWshrHdlamp: interface=WshrSts1  # Status of Washer Head Lamp | Headlamp: Status feedback. Failure feedback. In some implementations, a user wash request results also in a fixed number of wipe-cycles. If washer is defective, these wipe cycles should be suppressed.
    WshrStsOfWshrRe: interface=WshrSts1  # Status of Washer Rear | Rear: Status feedback. Failure feedback. In some implementations, a user wash request results also in a fixed number of wipe-cycles. If washer is defective, these wipe cycles should be suppressed.
    YawCtrlOvrdnByRsc: interface=CtrlOvrdnByRsc1  # Yaw Control Overridden by RSC | Flag indicating Roll Stability Control (RSC) brake torque overrides yaw control. This enables RSC to win over Active Yaw Control (AYC) also if RSC requests less braking. To avoid conflict between Electronic Stability Control (ESC), Understeering Control and RSC. (Vector of 4)
    YawRateBas: interface=YawRate1  # Yaw Rate Base | Yaw rate base measured along vehicle z-axis (i.e. compensated for orientation). Coordinate system according to ISO 8855.
    YawRateGrdtMeasdByEsc: interface=YawRateGrdt1  # Yaw Rate Gradient Measured by ESC | Time-derivative of Yaw Rate Measured provided by Electronic Stability Control (ESC)
    YawRateGrdtStdByEsc: interface=YawRateGrdt1  # Yaw Rate Gradient Standard by ESC | Time-derivative of Yaw Rate Standard provided by Electronic Stability Control (ESC)
    YawRateMeasdByEsc: interface=YawRate1  # Yaw Rate Measured by ESC | Yaw rate provided by Electronic Stability Control (ESC)
    YawRateOffsMeasdByEsc: interface=YawRate1  # Yaw Rate Offset Measured by ESC | Yaw rate offset provided by Electronic Stability Control (ESC)
    YawRateOffsStdByEsc: interface=YawRate1  # Yaw Rate Offset Standard by ESC | Yaw rate offset provided by Electronic Stability Control (ESC)
    YawRateRaw: interface=YawRate1  # Yaw Rate Raw | Yaw rate base measured along vehicle z-axis (i.e. compensated for orientation). Coordinate system according to ISO 8855.
    YawRateRefValByEsc: interface=YawRate1  # Yaw Rate Reference Value by ESC | Target yaw rate of the Yaw Stability Control feature provided by Electronic Stability Control (ESC)
    YawRateStdByEsc: interface=YawRate1  # Yaw Rate Standard by ESC | Yaw rate provided by Electronic Stability Control (ESC)
    YawStabyCtrlIntvg: interface=YawStabyCtrlIntvg1  # Yaw Stability Control Intervening | Yaw stability control intervention status. | Intervention by any actuators.
    YawStabyInfoByEsc: interface=YawStabyInfo1  # Yaw Stability Information by ESC | Yaw stability information provided by Electronic Stability Control (ESC)
