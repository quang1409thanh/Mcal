AUTOSAR XML (schema 4-2-2)
package /ArcCore/EcucDefs/mpc551x/Implementations
  8 x bsw implementation, all with ar-release-version=4.1.2:
    Spi: programming-language=C, sw-version=2.0.0, used-code-generator=generators::mcal::mpc551x::Spi::main, vendor-specific-module-def=Spi
    Pwm: programming-language=C, sw-version=2.1.0, used-code-generator=generators::mcal::mpc551x::Pwm::main, vendor-specific-module-def=Pwm
    Mcu: programming-language=C, sw-version=2.0.0, used-code-generator=generators::mcal::mpc551x::Mcu::main, vendor-id=60, vendor-specific-module-def=Mcu
    Gpt: programming-language=C, sw-version=3.0.0, used-code-generator=generators::mcal::mpc551x::Gpt::main, vendor-specific-module-def=Gpt
    Dio: sw-version=5.0.0, used-code-generator=generators::mcal::mpc551x::Dio::main, vendor-id=60, vendor-specific-module-def=Dio
    Can: sw-version=5.0.0, used-code-generator=generators::mcal::mpc551x::Can::main, vendor-id=60, vendor-specific-module-def=Can
    Lin: programming-language=C, sw-version=2.1.1, used-code-generator=generators::mcal::mpc551x::Lin::main, vendor-id=60, vendor-specific-module-def=Lin
    Adc: programming-language=C, sw-version=2.0.0, used-code-generator=generators::mcal::mpc551x::Adc::main, vendor-specific-module-def=Adc
