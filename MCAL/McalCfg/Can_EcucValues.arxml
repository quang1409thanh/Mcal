AUTOSAR XML (schema 4-2-2)
package /stm32f107
  module config Can: implementation-config-variant=VARIANT-PRE-COMPILE, module-description=Can
    CanConfigSet
      CanController:
        CanBusoffProcessing = 
        CanControllerActivation = true
        CanControllerBaseAddress = 
        CanControllerId = 0
        CanRxProcessing = 
        CanTxProcessing = 
        CanWakeupFunctionalityAPI = false
        CanWakeupProcessing = 
        CanWakeupSupport = false
        ArcCanControllerLoopback = false
        CanControllerDefaultBaudrate = CanControllerBaudrateConfig
        CanCpuClockRef = (unset)
        CanControllerBaudrateConfig:
          CanControllerBaudRate = 500
          CanControllerBaudRateConfigID = 0
          CanControllerPropSeg = 8
          CanControllerSeg1 = 5
          CanControllerSeg2 = 4
          CanControllerSyncJumpWidth = 1
      CanHardwareObjectRx (CanHardwareObject): CanHandleType=BASIC, CanIdType=STANDARD, CanObjectId=, CanObjectType=RECEIVE, CanControllerRef=CanController
        CanHwFilter: CanHwFilterCode=0, CanHwFilterMask=0
      CanHardwareObjectTx (CanHardwareObject): CanHandleType=BASIC, CanIdType=STANDARD, CanObjectId=, CanObjectType=TRANSMIT, CanControllerRef=CanController
    CanGeneral:
      CanDevErrorDetection = true
      CanHardwareCancellation = false
      CanIdenticalIdCancellation = false
      CanIndex = 
      CanMainFunctionModePeriod = 
      CanMultiplexedTransmission = 
      CanTimeoutDuration = 
      CanVersionInfoApi = true
      CanCounterRef = (unset)
      CanSupportTTCANRef = (unset)
      CanMainFunctionRWPeriods
