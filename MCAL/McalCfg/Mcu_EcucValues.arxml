AUTOSAR XML (schema 4-0-3)
package /stm32f107
  module config Mcu: implementation-config-variant=VARIANT-PRE-COMPILE, module-description=Mcu
    McuGeneralConfiguration: McuDevErrorDetect=true, McuGetRamStateApi=false, McuInitClock=true, McuNoPll=false, McuPerformResetApi=false, McuVersionInfoApi=false
    McuModuleConfiguration: McuClockSrcFailureNotification=DISABLED, McuNumberOfMcuModes=, McuRamSectors=, ArcDefaultClockRef=McuClockSettingConfig
      McuClockSettingConfig: McuClockSettingId=, ArcAPB2ClocksEnable=GPIOD, ArcAPB1ClocksEnable=CAN1, ArcAPB2ClocksEnable=GPIOE, ArcAPB2ClocksEnable=AFIO
        McuClockReferencePoint: Frequency=, McuClockReferencePointFrequency=25E6
        PLLSettings72MHzOn25MHzOsc (PLLSettings): IDF=9, NDIV=8, ODF=0
      3 x McuModeSettingConf, all with McuMode=:
        NORMAL
        RUN
        SLEEP
    McuPublishedInformation
      McuResetReasonConf: McuResetReason=
