AUTOSAR XML (schema 4-0-3)
package /stm32f107
  module config Port: implementation-config-variant=VARIANT-PRE-COMPILE, module-description=Port
    PortConfigSet: ArcPortPinRemap=GPIO_Remap2_CAN1
      3 x PortContainer, all with PortNumberOfPortPins=:
        LED
          PD7 (PortPin):
            PortPinDirection = PORT_PIN_OUT
            PortPinDirectionChangeable = 
            PortPinId = 55
            PortPinInitialMode = 
            PortPinLevelValue = PORT_PIN_LEVEL_LOW
            PortPinMode = 
            PortPinModeChangeable = 
            ArcPortPinGpioMode = GPIO_OUTPUT_PUSHPULL_CNF
            ArcPortPinSlewRate = PORT_PIN_SLEW_RATE_MED
          PD13 (PortPin):
            PortPinDirection = PORT_PIN_OUT
            PortPinDirectionChangeable = 
            PortPinId = 61
            PortPinInitialMode = 
            PortPinLevelValue = PORT_PIN_LEVEL_LOW
            PortPinMode = 
            PortPinModeChangeable = 
            ArcPortPinGpioMode = GPIO_OUTPUT_PUSHPULL_CNF
            ArcPortPinSlewRate = PORT_PIN_SLEW_RATE_MED
        SWITCH
          PE12 (PortPin):
            PortPinDirection = PORT_PIN_IN
            PortPinDirectionChangeable = 
            PortPinId = 76
            PortPinInitialMode = 
            PortPinLevelValue = PORT_PIN_LEVEL_LOW
            PortPinMode = 
            PortPinModeChangeable = 
            ArcPortPinGpioMode = GPIO_INPUT_PULLUP_CNF
            ArcPortPinSlewRate = PORT_PIN_SLEW_RATE_MED
          PE13 (PortPin):
            PortPinDirection = PORT_PIN_IN
            PortPinDirectionChangeable = 
            PortPinId = 77
            PortPinInitialMode = 
            PortPinLevelValue = PORT_PIN_LEVEL_LOW
            PortPinMode = 
            PortPinModeChangeable = 
            ArcPortPinGpioMode = GPIO_INPUT_PULLUP_CNF
            ArcPortPinSlewRate = PORT_PIN_SLEW_RATE_MED
        CAN
          4 x PortPin, all with PortPinLevelValue=PORT_PIN_LEVEL_LOW, PortPinMode=:
            PD0: PortPinDirection=PORT_PIN_IN, PortPinDirectionChangeable=, PortPinId=48, PortPinInitialMode=, PortPinModeChangeable=, ArcPortPinGpioMode=GPIO_INPUT_PULLUP_CNF, ArcPortPinSlewRate=PORT_PIN_SLEW_RATE_MIN
            PD1: PortPinDirection=PORT_PIN_OUT, PortPinDirectionChangeable=, PortPinId=49, PortPinInitialMode=, PortPinModeChangeable=, ArcPortPinGpioMode=GPIO_ALT_PUSHPULL_CNF, ArcPortPinSlewRate=PORT_PIN_SLEW_RATE_MED
            PortPin_B6: PortPinDirection=PORT_PIN_OUT, PortPinDirectionChangeable=00, PortPinId=2222, PortPinInitialMode=PORT_PIN_MODE_CAN, PortPinModeChangeable=00, ArcPortPinGpioMode=GPIO_ALT_PUSHPULL_CNF, ArcPortPinSlewRate=PORT_PIN_SLEW_RATE_MED
            PortPin_B5: PortPinDirection=PORT_PIN_IN, PortPinDirectionChangeable=0, PortPinId=21, PortPinInitialMode=PORT_PIN_MODE_CAN, PortPinModeChangeable=0, ArcPortPinGpioMode=GPIO_INPUT_PULLUP_CNF, ArcPortPinSlewRate=PORT_PIN_SLEW_RATE_MIN
    PortGeneral: PortDevErrorDetect=false, PortSetPinDirectionApi=false, PortSetPinModeApi=false, PortVersionInfoApi=false
